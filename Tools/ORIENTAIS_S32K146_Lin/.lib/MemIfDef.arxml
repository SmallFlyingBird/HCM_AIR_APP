AUTOSAR XML (schema 4-2-2)
package /AUTOSAR
  module definition MemIf [0..1]: variants pre-compile  # Configuration of the MemIf (Memory Abstraction Interface) module.
    container MemIfGeneral  # Configuration of the memory abstraction interface (Memif) module.
      boolean MemIfGeneralDevErrorDetect: set at pre-compile, default-value=false  # Switches the development error detection and notification on or off. | * true: detection and notification is enabled. * false: detection and notification is disabled.
      integer MemIfGeneralNumberOfDevices: 0..2, set at pre-compile, default-value=0  # Concrete number of underlying memory abstraction modules. | Calculation Formula: Count number of configured EA and FEE modules.
      boolean MemIfGeneralVersionInfoApi: set at pre-compile, default-value=false  # Pre-processor switch to enable / disable the API to read out the modules version information. | true: Version info API enabled. false: Version info API disabled.
      boolean MemIfGeneralUseFunciontApi: set at pre-compile, default-value=false  # Pre-processor switch to enable / disable the API to use function. | * true: Use function API enabled. * false: Use function API disabled.
      boolean MemIfGeneralFeeMapSupport: set at pre-compile, default-value=false  # Pre-processor switch to enable / disable the API to Support Fee module mapping. | * true: Support Fee module mapping. * false: Not support Fee module mapping.
      boolean MemIfGeneralEaMapSupport: set at pre-compile, default-value=false  # Pre-processor switch to enable / disable the API to Support Ea module mapping. | * true: Support Ea module mapping. * false: Not support Ea module mapping.
