AUTOSAR XML (schema 4-2-2)
package /AUTOSAR
  module definition OsekNm [0..1]: post-build-variant-support=true, variants link-time/post-build/pre-compile  # Configuration Parameters for the Osek Nm module.
    container OsekNmGlobalConfig  # This container contains the global configuration parameter of the OsekNm. The parameters and the parameters of the sub containers shall be mapped to the C data type OsekNm_ConfigType (for parameters where it is possible) which is passed to the OsekNm_Init function.
      boolean OsekNmComControlEnabled: scope=ECU, set at pre-compile  # Pre-processor switch for enabling the Communication Control support.
      boolean OsekNmComUserDataSupport: scope=ECU, set at pre-compile  # Preprocessor switch for enabling Com User Data.
      boolean OsekNmDevErrorDetect: set at pre-compile  # Switches the Default Error Tracer (Det) detection and notification ON or OFF. | * true: enabled (ON). * false: disabled (OFF).
      boolean OsekNmImmediateTxconfEnabled: scope=ECU, set at pre-compile  # Enable/disable the immediate tx confirmation.
      boolean OsekNmRemoteSleepIndEnabled: scope=ECU, set at pre-compile  # Enable/disable the remote sleep ind.
      float OsekNmMainFunctionPeriod: 0.001..0.255, set at link in variant link-time+post-build / pre-compile in variant pre-compile  # Call cycle in seconds of OsekNm_MainFunction.
      boolean OsekNmPassiveModeEnabled: scope=ECU, set at pre-compile  # Pre-processor switch for enabling support of the Passive Mode.
      boolean OsekNmStateChangeIndEnabled: scope=ECU, set at pre-compile  # Pre-processor switch for enabling the Osek NM state change notification.
      boolean OsekNmUserDataEnabled: scope=ECU, set at pre-compile  # Pre-processor switch for enabling user data support.
      boolean OsekNmVersionInfoApi: scope=ECU, set at pre-compile  # Pre-processor switch for enabling version info API support.
      function name OsekNmLimphomeNotifyName [0..1]: scope=ECU, multiplicity set at link in variant link-time+post-build / pre-compile in variant pre-compile, set at link in variant link-time+post-build / pre-compile in variant pre-compile, max-length=32, min-length=1  # Osek Nm notify node entry Limphome state by this callback function | Functional model reference:void OsekNmNotifyName (NetworkHandleType nmChannelHandle); nmChannelHandle is ComM channel id
      function name OsekNmResetNotifyName [0..1]: scope=ECU, multiplicity set at link in variant link-time+post-build / pre-compile in variant pre-compile, set at link in variant link-time+post-build / pre-compile in variant pre-compile, max-length=32, min-length=1  # Osek Nm notify node entry Reset state by this callback function | Functional model reference:void OsekNmNotifyName (NetworkHandleType nmChannelHandle); nmChannelHandle is ComM channel id
      function name OsekNmNormalNotifyName [0..1]: scope=ECU, multiplicity set at link in variant link-time+post-build / pre-compile in variant pre-compile, set at link in variant link-time+post-build / pre-compile in variant pre-compile, max-length=32, min-length=1  # Osek Nm notify node entry Normal state by this callback function | Functional model reference:void OsekNmNotifyName (NetworkHandleType nmChannelHandle); nmChannelHandle is ComM channel id
      function name OsekNmReadySleepNotifyName [0..1]: scope=ECU, multiplicity set at link in variant link-time+post-build / pre-compile in variant pre-compile, set at link in variant link-time+post-build / pre-compile in variant pre-compile, max-length=32, min-length=1  # Osek Nm notify node entry Ready Sleep state by this callback function | Functional model reference:void OsekNmNotifyName (NetworkHandleType nmChannelHandle); nmChannelHandle is ComM channel id
      function name OsekNmPreSleepNotifyName [0..1]: scope=ECU, multiplicity set at link in variant link-time+post-build / pre-compile in variant pre-compile, set at link in variant link-time+post-build / pre-compile in variant pre-compile, max-length=32, min-length=1  # Osek Nm notify node entry Pre-Sleep state by this callback function | Functional model reference:void OsekNmNotifyName (NetworkHandleType nmChannelHandle); nmChannelHandle is ComM channel id
      function name OsekNmBusSleepNotifyName [0..1]: scope=ECU, multiplicity set at link in variant link-time+post-build / pre-compile in variant pre-compile, set at link in variant link-time+post-build / pre-compile in variant pre-compile, max-length=32, min-length=1  # Osek Nm notify node entry Bus Sleep state by this callback function | Functional model reference:void OsekNmNotifyName (NetworkHandleType nmChannelHandle); nmChannelHandle is ComM channel id
      function name OsekNmD_OnlineName [0..1]: scope=ECU, multiplicity set at link in variant link-time+post-build / pre-compile in variant pre-compile, set at link in variant link-time+post-build / pre-compile in variant pre-compile, max-length=32, min-length=1  # Osek Nm notify node communication requirement is Online | Functional model reference:void OsekNmNotifyName (NetworkHandleType nmChannelHandle); nmChannelHandle is ComM channel id
      function name OsekNmD_OfflineName [0..1]: scope=ECU, multiplicity set at link in variant link-time+post-build / pre-compile in variant pre-compile, set at link in variant link-time+post-build / pre-compile in variant pre-compile, max-length=32, min-length=1  # Osek Nm notify node communication requirement is Offline | Functional model reference:void OsekNmNotifyName (NetworkHandleType nmChannelHandle); nmChannelHandle is ComM channel id
      container OsekNmUserIncludeFiles [0..1]  # Collection of header file names which shall be included by the OsekNm.
        string OsekNmUserIncludeFile [1..*]: multiplicity set at pre-compile, set at pre-compile  # Header file name which shall be included by the OsekNm. | The value of this parameter shall be used as h-char-sequence or q-char-sequence according to ISO C90 section 6.10.2 "source file inclusion". The parameter value MUST NOT represent a path, since ISO C90 does not specify how such a path is treated (i.e., this is implementation defined (and additionally depends on the operating system and the underlying file system)).
    container OsekNmconfig  # This container contains the configuration parameters and sub containers of the AUTOSAR OsekNm module. This container exists once per Channel.
      container OsekNmChannelConfig [1..*]: multiplicity set at pre-compile  # This container contains the channel specific configuration parameter of the OsekNm.
        boolean OsekNmComControlEnabled: scope=ECU, set at pre-compile  # Pre-processor switch for enabling the Communication Control support.
        boolean OsekNmComUserDataSupport: scope=ECU, set at pre-compile  # Preprocessor switch for enabling Com User Data.
        integer OsekNmNodeId: 0..255, post-build-variant-value=true, set at link in variant link-time / post-build in variant post-build / pre-compile in variant pre-compile  # Node identifier of local node.
        enumeration OsekNmPduCbvPosition: {OSEKNM_PDU_BYTE_0, OSEKNM_PDU_BYTE_1, OSEKNM_PDU_OFF}, scope=ECU, set at link in variant link-time+post-build / pre-compile in variant pre-compile, default-value=OSEKNM_PDU_BYTE_1  # Defines the position of the control bit vector within the NM PDU. | The value of the parameter represents the location of the Control Bit Vector in the NM PDU (OsekNmPduByte0 means byte 0, OsekNmPduByte1 means byte 1, OsekNmPduOff means source node identifier is not part of the NM PDU) ImplementationType: OsekNm_PduPositionType
        enumeration OsekNmPduNidPosition: {OSEKNM_PDU_BYTE_0, OSEKNM_PDU_BYTE_1, OSEKNM_PDU_OFF}, scope=ECU, set at link in variant link-time+post-build / pre-compile in variant pre-compile, default-value=OSEKNM_PDU_BYTE_0  # Defines the position of the source node identifier within the NM PDU. | The value of the parameter represents the location of the source node identifier in the NM PDU (OsekNmPduByte0 means byte 0, OsekNmPduByte1 means byte 1, OsekNmPduOff means source node identifier is not part of the NM PDU) ImplementationType: OsekNm_PduPositionType
        float OsekNmMsgTimeoutTime: 0.001..65.535, set at link in variant link-time+post-build / pre-compile in variant pre-compile, default-value=0.01  # Transmission Timeout of NM PDU. If there is no transmission confirmation by the CAN Interface within this timeout, the OsekNm module shall give an error notification.
        float OsekNm_TLimpErr: 0.001..65.535, set at link in variant link-time+post-build / pre-compile in variant pre-compile  # This parameter defines in seconds the recode event error to dem if this node remain Limphome state
        float OsekNm_TTyp: 0..65.535, set at link in variant link-time+post-build / pre-compile in variant pre-compile, default-value=0.1  # Typical time interval between two ring messages | It defines the time in seconds how long the NM shall transmit two ring message
        float OsekNm_TMax: 0..65.535, set at link in variant link-time+post-build / pre-compile in variant pre-compile, default-value=0.26  # Maximum time interval between two ring messages | global for all nodes in network
        float OsekNm_TError: 0..65.535, set at link in variant link-time+post-build / pre-compile in variant pre-compile, default-value=1  # Time interval between two ring messages with NMLimpHome identification | global for all nodes in network
        float OsekNm_TWaitBusSleep: 0..65.535, set at link in variant link-time+post-build / pre-compile in variant pre-compile, default-value=1.5  # Time the NM waits before transmission in NMBusSleep | global for all nodes in network
        float OsekNm_TTx: 0..65.535, set at link in variant link-time+post-build / pre-compile in variant pre-compile, default-value=0.025  # delay to repeat the transmission request of a NM message if the preceding request was rejected | global for all nodes in network
        integer OsekNm_TxLimit: 0..65535, post-build-variant-value=true, set at link in variant link-time / post-build in variant post-build / pre-compile in variant pre-compile, default-value=8  # Counter limit is used to detect a failure at the transmit functionality of the NM
        integer OsekNm_RxLimit: 0..65535, post-build-variant-value=true, set at link in variant link-time / post-build in variant post-build / pre-compile in variant pre-compile, default-value=4  # Counter limit is used to detect a failure at the receive functionality of the NM
        integer OsekNmDefaultFillUserData: 0..65535, post-build-variant-value=true, set at link in variant link-time / post-build in variant post-build / pre-compile in variant pre-compile  # fill default user data every byte in nm pdu
        symbolic name reference OsekNmComMNetworkHandleRef: set at link in variant link-time+post-build / pre-compile in variant pre-compile, destination=ComMChannel  # This reference points to the unique channel defined by the ComMChannel and provides access to the unique channel index value in ComMChannelId.
        container OsekNmRxPdu [1..*]  # This container is used to configure the Rx PDU properties that are used for the OsekNm Channel.
          string OsekNmRxPduId: scope=ECU, set at pre-compile, symbolic-name-value=true  # This parameter defines the Rx PDU ID of the CanIf L-PDU range that is associated with this OsekNm channel.
          integer OsekNmRxPduSourceId [0..1]: 0..255, multiplicity set at link in variant link-time+post-build / pre-compile in variant pre-compile, post-build-variant-multiplicity=true, post-build-variant-value=true, set at link in variant link-time+post-build / pre-compile in variant pre-compile  # Received Nm Pdu this Source Id in Address Field
          reference OsekNmRxPduRef: post-build-variant-value=true, set at link in variant link-time / post-build in variant post-build / pre-compile in variant pre-compile, destination=Pdu  # Reference to the global PDU that is used by this OsekNm channel.
        container OsekNmTxPdu [0..1]  # This container contains the OsekNmTxConfirmationPduId and the OsekNmTxPduRef.
          string OsekNmTxConfirmationPduId: scope=ECU, set at pre-compile, symbolic-name-value=true  # Handle Id to be used by the Lower Layer to confirm the transmission of the OsekNmTxPdu to the LowerLayer.
          reference OsekNmTxPduRef: post-build-variant-value=true, set at link in variant link-time / post-build in variant post-build / pre-compile in variant pre-compile, destination=Pdu  # The reference to the common PDU structure.
        container OsekNmUserDataTxPdu [0..1]  # This optional container is used to configure the UserNm PDU. This container is only available if OsekNmComUserDataSupport is enabled.
          string OsekNmTxUserDataPduId: scope=ECU, set at pre-compile, symbolic-name-value=true  # This parameter defines the Handle ID of the NM User Data I-PDU.
          reference OsekNmTxUserDataPduRef: post-build-variant-value=true, set at link in variant link-time / post-build in variant post-build / pre-compile in variant pre-compile, destination=Pdu  # Reference to the NM User Data I-PDU in the global PDU collection.
        container OsekNmDemEventParameterRefs [0..1]  # Container for the references to DemEventParameter elements which shall be invoked using the API Dem_ReportErrorStatus API in case the corresponding error occurs. The EventId is taken from the referenced DemEventParameter's DemEventId value. The standardized errors are provided in the container and can be extended by vendor specific error references.
          symbolic name reference OSEKNM_E_LIMPHOME [0..1]: multiplicity set at link in variant link-time / post-build in variant post-build / pre-compile in variant pre-compile, post-build-variant-multiplicity=true, post-build-variant-value=true, set at link in variant link-time / post-build in variant post-build / pre-compile in variant pre-compile, destination=DemEventParameter  # Reference to configured DEM event to report limphome errors for this CAN network.
