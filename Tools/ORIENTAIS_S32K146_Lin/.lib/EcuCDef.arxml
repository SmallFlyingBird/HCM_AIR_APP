AUTOSAR XML (schema 4-2-2)
package /AUTOSAR
  module definition EcuC [0..1]: post-build-variant-support=true, variants post-build/pre-compile  # Virtual module to collect ECU Configuration specific / global configuration information.
    container EcucGeneral  # This container holds the general, pre-compile configuration parameters.
      function name ByteOrder: scope=ECU, set at pre-compile, default-value=LITTLE_ENDIAN
    container EcucConfigSet [0..1]  # This container contains the configuration parameters and sub containers of the global PduCollection.
      container EcucPduCollection [0..1]  # Collection of all Pdu objects flowing through the Com-Stack.
        enumeration PduIdTypeEnum: {UINT16, UINT8}, default-value=UINT16  # The PduIdType is used within the entire AUTOSAR Com Stack except for bus drivers. The size of this global type depends on the maximum number of PDUs used within one software module. If no software module deals with more PDUs that 256, this type can be set to uint8. If at least one software module handles more than 256 PDUs, this type must be set to uint16. See AUTOSAR_SWS_CommunicationStackTypes for more details.
        enumeration PduLengthTypeEnum: {UINT16, UINT32, UINT8}, default-value=UINT16  # The PduLengthType is used within the entire AUTOSAR Com Stack except for bus drivers. The size of this global type depends on the maximum length of PDUs to be sent by an ECU. If no segmentation is used the length depends on the maximum payload size of a frame of the underlying communication system (for FlexRay maximum size is 255 bytes, therefore uint8). If segmentation is used it depends on the maximum length of a segmented N-PDU (in general uint16 is used). See AUTOSAR_SWS_CommunicationStackTypes for more details.
        container Pdu [0..*]: multiplicity set at post-build in variant post-build / pre-compile in variant pre-compile, post-build-variant-multiplicity=true  # One Pdu flowing through the COM-Stack. | This Pdu is used by all Com-Stack modules to agree on referencing the same Pdu.
          enumeration EcuCPduDirectionType: {RECEIVE, SEND}, default-value=RECEIVE
          boolean J1939Requestable [0..1]: multiplicity set at post-build in variant post-build / pre-compile in variant pre-compile, post-build-variant-multiplicity=true, post-build-variant-value=true, set at post-build in variant post-build / pre-compile in variant pre-compile  # Pdu can be triggered by the J1939 request message.
          integer MetaDataLength: 0..4, multiplicity set at post-build in variant post-build / pre-compile in variant pre-compile, post-build-variant-multiplicity=true, post-build-variant-value=true, set at post-build in variant post-build / pre-compile in variant pre-compile, default-value=0, default-value=0  # Number of additional bytes in PDU data that contain auxiliary information (MetaData) for the PDU, e.g. the CAN ID. These bytes are handled as part of the PDU data and increase the PDU data length accordingly.
          integer PduLength: 0..4294967295, post-build-variant-value=true, set at post-build in variant post-build / pre-compile in variant pre-compile, default-value=0  # Length of the Pdu in bytes. It should be noted that in former AUTOSAR releases (Rel 2.1, Rel 3.0, Rel 3.1, Rel 4.0 Rev. 1) this parameter was defined in bits.
          foreign reference SysTPduToFrameTriggeringRef [0..1]: multiplicity set at post-build in variant post-build / pre-compile in variant pre-compile, post-build-variant-multiplicity=true, post-build-variant-value=true, set at post-build in variant post-build / pre-compile in variant pre-compile, destination-type=FRAME-TRIGGERING  # Reference to the FrameTriggering from the SystemTemplate which this Pdu belongs to. | SysTPduToFrameTriggeringRef shall be used for UserDefinedPdus, NmPdus and NPdus which are not going through the Pdu Router. This reference shall not be used if SysTPduToPduTriggeringRef exists.
          foreign reference SysTPduToPduTriggeringRef [0..1]: multiplicity set at post-build in variant post-build / pre-compile in variant pre-compile, post-build-variant-multiplicity=true, post-build-variant-value=true, set at post-build in variant post-build / pre-compile in variant pre-compile, destination-type=PDU-TRIGGERING  # Reference to the PduTriggering from the SystemTemplate which this Pdu represents. | SysTPduToPduTriggeringRef shall be used for all Pdus except UserDefinedPdus, NmPdus and NPdus which are not going through the Pdu Router. For these Pdus, SysTPduToFrameTriggeringRef shall be used.
          foreign reference SysTPduToFrameMappingRef [0..1]: set at post-build in variant post-build-loadable+post-build-selectable / pre-compile in variant pre-compile, destination-type=PDU-TO-FRAME-MAPPING  # Reference to the PduToFrameMapping from the SystemTemplate which this Pdu represents.
    container EcucHardware [0..1]  # Hardware definition of this Ecu.
      container EcucCoreDefinition [0..*]  # Definition of one Core on this Ecu.
        integer EcucCoreId: 0..65535, set at pre-compile, symbolic-name-value=true  # ID of the core.
        foreign reference EcucCoreHwRef [0..1]: multiplicity set at pre-compile, set at pre-compile, destination-type=HW-ELEMENT  # Optional reference to the HwElement of HwCategory ProcessingUnit that represents this Core in the ECU Resource Template.
    container EcucPartitionCollection [0..1]  # Collection of Partitions defined for this ECU.
      container EcucPartition [0..*]: multiplicity set at pre-compile  # Definition of one Partition on this ECU. | One Partition will be implemented using one Os-Application.
        boolean EcucPartitionBswModuleExecution: set at pre-compile  # Denotes that this partition will execute BSW Modules. BSW Modules can only be executed in such partitions.
        boolean EcucPartitionQmBswModuleExecution: scope=ECU, set at pre-compile, default-value=true  # Denotes that this partition will execute QM BSW.
        boolean PartitionCanBeRestarted: set at pre-compile  # Specifies the requirement whether the Partition can be restarted. If set to true all software executing in this partition shall be capable of handling a restart.
        foreign reference EcucPartitionBswModuleDistinguishedPartition [0..*]: multiplicity set at pre-compile, set at pre-compile, destination-type=BSW-DISTINGUISHED-PARTITION  # This maps the abstract partition of the Bsw Module to a concrete Partition existing in the ECU.
        instance reference EcucPartitionSoftwareComponentInstanceRef [0..*]: multiplicity set at pre-compile, set at pre-compile, destination-context=ROOT-SW-COMPOSITION-PROTOTYPE, destination-type=SW-COMPONENT-PROTOTYPE  # References the SW Component instances from the Ecu Extract that shall be executed in this partition.
    container EcucPostBuildVariants [0..1]  # Collection of toplevel PostBuildSelectable variants. The PredefinedVariants linked inside this container will determine how many PostBuildSelectableVariants exist. If this container exist the name pattern for initialization of BSW modules will be <Mip>_Config_<PredefinedVariant.shortName>. If this container does not exist the name pattern for initialization of BSW modlues will be <Mip>_Config.
      foreign reference EcucPostBuildVariantRef [1..*]: multiplicity set at pre-compile, set at pre-compile, destination-type=PREDEFINED-VARIANT  # Reference to a PredefinedVariant that defines one toplevel postBuild configuration set (covering all post-build capable BSW modules). PredefinedVariants that are referenced here shall contain only PostBuildVariantCriterionValueSets.
    container EcucUnitGroupAssignment [0..1]  # Collection of UnitGroup references to support the generation of ASAM MCD file.
      foreign reference EcucUnitGroupRef [1..*]: multiplicity set at pre-compile, set at pre-compile, destination-type=UNIT-GROUP  # Optional reference to the UnitGroup to support the generation of ASAM MCD file. These UnitGroups are selecting a set of units for a specific country.
    container EcucVariationResolver [0..1]  # Collection of PredefinedVariant elements containing definition of values for SwSystemconst which shall be applied when resolving the variability during ECU Configuration.
      foreign reference PredefinedVariantRef [1..*]: multiplicity set at pre-compile, set at pre-compile, destination-type=PREDEFINED-VARIANT
