AUTOSAR XML (schema 4-2-2)
package /S32K146
  ecuc value collection S32K146: ecuc-values=[EcuC, Fls, Spi, PduR, Lin, BswM, ComM, Dem, WdgIf, Dio, Os, Mcu, LinIf, WdgM, LinSM, Dcm, MemIf, EcuM, Port, Com, Fee, RamTst, NvM, FlsTst, Crc]
  module config EcuC
    EcucGeneral: ByteOrder=LITTLE_ENDIAN
    EcucConfigSet
      EcucPduCollection: PduIdTypeEnum=UINT16, PduLengthTypeEnum=UINT16
        22 x Pdu, all with MetaDataLength=0:
          BCM_RLM_01: EcuCPduDirectionType=RECEIVE, PduLength=8
          Com_BCM_RLM_01: EcuCPduDirectionType=RECEIVE, PduLength=8
          BCM_RLM_02: EcuCPduDirectionType=RECEIVE, PduLength=8
          Com_BCM_RLM_02: EcuCPduDirectionType=RECEIVE, PduLength=8
          RLM_RS_BCM_01: EcuCPduDirectionType=RECEIVE, PduLength=8
          Com_RLM_RS_BCM_01: EcuCPduDirectionType=RECEIVE, PduLength=8
          RLM_RS_MasterReq: EcuCPduDirectionType=RECEIVE, PduLength=8
          Dcm_RLM_RS_MasterReq: EcuCPduDirectionType=RECEIVE, PduLength=8
          RLM_RS_SlaveResp: EcuCPduDirectionType=SEND, PduLength=8
          Dcm_RLM_RS_SlaveResp: EcuCPduDirectionType=SEND, PduLength=8
          RLM_RS_MasterReq_Fun: EcuCPduDirectionType=RECEIVE, PduLength=8
          Dcm_RLM_RS_MasterReq_Fun: EcuCPduDirectionType=RECEIVE, PduLength=8
          HcmlZcud_Lin2Fr01: EcuCPduDirectionType=RECEIVE, PduLength=7
          Com_HcmlZcud_Lin2Fr01: EcuCPduDirectionType=RECEIVE, PduLength=7
          ZcudZcud_Lin2Fr01: EcuCPduDirectionType=RECEIVE, PduLength=7
          Com_ZcudZcud_Lin2Fr01: EcuCPduDirectionType=RECEIVE, PduLength=7
          ZcudZcud_Lin2Fr02: EcuCPduDirectionType=RECEIVE, PduLength=7
          Com_ZcudZcud_Lin2Fr02: EcuCPduDirectionType=RECEIVE, PduLength=7
          HCML_MasterReq: EcuCPduDirectionType=RECEIVE, PduLength=8
          Dcm_HCML_MasterReq: EcuCPduDirectionType=RECEIVE, PduLength=8
          HCML_SlaveResp: EcuCPduDirectionType=RECEIVE, PduLength=8
          Dcm_HCML_SlaveResp: EcuCPduDirectionType=RECEIVE, PduLength=8
    EcucPartitionCollection
      EcucPartition_0 (EcucPartition): EcucPartitionBswModuleExecution=false, EcucPartitionQmBswModuleExecution=true, PartitionCanBeRestarted=false
  module config Fls: implementation-config-variant=VARIANT-POST-BUILD
    AutosarExt:
      FlsEnableUserModeSupport = 0
      FlsExternalSectorsConfigured = 0
      FlsInternalSectorsConfigured = 1
      FlsInvalidPrefetchBufFromRam = 0
      FlsQspiLockLUT = 0
      FlsSynchronizeCache = 0
    CommonPublishedInformation:
      ArReleaseMajorVersion = 4
      ArReleaseMinorVersion = 4
      ArReleaseRevisionVersion = 0
      ModuleId = 92
      SwMajorVersion = 1
      SwMinorVersion = 0
      SwPatchVersion = 0
      VendorApiInfix = 
      VendorId = 43
    FlsConfigSet:
      FlsAcErase = 1073751296
      FlsAcErasePointer = NULL_PTR
      FlsAcWrite = 1073751296
      FlsAcWritePointer = NULL_PTR
      FlsCallCycle = 0.0
      FlsDefaultMode = MEMIF_MODE_SLOW
      FlsJobEndNotification = Fee_JobEndNotification
      FlsJobErrorNotification = Fee_JobErrorNotification
      FlsMaxReadFastMode = 1048576
      FlsMaxReadNormalMode = 1024
      FlsMaxWriteFastMode = 256
      FlsMaxWriteNormalMode = 128
      FlsProtection = 0
      FlsSectorList
        30 x FlsSector, all with FlsHwCh=FLS_CH_INTERN, FlsNumberOfSectors=1, FlsPageSize=8, FlsPageWriteAsynch=0, FlsQspiSectorCh=NOT_QSPI_CHANNEL, FlsSectorEraseAsynch=0, FlsSectorHwAddress=0, FlsSectorSize=2048:
          FlsSector_0: FlsPhysicalSector=FLS_DATA_ARRAY_0_BLOCK_2_S000, FlsSectorIndex=0, FlsSectorStartaddress=0
          FlsSector_1: FlsPhysicalSector=FLS_DATA_ARRAY_0_BLOCK_2_S001, FlsSectorIndex=1, FlsSectorStartaddress=2048
          FlsSector_10: FlsPhysicalSector=FLS_DATA_ARRAY_0_BLOCK_2_S010, FlsSectorIndex=10, FlsSectorStartaddress=20480
          FlsSector_11: FlsPhysicalSector=FLS_DATA_ARRAY_0_BLOCK_2_S011, FlsSectorIndex=11, FlsSectorStartaddress=22528
          FlsSector_12: FlsPhysicalSector=FLS_DATA_ARRAY_0_BLOCK_2_S012, FlsSectorIndex=12, FlsSectorStartaddress=24576
          FlsSector_13: FlsPhysicalSector=FLS_DATA_ARRAY_0_BLOCK_2_S013, FlsSectorIndex=13, FlsSectorStartaddress=26624
          FlsSector_14: FlsPhysicalSector=FLS_DATA_ARRAY_0_BLOCK_2_S014, FlsSectorIndex=14, FlsSectorStartaddress=28672
          FlsSector_15: FlsPhysicalSector=FLS_DATA_ARRAY_0_BLOCK_2_S015, FlsSectorIndex=15, FlsSectorStartaddress=30720
          FlsSector_16: FlsPhysicalSector=FLS_DATA_ARRAY_0_BLOCK_2_S016, FlsSectorIndex=16, FlsSectorStartaddress=32768
          FlsSector_17: FlsPhysicalSector=FLS_DATA_ARRAY_0_BLOCK_2_S017, FlsSectorIndex=17, FlsSectorStartaddress=34816
          FlsSector_18: FlsPhysicalSector=FLS_DATA_ARRAY_0_BLOCK_2_S018, FlsSectorIndex=18, FlsSectorStartaddress=36864
          FlsSector_19: FlsPhysicalSector=FLS_DATA_ARRAY_0_BLOCK_2_S019, FlsSectorIndex=19, FlsSectorStartaddress=38912
          FlsSector_2: FlsPhysicalSector=FLS_DATA_ARRAY_0_BLOCK_2_S002, FlsSectorIndex=2, FlsSectorStartaddress=4096
          FlsSector_20: FlsPhysicalSector=FLS_DATA_ARRAY_0_BLOCK_2_S020, FlsSectorIndex=20, FlsSectorStartaddress=40960
          FlsSector_21: FlsPhysicalSector=FLS_DATA_ARRAY_0_BLOCK_2_S021, FlsSectorIndex=21, FlsSectorStartaddress=43008
          FlsSector_22: FlsPhysicalSector=FLS_DATA_ARRAY_0_BLOCK_2_S022, FlsSectorIndex=22, FlsSectorStartaddress=45056
          FlsSector_23: FlsPhysicalSector=FLS_DATA_ARRAY_0_BLOCK_2_S023, FlsSectorIndex=23, FlsSectorStartaddress=47104
          FlsSector_24: FlsPhysicalSector=FLS_DATA_ARRAY_0_BLOCK_2_S024, FlsSectorIndex=24, FlsSectorStartaddress=49152
          FlsSector_25: FlsPhysicalSector=FLS_DATA_ARRAY_0_BLOCK_2_S025, FlsSectorIndex=25, FlsSectorStartaddress=51200
          FlsSector_26: FlsPhysicalSector=FLS_DATA_ARRAY_0_BLOCK_2_S026, FlsSectorIndex=26, FlsSectorStartaddress=53248
          FlsSector_27: FlsPhysicalSector=FLS_DATA_ARRAY_0_BLOCK_2_S027, FlsSectorIndex=27, FlsSectorStartaddress=55296
          FlsSector_28: FlsPhysicalSector=FLS_DATA_ARRAY_0_BLOCK_2_S028, FlsSectorIndex=28, FlsSectorStartaddress=57344
          FlsSector_29: FlsPhysicalSector=FLS_DATA_ARRAY_0_BLOCK_2_S029, FlsSectorIndex=29, FlsSectorStartaddress=59392
          FlsSector_3: FlsPhysicalSector=FLS_DATA_ARRAY_0_BLOCK_2_S003, FlsSectorIndex=3, FlsSectorStartaddress=6144
          FlsSector_4: FlsPhysicalSector=FLS_DATA_ARRAY_0_BLOCK_2_S004, FlsSectorIndex=4, FlsSectorStartaddress=8192
          FlsSector_5: FlsPhysicalSector=FLS_DATA_ARRAY_0_BLOCK_2_S005, FlsSectorIndex=5, FlsSectorStartaddress=10240
          FlsSector_6: FlsPhysicalSector=FLS_DATA_ARRAY_0_BLOCK_2_S006, FlsSectorIndex=6, FlsSectorStartaddress=12288
          FlsSector_7: FlsPhysicalSector=FLS_DATA_ARRAY_0_BLOCK_2_S007, FlsSectorIndex=7, FlsSectorStartaddress=14336
          FlsSector_8: FlsPhysicalSector=FLS_DATA_ARRAY_0_BLOCK_2_S008, FlsSectorIndex=8, FlsSectorStartaddress=16384
          FlsSector_9: FlsPhysicalSector=FLS_DATA_ARRAY_0_BLOCK_2_S009, FlsSectorIndex=9, FlsSectorStartaddress=18432
    FlsGeneral:
      FlsAbortTimeout = 32767
      FlsAcLoadOnJobStart = 0
      FlsAsyncEraseTimeout = 2147483647
      FlsAsyncWriteTimeout = 2147483647
      FlsBaseAddress = 0
      FlsBlankCheckApi = 0
      FlsCancelApi = 0
      FlsCleanCacheAfterLoadAc = 0
      FlsCompareApi = 0
      FlsDevErrorDetect = 1
      FlsDriverIndex = 0
      FlsECCCheck = 0
      FlsECCHandlingProtectionHook = 0
      FlsEnableDevAssert = 0
      FlsEraseVerificationEnabled = 0
      FlsGetJobResultApi = 1
      FlsGetStatusApi = 1
      FlsMaxEraseBlankCheck = 256
      FlsQspiAsyncEraseTimeout = 2147483647
      FlsQspiAsyncWriteTimeout = 2147483647
      FlsQspiCommandCompleteTimeout = 1
      FlsQspiFlashInitTimeout = 1
      FlsQspiIpTimeoutOsifCounterType = OSIF_COUNTER_DUMMY
      FlsQspiResetTimeout = 1
      FlsQspiSoftwareResetDelay = 0
      FlsQspiSyncEraseTimeout = 2147483647
      FlsQspiSyncReadTimeout = 2147483647
      FlsQspiSyncWriteTimeout = 2147483647
      FlsQspiWriteEnableRetries = 3
      FlsSetModeApi = 1
      FlsSyncEraseTimeout = 2147483647
      FlsSyncWriteTimeout = 2147483647
      FlsTimeoutMethod = OSIF_COUNTER_DUMMY
      FlsTimeoutSupervisionEnabled = 0
      FlsTotalSize = 0
      FlsUseInterrupts = 0
      FlsVersionInfoApi = 0
      FlsWriteVerificationEnabled = 0
    FlsPublishedInformation:
      FlsAcLocationErase = 0
      FlsAcLocationWrite = 0
      FlsAcSizeErase = 0
      FlsAcSizeWrite = 0
      FlsECCValue = 1427461397
      FlsEraseTime = 5.0
      FlsErasedValue = 4294967295
      FlsExpectedHwId = 0
      FlsSpecifiedEraseCycles = 100000
      FlsWriteTime = 5.0E-4
  module config Spi: implementation-config-variant=VARIANT-PRE-COMPILE
    CommonPublishedInformation:
      ArReleaseMajorVersion = 4
      ArReleaseMinorVersion = 4
      ArReleaseRevisionVersion = 0
      ModuleId = 83
      SwMajorVersion = 1
      SwMinorVersion = 0
      SwPatchVersion = 0
      VendorId = 43
    SpiAutosarExt:
      SpiAllowBigSizeCollections = 0
      SpiDisableDemReportErrorStatus = 0
      SpiEnableDmaFastTransferSupport = 0
      SpiEnableHWUnitAsyncMode = 0
      SpiEnableUserModeSupport = 0
      SpiFlexioEnable = 0
      SpiHalfDuplexModeSupport = 0
      SpiJobStartNotificationEnable = 0
    SpiDriver
      SpiChannel_SBC (SpiChannel): SpiChannelId=0, SpiChannelType=EB, SpiDataWidth=16, SpiEbMaxLength=1, SpiIbNBuffers=1, SpiTransferStart=LSB
      SpiExternalDevice_0 (SpiExternalDevice):
        SpiBaudrate = 100000.0
        SpiCsContinous = TRUE
        SpiCsIdentifier = PCS3
        SpiCsPolarity = LOW
        SpiCsSelection = CS_VIA_PERIPHERAL_ENGINE
        SpiDataShiftEdge = LEADING
        SpiDeviceHalfDuplexSupport = 0
        SpiEnableCs = 1
        SpiHwUnit = CSIB0
        SpiShiftClockIdleLevel = LOW
        SpiTimeClk2Cs = 1.0E-6
        SpiTimeCs2Clk = 1.0E-6
        SpiTimeCs2Cs = 1.0E-6
      SpiJob_SBC (SpiJob): SpiJobId=0, SpiJobPriority=0, SpiDeviceAssignment=SpiExternalDevice_0
        SpiChannelList_0 (SpiChannelList): SpiChannelIndex=0, SpiChannelAssignment=SpiChannel_SBC
      SpiSequence_0 (SpiSequence): SpiEnableDmaFastTransfer=0, SpiInterruptibleSequence=0, SpiSequenceId=0, SpiJobAssignment=SpiJob_SBC
    SpiGeneral:
      SpiCancelApi = 1
      SpiChannelBuffersAllowed = 2
      SpiDevErrorDetect = 0
      SpiGlobalDmaEnable = 0
      SpiHwStatusApi = 1
      SpiInterruptibleSeqAllowed = 0
      SpiLevelDelivered = 2
      SpiMulticoreSupport = 0
      SpiSupportConcurrentSyncTransmit = 0
      SpiTimeoutMethod = OSIF_COUNTER_DUMMY
      SpiTransmitTimeout = 50000
      SpiVersionInfoApi = 0
      SpiPhyUnit_0 (SpiPhyUnit):
        SpiPhyUnitAsyncUseDma = 0
        SpiPhyUnitMapping = LPSPI_1
        SpiPhyUnitMode = SPI_MASTER
        SpiPhyUnitSync = 1
        SpiPinConfiguration = 3
        SpiSamplePoint = 0
        SpiPhyUnitClockRef = McuClockReferencePoint_LPSPI1
    SpiPublishedInformation: SpiMaxHwUnit=0
  module config PduR
    PduRGeneral: PduRDevErrorDetect=false, PduRMetaDataSupport=false, PduRVersionInfoApi=false, PduRZeroCostOperation=false
    PduRRoutingTables: PduRConfigurationId=0, PduRMaxRoutingTableCnt=1
      PduRRoutingTable
        9 x PduRRoutingPath:
          PduRRoutingPath_BCM_RLM_01
            PduRDestPdu_0 (PduRDestPdu):
              PduRDestPduDataProvision = PDUR_DIRECT
              PduRDestPduHandleId = PDUR_DESTPDU_Com_BCM_RLM_01
              PduRTransmissionConfirmation = true
              PduRDestPduRef = Com_BCM_RLM_01
            PduRSrcPdu_0 (PduRSrcPdu): PduRSourcePduHandleId=PDUR_SRCPDU_BCM_RLM_01, PduRSrcPduUpTxConf=true, PduRSrcPduRef=BCM_RLM_01
          PduRRoutingPath_BCM_RLM_02
            PduRDestPdu_0 (PduRDestPdu):
              PduRDestPduDataProvision = PDUR_DIRECT
              PduRDestPduHandleId = PDUR_DESTPDU_Com_BCM_RLM_02
              PduRTransmissionConfirmation = true
              PduRDestPduRef = Com_BCM_RLM_02
            PduRSrcPdu_0 (PduRSrcPdu): PduRSourcePduHandleId=PDUR_SRCPDU_BCM_RLM_02, PduRSrcPduUpTxConf=true, PduRSrcPduRef=BCM_RLM_02
          PduRRoutingPath_RLM_RS_BCM_01
            PduRDestPdu_0 (PduRDestPdu):
              PduRDestPduDataProvision = PDUR_DIRECT
              PduRDestPduHandleId = PDUR_DESTPDU_RLM_RS_BCM_01
              PduRTransmissionConfirmation = true
              PduRDestPduRef = RLM_RS_BCM_01
            PduRSrcPdu_0 (PduRSrcPdu): PduRSourcePduHandleId=PDUR_SRCPDU_Com_RLM_RS_BCM_01, PduRSrcPduUpTxConf=true, PduRSrcPduRef=Com_RLM_RS_BCM_01
          PduRRoutingPath_DCM_PHY
            PduRDestPdu_0 (PduRDestPdu):
              PduRDestPduDataProvision = PDUR_DIRECT
              PduRDestPduHandleId = PDUR_DESTPDU_Dcm_RLM_RS_MasterReq
              PduRTransmissionConfirmation = true
              PduRDestPduRef = Dcm_RLM_RS_MasterReq
            PduRSrcPdu: PduRSourcePduHandleId=PDUR_SRCPDU_RLM_RS_MasterReq, PduRSrcPduUpTxConf=true, PduRSrcPduRef=RLM_RS_MasterReq
          PduRRoutingPath_DCM_FUN
            PduRDestPdu_0 (PduRDestPdu):
              PduRDestPduDataProvision = PDUR_DIRECT
              PduRDestPduHandleId = PDUR_DESTPDU_Dcm_RLM_RS_MasterReq_Fun
              PduRTransmissionConfirmation = true
              PduRDestPduRef = Dcm_RLM_RS_MasterReq_Fun
            PduRSrcPdu: PduRSourcePduHandleId=PDUR_SRCPDU_RLM_RS_MasterReq_Fun, PduRSrcPduUpTxConf=true, PduRSrcPduRef=RLM_RS_MasterReq_Fun
          PduRRoutingPath_DCM_RESP
            PduRDestPdu_0 (PduRDestPdu):
              PduRDestPduDataProvision = PDUR_DIRECT
              PduRDestPduHandleId = PDUR_DESTPDU_RLM_RS_SlaveResp
              PduRTransmissionConfirmation = true
              PduRDestPduRef = RLM_RS_SlaveResp
            PduRSrcPdu: PduRSourcePduHandleId=PDUR_SRCPDU_Dcm_RLM_RS_SlaveResp, PduRSrcPduUpTxConf=true, PduRSrcPduRef=Dcm_RLM_RS_SlaveResp
          PduRRoutingPath_HcmlZcud_Lin2Fr01
            PduRDestPdu_0 (PduRDestPdu):
              PduRDestPduDataProvision = PDUR_DIRECT
              PduRDestPduHandleId = PDUR_DESTPDU_HcmlZcud_Lin2Fr01
              PduRTransmissionConfirmation = true
              PduRDestPduRef = HcmlZcud_Lin2Fr01
            PduRSrcPdu_0 (PduRSrcPdu): PduRSourcePduHandleId=PDUR_SRCPDU_Com_HcmlZcud_Lin2Fr01, PduRSrcPduUpTxConf=true, PduRSrcPduRef=Com_HcmlZcud_Lin2Fr01
          PduRRoutingPath_ZcudZcud_Lin2Fr01
            PduRDestPdu_0 (PduRDestPdu):
              PduRDestPduDataProvision = PDUR_DIRECT
              PduRDestPduHandleId = PDUR_DESTPDU_Com_ZcudZcud_Lin2Fr01
              PduRTransmissionConfirmation = true
              PduRDestPduRef = Com_ZcudZcud_Lin2Fr01
            PduRSrcPdu_0 (PduRSrcPdu): PduRSourcePduHandleId=PDUR_SRCPDU_ZcudZcud_Lin2Fr01, PduRSrcPduUpTxConf=true, PduRSrcPduRef=ZcudZcud_Lin2Fr01
          PduRRoutingPath_ZcudZcud_Lin2Fr02
            PduRDestPdu_0 (PduRDestPdu):
              PduRDestPduDataProvision = PDUR_DIRECT
              PduRDestPduHandleId = PDUR_DESTPDU_Com_ZcudZcud_Lin2Fr02
              PduRTransmissionConfirmation = true
              PduRDestPduRef = Com_ZcudZcud_Lin2Fr02
            PduRSrcPdu_0 (PduRSrcPdu): PduRSourcePduHandleId=PDUR_SRCPDU_ZcudZcud_Lin2Fr02, PduRSrcPduUpTxConf=true, PduRSrcPduRef=ZcudZcud_Lin2Fr02
    3 x PduRBswModules, all with PduRCancelReceive=false, PduRCancelTransmit=false, PduRChangeParameterApi=false, PduRCommunicationInterface=true, PduRTxConfirmation=true, PduRUseTag=true:
      PduRBswModules_COM: PduRLowerModule=false, PduRRetransmission=true, PduRTransportProtocol=true, PduRTriggertransmit=true, PduRUpperModule=true, PduRBswModuleRef=Com
      PduRBswModules_LINIF: PduRLowerModule=true, PduRRetransmission=false, PduRTransportProtocol=false, PduRTriggertransmit=true, PduRUpperModule=false, PduRBswModuleRef=LinIf
      PduRBswModules_DCM: PduRLowerModule=true, PduRRetransmission=false, PduRTransportProtocol=false, PduRTriggertransmit=false, PduRUpperModule=false, PduRBswModuleRef=Dcm
  module config Lin: implementation-config-variant=VARIANT-POST-BUILD
    AutosarExt: LinDisableDemReportErrorStatus=0, LinEnableUserModeSupport=0, LinFrameTimeoutDisable=1
    CommonPublishedInformation:
      ArReleaseMajorVersion = 4
      ArReleaseMinorVersion = 4
      ArReleaseRevisionVersion = 0
      ModuleId = 82
      SwMajorVersion = 1
      SwMinorVersion = 0
      SwPatchVersion = 0
      VendorId = 43
    LinGeneral: LinDevErrorDetect=0, LinIndex=0, LinMulticoreSupport=0, LinTimeoutDuration=1000, LinTimeoutMethod=OSIF_COUNTER_DUMMY, LinVersionInfoApi=0
    LinGlobalConfig
      LinChannel_0 (LinChannel):
        BreakLength = BL_13
        DetectedBreakLength = BL_11
        LinChannelBaudRate = 19200
        LinChannelId = 0
        LinChannelWakeupSupport = 0
        LinHeaderTimeout = 44
        LinHwChannel = LPUART_IP_1
        LinNodeType = SLAVE
        LinResponseTimeout = 14
        LinClockRef = McuClockReferencePoint_Lin
  module config BswM
    BswMGeneral:
      BswMCanSMEnabled = false
      BswMCanSMIcomEnabled = false
      BswMComMEnabled = true
      BswMDcmEnabled = true
      BswMDevErrorDetect = false
      BswMEcuMEnabled = true
      BswMEthSMEnabled = false
      BswMFrSMEnabled = false
      BswMGenericRequestEnabled = true
      BswMJ1939DcmEnabled = false
      BswMJ1939NmEnabled = false
      BswMLinSMEnabled = true
      BswMLinTPEnabled = false
      BswMNvMEnabled = false
      BswMSchMEnabled = false
      BswMSdEnabled = false
      BswMVersionInfoApi = true
      BswMWdgMEnabled = false
      BswMMainFunctionPeriod = 0.02
    BswMConfig: BswMPartitionRef=EcucPartition_0
      BswMArbitration
        ReqPort_LIN_VOLTAGE (BswMModeRequestPort): BswMRequestProcessing=BSWM_IMMEDIATE
          BswMModeRequestSource
            BswMGenericRequest: BswMModeRequesterId=241, BswMRequestedModeMax=3
          BswMModeInitValue: BswMBswModeInitValue=0xFF
        ReqPort_DTC_VOLTAGE (BswMModeRequestPort): BswMRequestProcessing=BSWM_IMMEDIATE
          BswMModeRequestSource
            BswMGenericRequest: BswMModeRequesterId=242, BswMRequestedModeMax=3
          BswMModeInitValue: BswMBswModeInitValue=0xFF
        6 x BswMModeCondition, all with BswMConditionType=BSWM_EQUALS:
          Cond_LIN_VOLTAGE_NORMAL: BswMConditionMode=ReqPort_LIN_VOLTAGE
            BswMConditionValue
              BswMBswMode: BswMBswRequestedMode=LIN_VOLTAGE_NORMAL
          Cond_LIN_VOLTAGE_L_7_500: BswMConditionMode=ReqPort_LIN_VOLTAGE
            BswMConditionValue
              BswMBswMode: BswMBswRequestedMode=LIN_VOLTAGE_L_7_500
          Cond_LIN_VOLTAGE_H_16_5_500: BswMConditionMode=ReqPort_LIN_VOLTAGE
            BswMConditionValue
              BswMBswMode: BswMBswRequestedMode=LIN_VOLTAGE_H_16_5_500
          Cond_DTC_VOLTAGE_NORMAL: BswMConditionMode=ReqPort_DTC_VOLTAGE
            BswMConditionValue
              BswMBswMode: BswMBswRequestedMode=DTC_VOLTAGE_NORMAL
          Cond_DTC_VOLTAGE_L_8_5_500: BswMConditionMode=ReqPort_DTC_VOLTAGE
            BswMConditionValue
              BswMBswMode: BswMBswRequestedMode=DTC_VOLTAGE_L_8_5_500
          Cond_DTC_VOLTAGE_H_18_500: BswMConditionMode=ReqPort_DTC_VOLTAGE
            BswMConditionValue
              BswMBswMode: BswMBswRequestedMode=DTC_VOLTAGE_H_18_500
        6 x BswMLogicalExpression, all with BswMLogicalOperator=BSWM_AND:
          LE_LIN_VOLTAGE_NORMAL: BswMArgumentRef=Cond_LIN_VOLTAGE_NORMAL
          LE_LIN_VOLTAGE_L_7_500: BswMArgumentRef=Cond_LIN_VOLTAGE_L_7_500
          LE_LIN_VOLTAGE_H_16_5_500: BswMArgumentRef=Cond_LIN_VOLTAGE_H_16_5_500
          LE_DTC_VOLTAGE_NORMAL: BswMArgumentRef=Cond_DTC_VOLTAGE_NORMAL
          LE_DTC_VOLTAGE_L_8_5_500: BswMArgumentRef=Cond_DTC_VOLTAGE_L_8_5_500
          LE_DTC_VOLTAGE_H_18_500: BswMArgumentRef=Cond_DTC_VOLTAGE_H_18_500
        ReqPort_LinSm_Channel_Lin (BswMModeRequestPort): BswMRequestProcessing=BSWM_IMMEDIATE
          BswMModeRequestSource
            BswMLinSMIndication: BswMLinSMChannelRef=ComMChannel_RLM_RS
          BswMModeInitValue: BswMBswModeInitValue=LINSM_NO_COM
        LE_NO_COM_Channel_Lin (BswMLogicalExpression): BswMLogicalOperator=BSWM_AND, BswMArgumentRef=Cond_LinSMIndication_EQ_COMM_NO_COMMUNICATION
        LE_FULL_COM_Channel_Lin (BswMLogicalExpression): BswMLogicalOperator=BSWM_AND, BswMArgumentRef=Cond_LinSMIndication_EQ_COMM_FULL_COMMUNICATION
        3 x BswMModeRequestPort:
          ReqPort_EcuM_ReqPostRun: BswMRequestProcessing=BSWM_DEFERRED
            BswMModeRequestSource
              BswMEcuMRUNRequestIndication: BswMEcuMRUNRequestProtocolPort=POST_RUN
            BswMModeInitValue: BswMBswModeInitValue=ECUM_RUNSTATUS_UNKNOWN
          ReqPort_EcuM_ReqRun: BswMRequestProcessing=BSWM_IMMEDIATE
            BswMModeRequestSource
              BswMEcuMRUNRequestIndication: BswMEcuMRUNRequestProtocolPort=RUN
            BswMModeInitValue: BswMBswModeInitValue=ECUM_RUNSTATUS_UNKNOWN
          ReqPort_EcuM_ReqShutdown: BswMRequestProcessing=BSWM_DEFERRED
            BswMModeRequestSource
              BswMEcuMRUNRequestIndication: BswMEcuMRUNRequestProtocolPort=SHUTDOWN
            BswMModeInitValue: BswMBswModeInitValue=ECUM_RUNSTATUS_UNKNOWN
        5 x BswMModeCondition, all with BswMConditionType=BSWM_EQUALS:
          Cond_EcuMWakeupIndication_EcuMRequstPostRun_EQ_ECUM_RUNSTATUS_REQUESTED: BswMConditionMode=ReqPort_EcuM_ReqPostRun
            BswMConditionValue
              BswMBswMode: BswMBswRequestedMode=ECUM_RUNSTATUS_REQUESTED
          Cond_EcuMWakeupIndication_EcuMRequstPostRun_EQ_ECUM_RUNSTATUS_RELEASED: BswMConditionMode=ReqPort_EcuM_ReqPostRun
            BswMConditionValue
              BswMBswMode: BswMBswRequestedMode=ECUM_RUNSTATUS_RELEASED
          Cond_EcuMWakeupIndication_EcuMRequstRun_EQ_ECUM_RUNSTATUS_REQUESTED: BswMConditionMode=ReqPort_EcuM_ReqRun
            BswMConditionValue
              BswMBswMode: BswMBswRequestedMode=ECUM_RUNSTATUS_REQUESTED
          Cond_EcuMWakeupIndication_EcuMRequstRun_EQ_ECUM_RUNSTATUS_RELEASED: BswMConditionMode=ReqPort_EcuM_ReqRun
            BswMConditionValue
              BswMBswMode: BswMBswRequestedMode=ECUM_RUNSTATUS_RELEASED
          Cond_EcuMWakeupIndication_EcuMRequstShutDown_EQ_ECUM_RUNSTATUS_RELEASED: BswMConditionMode=ReqPort_EcuM_ReqShutdown
            BswMConditionValue
              BswMBswMode: BswMBswRequestedMode=ECUM_RUNSTATUS_RELEASED
        4 x BswMLogicalExpression, all with BswMLogicalOperator=BSWM_AND:
          LE_EcuM_RequestStatus_RUN_REQUEST: BswMArgumentRef=Cond_EcuMWakeupIndication_EcuMRequstRun_EQ_ECUM_RUNSTATUS_REQUESTED
          LE_EcuM_RequestStatus_RUN_RELEASE: BswMArgumentRef=Cond_EcuMWakeupIndication_EcuMRequstRun_EQ_ECUM_RUNSTATUS_RELEASED
          LE_EcuM_RequestStatus_POSTRUN_RELEASE: BswMArgumentRef=Cond_EcuMWakeupIndication_EcuMRequstPostRun_EQ_ECUM_RUNSTATUS_RELEASED
          LE_EcuM_RequestStatus_SHUTDOWN_RELEASE: BswMArgumentRef=Cond_EcuMWakeupIndication_EcuMRequstShutDown_EQ_ECUM_RUNSTATUS_RELEASED, BswMArgumentRef=Cond_EcuMWakeupIndication_EcuMRequstPostRun_EQ_ECUM_RUNSTATUS_RELEASED, BswMArgumentRef=Cond_EcuMWakeupIndication_EcuMRequstRun_EQ_ECUM_RUNSTATUS_RELEASED
        ReqPort_ComM_Ch_Channel_Lin (BswMModeRequestPort): BswMRequestProcessing=BSWM_DEFERRED
          BswMModeRequestSource
            BswMComMIndication: BswMComMChannelRef=ComMChannel_RLM_RS
          BswMModeInitValue: BswMBswModeInitValue=COMM_NO_COMMUNICATION
        ReqPort_ComM_InitRest (BswMModeRequestPort): BswMRequestProcessing=BSWM_DEFERRED
          BswMModeRequestSource
            BswMComMInitiateReset
          BswMModeInitValue: BswMBswModeInitValue=FALSE
        Cond_LinSMIndication_EQ_COMM_NO_COMMUNICATION (BswMModeCondition): BswMConditionType=BSWM_EQUALS, BswMConditionMode=ReqPort_LinSm_Channel_Lin
          BswMConditionValue
            BswMBswMode: BswMBswRequestedMode=LINSM_NO_COM
        ReqPort_Dcm_Channel_Lin (BswMModeRequestPort): BswMRequestProcessing=BSWM_IMMEDIATE
          BswMModeRequestSource
            BswMDcmComModeRequest: BswMDcmComMChannelRef=ComMChannel_RLM_RS
          BswMModeInitValue: BswMBswModeInitValue=DCM_ENABLE_RX_TX_NORM_NM
        ReqPort_Dcm_AppUpdate (BswMModeRequestPort): BswMRequestProcessing=BSWM_IMMEDIATE
          BswMModeRequestSource
            BswMDcmApplicationUpdatedIndication
          BswMModeInitValue: BswMBswModeInitValue=FALSE
        12 x BswMModeCondition, all with BswMConditionType=BSWM_EQUALS, BswMConditionMode=ReqPort_Dcm_Channel_Lin:
          Cond_DcmIndication_Channel_Lin_EQ_DCM_ENABLE_RX_TX_NORM
            BswMConditionValue
              BswMBswMode: BswMBswRequestedMode=DCM_ENABLE_RX_TX_NORM
          Cond_DcmIndication_Channel_Lin_EQ_DCM_ENABLE_RX_DISABLE_TX_NORM
            BswMConditionValue
              BswMBswMode: BswMBswRequestedMode=DCM_ENABLE_RX_DISABLE_TX_NORM
          Cond_DcmIndication_Channel_Lin_EQ_DCM_DISABLE_RX_ENABLE_TX_NORM
            BswMConditionValue
              BswMBswMode: BswMBswRequestedMode=DCM_DISABLE_RX_ENABLE_TX_NORM
          Cond_DcmIndication_Channel_Lin_EQ_DCM_DISABLE_RX_TX_NORMAL
            BswMConditionValue
              BswMBswMode: BswMBswRequestedMode=DCM_DISABLE_RX_TX_NORMAL
          Cond_DcmIndication_Channel_Lin_EQ_DCM_ENABLE_RX_TX_NM
            BswMConditionValue
              BswMBswMode: BswMBswRequestedMode=DCM_ENABLE_RX_TX_NM
          Cond_DcmIndication_Channel_Lin_EQ_DCM_ENABLE_RX_DISABLE_TX_NM
            BswMConditionValue
              BswMBswMode: BswMBswRequestedMode=DCM_ENABLE_RX_DISABLE_TX_NM
          Cond_DcmIndication_Channel_Lin_EQ_DCM_DISABLE_RX_ENABLE_TX_NM
            BswMConditionValue
              BswMBswMode: BswMBswRequestedMode=DCM_DISABLE_RX_ENABLE_TX_NM
          Cond_DcmIndication_Channel_Lin_EQ_DCM_DISABLE_RX_TX_NM
            BswMConditionValue
              BswMBswMode: BswMBswRequestedMode=DCM_DISABLE_RX_TX_NM
          Cond_DcmIndication_Channel_Lin_EQ_DCM_ENABLE_RX_TX_NORM_NM
            BswMConditionValue
              BswMBswMode: BswMBswRequestedMode=DCM_ENABLE_RX_TX_NORM_NM
          Cond_DcmIndication_Channel_Lin_EQ_DCM_ENABLE_RX_DISABLE_TX_NORM_NM
            BswMConditionValue
              BswMBswMode: BswMBswRequestedMode=DCM_ENABLE_RX_DISABLE_TX_NORM_NM
          Cond_DcmIndication_Channel_Lin_EQ_DCM_DISABLE_RX_ENABLE_TX_NORM_NM
            BswMConditionValue
              BswMBswMode: BswMBswRequestedMode=DCM_DISABLE_RX_ENABLE_TX_NORM_NM
          Cond_DcmIndication_Channel_Lin_EQ_DCM_DISABLE_RX_TX_NORM_NM
            BswMConditionValue
              BswMBswMode: BswMBswRequestedMode=DCM_DISABLE_RX_TX_NORM_NM
        6 x BswMLogicalExpression, all with BswMLogicalOperator=BSWM_OR:
          LE_DCM_Normal_Rx_Enable_Channel_Lin: BswMArgumentRef=Cond_DcmIndication_Channel_Lin_EQ_DCM_ENABLE_RX_TX_NORM, BswMArgumentRef=Cond_DcmIndication_Channel_Lin_EQ_DCM_ENABLE_RX_DISABLE_TX_NORM, BswMArgumentRef=Cond_DcmIndication_Channel_Lin_EQ_DCM_ENABLE_RX_TX_NORM_NM, BswMArgumentRef=Cond_DcmIndication_Channel_Lin_EQ_DCM_ENABLE_RX_DISABLE_TX_NORM_NM
          LE_DCM_Normal_Rx_Disable_Channel_Lin: BswMArgumentRef=Cond_DcmIndication_Channel_Lin_EQ_DCM_DISABLE_RX_ENABLE_TX_NORM, BswMArgumentRef=Cond_DcmIndication_Channel_Lin_EQ_DCM_DISABLE_RX_TX_NORMAL, BswMArgumentRef=Cond_DcmIndication_Channel_Lin_EQ_DCM_DISABLE_RX_ENABLE_TX_NORM_NM, BswMArgumentRef=Cond_DcmIndication_Channel_Lin_EQ_DCM_DISABLE_RX_TX_NORM_NM
          LE_DCM_Normal_Tx_Enable_Channel_Lin: BswMArgumentRef=Cond_DcmIndication_Channel_Lin_EQ_DCM_ENABLE_RX_TX_NORM, BswMArgumentRef=Cond_DcmIndication_Channel_Lin_EQ_DCM_DISABLE_RX_ENABLE_TX_NORM, BswMArgumentRef=Cond_DcmIndication_Channel_Lin_EQ_DCM_ENABLE_RX_TX_NORM_NM, BswMArgumentRef=Cond_DcmIndication_Channel_Lin_EQ_DCM_DISABLE_RX_ENABLE_TX_NORM_NM
          LE_DCM_Normal_Tx_Disable_Channel_Lin: BswMArgumentRef=Cond_DcmIndication_Channel_Lin_EQ_DCM_ENABLE_RX_DISABLE_TX_NORM, BswMArgumentRef=Cond_DcmIndication_Channel_Lin_EQ_DCM_DISABLE_RX_TX_NORMAL, BswMArgumentRef=Cond_DcmIndication_Channel_Lin_EQ_DCM_ENABLE_RX_DISABLE_TX_NORM_NM, BswMArgumentRef=Cond_DcmIndication_Channel_Lin_EQ_DCM_DISABLE_RX_TX_NORM_NM
          LE_DCM_NmCtrol_Enable_Channel_Lin: BswMArgumentRef=Cond_DcmIndication_Channel_Lin_EQ_DCM_ENABLE_RX_TX_NM, BswMArgumentRef=Cond_DcmIndication_Channel_Lin_EQ_DCM_DISABLE_RX_ENABLE_TX_NM, BswMArgumentRef=Cond_DcmIndication_Channel_Lin_EQ_DCM_ENABLE_RX_TX_NORM_NM, BswMArgumentRef=Cond_DcmIndication_Channel_Lin_EQ_DCM_DISABLE_RX_ENABLE_TX_NORM_NM
          LE_DCM_NmCtrol_Disable_Channel_Lin: BswMArgumentRef=Cond_DcmIndication_Channel_Lin_EQ_DCM_ENABLE_RX_DISABLE_TX_NM, BswMArgumentRef=Cond_DcmIndication_Channel_Lin_EQ_DCM_DISABLE_RX_TX_NM, BswMArgumentRef=Cond_DcmIndication_Channel_Lin_EQ_DCM_ENABLE_RX_DISABLE_TX_NORM_NM, BswMArgumentRef=Cond_DcmIndication_Channel_Lin_EQ_DCM_DISABLE_RX_TX_NORM_NM
        18 x BswMRule, all with BswMNestedExecutionOnly=false:
          Rule_LIN_VOLTAGE_NORMAL: BswMRuleId=0, BswMRuleInitState=BSWM_FALSE, BswMRuleExpressionRef=LE_LIN_VOLTAGE_NORMAL, BswMRuleTrueActionList=AL_LIN_VOLTAGE_NORMAL
          Rule_LIN_VOLTAGE_L_7_500: BswMRuleId=1, BswMRuleInitState=BSWM_FALSE, BswMRuleExpressionRef=LE_LIN_VOLTAGE_L_7_500, BswMRuleTrueActionList=AL_LIN_VOLTAGE_L_7_500
          Rule_LIN_VOLTAGE_H_16_5_500: BswMRuleId=2, BswMRuleInitState=BSWM_FALSE, BswMRuleExpressionRef=LE_LIN_VOLTAGE_H_16_5_500, BswMRuleTrueActionList=AL_LIN_VOLTAGE_H_16_5_500
          Rule_DTC_VOLTAGE_NORMAL: BswMRuleId=3, BswMRuleInitState=BSWM_FALSE, BswMRuleExpressionRef=LE_DTC_VOLTAGE_NORMAL, BswMRuleTrueActionList=AL_DTC_VOLTAGE_NORMAL
          Rule_DTC_VOLTAGE_L_8_5_500: BswMRuleId=4, BswMRuleInitState=BSWM_FALSE, BswMRuleExpressionRef=LE_DTC_VOLTAGE_L_8_5_500, BswMRuleTrueActionList=AL_DTC_VOLTAGE_L_8_5_500
          Rule_DTC_VOLTAGE_H_18_500: BswMRuleId=5, BswMRuleInitState=BSWM_FALSE, BswMRuleExpressionRef=LE_DTC_VOLTAGE_H_18_500, BswMRuleTrueActionList=AL_DTC_VOLTAGE_H_18_500
          Rule_EcuM_RequestStatus_RUN_REQUEST: BswMRuleId=6, BswMRuleInitState=BSWM_FALSE, BswMRuleExpressionRef=LE_EcuM_RequestStatus_RUN_REQUEST, BswMRuleTrueActionList=AL_EcuM_RequestStatus_RUN_REQUEST
          Rule_EcuM_RequestStatus_RUN_RELEASE: BswMRuleId=7, BswMRuleInitState=BSWM_FALSE, BswMRuleExpressionRef=LE_EcuM_RequestStatus_RUN_RELEASE, BswMRuleTrueActionList=AL_EcuM_RequestStatus_RUN_RELEASE
          Rule_EcuM_RequestStatus_POSTRUN_RELEASE: BswMRuleId=8, BswMRuleInitState=BSWM_FALSE, BswMRuleExpressionRef=LE_EcuM_RequestStatus_POSTRUN_RELEASE, BswMRuleTrueActionList=AL_EcuM_RequestStatus_POSTRUN_RELEASE
          Rule_EcuM_RequestStatus_SHUTDOWN_RELEASE: BswMRuleId=9, BswMRuleInitState=BSWM_FALSE, BswMRuleExpressionRef=LE_EcuM_RequestStatus_SHUTDOWN_RELEASE, BswMRuleTrueActionList=AL_EcuM_RequestStatus_SHUTDOWN_RELEASE
          Rule_NO_COM_Channel_Lin: BswMRuleId=10, BswMRuleInitState=BSWM_FALSE, BswMRuleExpressionRef=LE_NO_COM_Channel_Lin, BswMRuleTrueActionList=AL_NO_COM_Channel_Lin
          Rule_FULL_COM_Channel_Lin: BswMRuleId=11, BswMRuleInitState=BSWM_FALSE, BswMRuleExpressionRef=LE_FULL_COM_Channel_Lin, BswMRuleTrueActionList=AL_FULL_COM_Channel_Lin
          Rule_DCM_Normal_Rx_Enable_Channel_Lin: BswMRuleId=12, BswMRuleInitState=BSWM_TRUE, BswMRuleExpressionRef=LE_DCM_Normal_Rx_Enable_Channel_Lin, BswMRuleTrueActionList=AL_DCM_Normal_Rx_Enable_Channel_Lin
          Rule_DCM_Normal_Rx_Disable_Channel_Lin: BswMRuleId=13, BswMRuleInitState=BSWM_TRUE, BswMRuleExpressionRef=LE_DCM_Normal_Rx_Disable_Channel_Lin, BswMRuleTrueActionList=AL_DCM_Normal_Rx_Disable_Channel_Lin
          Rule_DCM_Normal_Tx_Enable_Channel_Lin: BswMRuleId=14, BswMRuleInitState=BSWM_TRUE, BswMRuleExpressionRef=LE_DCM_Normal_Tx_Enable_Channel_Lin, BswMRuleTrueActionList=AL_DCM_Normal_Tx_Enable_Channel_Lin
          Rule_DCM_Normal_Tx_Disable_Channel_Lin: BswMRuleId=15, BswMRuleInitState=BSWM_TRUE, BswMRuleExpressionRef=LE_DCM_Normal_Tx_Disable_Channel_Lin, BswMRuleTrueActionList=AL_DCM_Normal_Tx_Disable_Channel_Lin
          Rule_DCM_Nm_Tx_Enable_Channel_Lin: BswMRuleId=16, BswMRuleInitState=BSWM_TRUE, BswMRuleExpressionRef=LE_DCM_NmCtrol_Enable_Channel_Lin, BswMRuleTrueActionList=AL_DCM_NmCtrol_Enable_Channel_Lin
          Rule_DCM_Nm_Tx_Disable_Channel_Lin: BswMRuleId=17, BswMRuleInitState=BSWM_TRUE, BswMRuleExpressionRef=LE_DCM_NmCtrol_Disable_Channel_Lin, BswMRuleTrueActionList=AL_DCM_NmCtrol_Disable_Channel_Lin
        Cond_LinSMIndication_EQ_COMM_FULL_COMMUNICATION (BswMModeCondition): BswMConditionType=BSWM_EQUALS, BswMConditionMode=ReqPort_LinSm_Channel_Lin
          BswMConditionValue
            BswMBswMode: BswMBswRequestedMode=LINSM_FULL_COM
      BswMModeControl
        11 x BswMAction:
          Action_CAN_VOLTAGE_NORMAL
            BswMAvailableActions
              BswMUserCallout: BswMUserCalloutFunction=GenericRequest_CanVoltage_Normal
          Action_CAN_VOLTAGE_L_6_5
            BswMAvailableActions
              BswMUserCallout: BswMUserCalloutFunction=GenericRequest_CanVoltage_L65
          Action_CAN_VOLTAGE_L_6_5_500
            BswMAvailableActions
              BswMUserCallout: BswMUserCalloutFunction=GenericRequest_CanVoltage_L65_500
          Action_CAN_VOLTAGE_H_18
            BswMAvailableActions
              BswMUserCallout: BswMUserCalloutFunction=GenericRequest_CanVoltage_H18
          Action_CAN_VOLTAGE_H_18_500
            BswMAvailableActions
              BswMUserCallout: BswMUserCalloutFunction=GenericRequest_CanVoltage_H18_500
          Action_LIN_VOLTAGE_NORMAL
            BswMAvailableActions
              BswMUserCallout: BswMUserCalloutFunction=GenericRequest_LinVoltage_Normal
          Action_LIN_VOLTAGE_L_7_500
            BswMAvailableActions
              BswMUserCallout: BswMUserCalloutFunction=GenericRequest_LinVoltage_L7_500
          Action_LIN_VOLTAGE_H_16_5_500
            BswMAvailableActions
              BswMUserCallout: BswMUserCalloutFunction=GenericRequest_LinVoltage_H165_500
          Action_DTC_VOLTAGE_NORMAL
            BswMAvailableActions
              BswMUserCallout: BswMUserCalloutFunction=GenericRequest_DtcVoltage_Normal
          Action_DTC_VOLTAGE_L_8_5_500
            BswMAvailableActions
              BswMUserCallout: BswMUserCalloutFunction=GenericRequest_DtcVoltage_L85_500
          Action_DTC_VOLTAGE_H_18_500
            BswMAvailableActions
              BswMUserCallout: BswMUserCalloutFunction=GenericRequest_DtcVoltage_H18_500
        11 x BswMActionList, all with BswMActionListExecution=BSWM_TRIGGER:
          AL_CAN_VOLTAGE_NORMAL
            Item_Action_CAN_VOLTAGE_NORMAL (BswMActionListItem): BswMAbortOnFail=false, BswMActionListItemIndex=0, BswMActionListItemRef=Action_CAN_VOLTAGE_NORMAL
          AL_CAN_VOLTAGE_L_6_5
            Item_Action_CAN_VOLTAGE_L_6_5 (BswMActionListItem): BswMAbortOnFail=false, BswMActionListItemIndex=0, BswMActionListItemRef=Action_CAN_VOLTAGE_L_6_5
          AL_CAN_VOLTAGE_L_6_5_500
            Item_Action_CAN_VOLTAGE_L_6_5_500 (BswMActionListItem): BswMAbortOnFail=false, BswMActionListItemIndex=0, BswMActionListItemRef=Action_CAN_VOLTAGE_L_6_5_500
          AL_CAN_VOLTAGE_H_18
            Item_Action_CAN_VOLTAGE_H_18 (BswMActionListItem): BswMAbortOnFail=false, BswMActionListItemIndex=0, BswMActionListItemRef=Action_CAN_VOLTAGE_H_18
          AL_CAN_VOLTAGE_H_18_500
            Item_Action_CAN_VOLTAGE_H_18_500 (BswMActionListItem): BswMAbortOnFail=false, BswMActionListItemIndex=0, BswMActionListItemRef=Action_CAN_VOLTAGE_H_18_500
          AL_LIN_VOLTAGE_NORMAL
            Item_Action_LIN_VOLTAGE_NORMAL (BswMActionListItem): BswMAbortOnFail=false, BswMActionListItemIndex=0, BswMActionListItemRef=Action_LIN_VOLTAGE_NORMAL
          AL_LIN_VOLTAGE_L_7_500
            Item_Action_LIN_VOLTAGE_L_7_500 (BswMActionListItem): BswMAbortOnFail=false, BswMActionListItemIndex=0, BswMActionListItemRef=Action_LIN_VOLTAGE_L_7_500
          AL_LIN_VOLTAGE_H_16_5_500
            Item_Action_LIN_VOLTAGE_H_16_5_500 (BswMActionListItem): BswMAbortOnFail=false, BswMActionListItemIndex=0, BswMActionListItemRef=Action_LIN_VOLTAGE_H_16_5_500
          AL_DTC_VOLTAGE_NORMAL
            Item_Action_DTC_VOLTAGE_NORMAL (BswMActionListItem): BswMAbortOnFail=false, BswMActionListItemIndex=0, BswMActionListItemRef=Action_DTC_VOLTAGE_NORMAL
          AL_DTC_VOLTAGE_L_8_5_500
            Item_Action_DTC_VOLTAGE_L_8_5_500 (BswMActionListItem): BswMAbortOnFail=false, BswMActionListItemIndex=0, BswMActionListItemRef=Action_DTC_VOLTAGE_L_8_5_500
          AL_DTC_VOLTAGE_H_18_500
            Item_Action_DTC_VOLTAGE_H_18_500 (BswMActionListItem): BswMAbortOnFail=false, BswMActionListItemIndex=0, BswMActionListItemRef=Action_DTC_VOLTAGE_H_18_500
        7 x BswMAction:
          Action_NvM_WriteAll
            BswMAvailableActions
              BswMUserCallout: BswMUserCalloutFunction=NvM_Action_WriteAll
          Action_EcuM_SetStatus_RUN
            BswMAvailableActions
              BswMEcuMStateSwitch: BswMEcuMState=RUN
          Action_EcuM_SetStatus_POST_RUN
            BswMAvailableActions
              BswMEcuMStateSwitch: BswMEcuMState=POST_RUN
          Action_EcuM_SetStatus_SHUTDOWN
            BswMAvailableActions
              BswMEcuMStateSwitch: BswMEcuMState=SHUTDOWN
          Action_EcuM_GoDown
            BswMAvailableActions
              BswMEcuMGoDown: BswMEcuMUserIdRef=EcuMFlexUserConfig_0
          Action_EcuM_RequestRun
            BswMAvailableActions
              BswMUserCallout: BswMUserCalloutFunction=BswM_EcuM_RequestRun
          Action_EcuM_ReleaseRun
            BswMAvailableActions
              BswMUserCallout: BswMUserCalloutFunction=BswM_EcuM_ReleaseRun
        4 x BswMActionList, all with BswMActionListExecution=BSWM_CONDITION:
          AL_EcuM_RequestStatus_RUN_REQUEST
            Item_Action_EcuM_Request_RUN (BswMActionListItem): BswMAbortOnFail=false, BswMActionListItemIndex=0, BswMActionListItemRef=Action_EcuM_RequestRun
          AL_EcuM_RequestStatus_RUN_RELEASE
            Item_Action_EcuM_SetStatus_POST_RUN (BswMActionListItem): BswMAbortOnFail=false, BswMActionListItemIndex=0, BswMActionListItemRef=Action_EcuM_SetStatus_POST_RUN
          AL_EcuM_RequestStatus_POSTRUN_RELEASE
            Item_Action_EcuM_SetStatus_POST_RUN (BswMActionListItem): BswMAbortOnFail=false, BswMActionListItemIndex=0, BswMActionListItemRef=Action_EcuM_SetStatus_POST_RUN
          AL_EcuM_RequestStatus_SHUTDOWN_RELEASE
            Item_Action_EcuM_SetStatus_SHUTDOWN (BswMActionListItem): BswMAbortOnFail=false, BswMActionListItemIndex=0, BswMActionListItemRef=Action_EcuM_SetStatus_SHUTDOWN
            Item_Action_EcuM_GoDown (BswMActionListItem): BswMAbortOnFail=false, BswMActionListItemIndex=1, BswMActionListItemRef=Action_EcuM_GoDown
        4 x BswMAction:
          Action_ComMAllow_Channel_Lin
            BswMAvailableActions
              BswMComMAllowCom: BswMComAllowed=true, BswMComMAllowChannelRef=ComMChannel_RLM_RS
          Action_ComMDisAllowCom_Channel_Lin
            BswMAvailableActions
              BswMComMAllowCom: BswMComAllowed=false, BswMComMAllowChannelRef=ComMChannel_RLM_RS
          Action_NO_COM_Channel_Lin
            BswMAvailableActions
              BswMUserCallout: BswMUserCalloutFunction=NO_COM_Channel_Lin
          Action_FULL_COM_Channel_Lin
            BswMAvailableActions
              BswMUserCallout: BswMUserCalloutFunction=FULL_COM_Channel_Lin
        3 x BswMActionList, all with BswMActionListExecution=BSWM_TRIGGER:
          AL_NO_COM_Channel_Lin
            Item_Action_NO_COM_Channel_FlexCan_A (BswMActionListItem): BswMAbortOnFail=false, BswMActionListItemIndex=0, BswMActionListItemRef=Action_NO_COM_Channel_Lin
          AL_FULL_COM_Channel_Lin
            Item_Action_FULL_COM_Channel_FlexCan_A (BswMActionListItem): BswMAbortOnFail=false, BswMActionListItemIndex=0, BswMActionListItemRef=Action_FULL_COM_Channel_Lin
          AL_ComM_AllChanel_NO_COM
            Item_Action_EcuM_ReleaseRun (BswMActionListItem): BswMAbortOnFail=false, BswMActionListItemIndex=0, BswMActionListItemRef=Action_EcuM_ReleaseRun
            Item_Action_NvM_WriteAll (BswMActionListItem): BswMAbortOnFail=false, BswMActionListItemIndex=1, BswMActionListItemRef=Action_NvM_WriteAll
        6 x BswMAction:
          Action_DCM_RxEnableGroupSwitch_Channel_Lin
            BswMAvailableActions
              BswMUserCallout: BswMUserCalloutFunction=RxEnableGroupSwitch_Channel_Lin
          Action_DCM_RxDisabledGroupSwitch_Channel_Lin
            BswMAvailableActions
              BswMUserCallout: BswMUserCalloutFunction=RxDisabledGroupSwitch_Channel_Lin
          Action_DCM_TxEnableGroupSwitch_Channel_Lin
            BswMAvailableActions
              BswMUserCallout: BswMUserCalloutFunction=TxEnableGroupSwitch_Channel_Lin
          Action_DCM_TxDisabledGroupSwitch_Channel_Lin
            BswMAvailableActions
              BswMUserCallout: BswMUserCalloutFunction=TxDisabledGroupSwitch_Channel_Lin
          Action_DCM_NmCtrol_Enable_Channel_Lin
            BswMAvailableActions
              BswMUserCallout: BswMUserCalloutFunction=DCM_NmCtrol_Enable_Channel_Lin
          Action_DCM_NmCtrol_Disable_Channel_Lin
            BswMAvailableActions
              BswMUserCallout: BswMUserCalloutFunction=DCM_NmCtrol_Disable_Channel_Lin
        6 x BswMActionList, all with BswMActionListExecution=BSWM_TRIGGER:
          AL_DCM_Normal_Rx_Enable_Channel_Lin
            Item_Action_DCM_RxEnableGroupSwitch_Channel_FlexCan_A (BswMActionListItem): BswMAbortOnFail=false, BswMActionListItemIndex=0, BswMActionListItemRef=Action_DCM_RxEnableGroupSwitch_Channel_Lin
          AL_DCM_Normal_Rx_Disable_Channel_Lin
            Item_Action_DCM_RxDisabledGroupSwitch_Channel_FlexCan_A (BswMActionListItem): BswMAbortOnFail=false, BswMActionListItemIndex=0, BswMActionListItemRef=Action_DCM_RxDisabledGroupSwitch_Channel_Lin
          AL_DCM_Normal_Tx_Enable_Channel_Lin
            Item_Action_DCM_TxEnableGroupSwitch_Channel_FlexCan_A (BswMActionListItem): BswMAbortOnFail=false, BswMActionListItemIndex=0, BswMActionListItemRef=Action_DCM_TxEnableGroupSwitch_Channel_Lin
          AL_DCM_Normal_Tx_Disable_Channel_Lin
            Item_Action_DCM_TxDisabledGroupSwitch_Channel_FlexCan_A (BswMActionListItem): BswMAbortOnFail=false, BswMActionListItemIndex=0, BswMActionListItemRef=Action_DCM_TxDisabledGroupSwitch_Channel_Lin
          AL_DCM_NmCtrol_Enable_Channel_Lin
            Item_Action_DCM_NmCtrol_Enable_Channel_FlexCan_A (BswMActionListItem): BswMAbortOnFail=false, BswMActionListItemIndex=0, BswMActionListItemRef=Action_DCM_NmCtrol_Enable_Channel_Lin
          AL_DCM_NmCtrol_Disable_Channel_Lin
            Item_Action_DCM_NmCtrol_Disable_Channel_FlexCan_A (BswMActionListItem): BswMAbortOnFail=false, BswMActionListItemIndex=0, BswMActionListItemRef=Action_DCM_NmCtrol_Disable_Channel_Lin
  module config ComM
    ComMGeneral:
      ComMDevErrorDetect = false
      ComMEcuGroupClassification = 3
      ComMModeLimitationEnabled = false
      ComMPncSupport = false
      ComMResetAfterForcingNoComm = false
      ComMSynchronousWakeUp = false
      ComMTMinFullComModeDuration = 5.0
      ComMVersionInfoApi = false
      ComMWakeupInhibitionEnabled = false
    ComMConfigSet
      ComMChannel_RLM_RS (ComMChannel):
        ComMBusType = COMM_BUS_TYPE_LIN
        ComMChannelId = ComMChannel_RLM_RS
        ComMFullCommRequestNotificationEnabled = false
        ComMMainFunctionPeriod = 0.005
        ComMNoCom = false
        ComMNoWakeUpInhibitionNvmStorage = false
        ComMNoWakeup = false
        ComMNetworkManagement: ComMNmVariant=LIGHT, ComMPncNmRequest=false, ComMNmLightTimeout=10.0
        ComMUserPerChannel_0 (ComMUserPerChannel): ComMUserChannel=ComMUser_RLM_RS
      ComMUser_RLM_RS (ComMUser): ComMUserIdentifier=ComMUser_RLM_RS, ComMUserModeNotification=false
      ComMChannel_HCML (ComMChannel):
        ComMBusType = COMM_BUS_TYPE_LIN
        ComMChannelId = ComMChannel_HCML
        ComMFullCommRequestNotificationEnabled = false
        ComMMainFunctionPeriod = 0.005
        ComMNoCom = false
        ComMNoWakeUpInhibitionNvmStorage = false
        ComMNoWakeup = false
        ComMNetworkManagement: ComMNmVariant=LINSLAVE, ComMPncNmRequest=false
        ComMUserPerChannel_0 (ComMUserPerChannel): ComMUserChannel=ComMUser_HCML
      ComMUser_HCML (ComMUser): ComMUserIdentifier=ComMUser_HCML, ComMUserModeNotification=false
  module config Dem
    DemGeneral:
      DemAgingRequieresTestedCycle = true
      DemAvailabilitySupport = DEM_EVENT_AVAILABILITY
      DemClearDTCBehavior = DEM_CLRRESP_NONVOLATILE_TRIGGER
      DemClearDTCLimitation = DEM_ALL_SUPPORTED_DTCS
      DemDataElementDefaultEndianness = BIG_ENDIAN
      DemDebounceCounterBasedSupport = true
      DemDebounceTimeBasedSupport = true
      DemDevErrorDetect = false
      DemDtcStatusAvailabilityMask = 9
      DemEventCombinationSupport = DEM_EVCOMB_ONSTORAGE
      DemEventDisplacementStrategy = DEM_DISPLACEMENT_FULL
      DemEventMemoryEntryStorageTrigger = DEM_TRIGGER_ON_TEST_FAILED
      DemGeneralInterfaceSupport = false
      DemMaxNumberEventEntryPermanent = 0
      DemMaxNumberPrestoredFF = 0
      DemOBDSupport = DEM_OBD_NO_OBD_SUPPORT
      DemOccurrenceCounterProcessing = DEM_PROCESS_OCCCTR_CDTC
      DemOperationCycleStatusStorage = false
      DemPTOSupport = false
      DemResetConfirmedBitOnOverflow = true
      DemStatusBitHandlingTestFailedSinceLastClear = DEM_STATUS_BIT_NORMAL
      DemStatusBitStorageTestFailed = false
      DemSuppressionSupport = DEM_DTC_SUPPRESSION
      DemTaskTime = 0.01
      DemTriggerDcmReports = false
      DemTriggerDltReports = false
      DemTriggerFiMReports = false
      DemTriggerMonitorInitBeforeClearOk = false
      DemTypeOfDTCSupported = DEM_DTC_TRANSLATION_ISO15031_6
      DemTypeOfFreezeFrameRecordNumeration = DEM_FF_RECNUM_CONFIGURED
      DemVersionInfoApi = false
      DemEnvironmentDataCapture = DEM_CAPTURE_ASYNCHRONOUS_TO_REPORTING
      DemBswErrorBufferSize = 80
      DemOperationCycle_IG (DemOperationCycle): DemOperationCycleAutomaticEnd=false, DemOperationCycleAutostart=false, DemOperationCycleId=0, DemOperationCycleType=DEM_OPCYC_IGNITION
      DemPrimaryMemory: DemMaxNumberEventEntryPrimary=38
      DemExtendedDataRecordClass_0 (DemExtendedDataRecordClass):
        DemExtendedDataRecordNumber = 1
        DemExtendedDataRecordTrigger = DEM_TRIGGER_ON_TEST_FAILED
        DemExtendedDataRecordUpdate = DEM_UPDATE_RECORD_YES
        DemDataElementClassRef = OccurrenceCounter
        DemDataElementClassRef = Timestamp
        DemDataElementClassRef = Odomete
        DemDataElementClassRef = LVBatteryVoltage
        DemDataElementClassRef = VehicleSpeed
      DemExtendedDataClass_0 (DemExtendedDataClass): DemExtendedDataRecordClassRef=DemExtendedDataRecordClass_0
      EnableCondition_Voltage (DemEnableCondition): DemEnableConditionId=0, DemEnableConditionStatus=true
      EnableConditionGroup_VOL_Powr3 (DemEnableConditionGroup): DemEnableConditionRef=EnableCondition_Voltage, DemEnableConditionRef=EnableCondition_Powered3S
      EnableCondition_VehState (DemEnableCondition): DemEnableConditionId=1, DemEnableConditionStatus=true
      5 x DemDataElementClass:
        DemDataElementClass_0
          OccurrenceCounter (DemInternalDataElementClass): DemDataElementDataSize=1, DemInternalDataElement=DEM_OCCCTR
        DemDataElementClass_1
          Timestamp (DemExternalCSDataElementClass): DemDataElementDataSize=6, DemDataElementUsePort=false, DemDataElementReadFnc=Rte_ReadData_Timestamp
        DemDataElementClass_2
          Odomete (DemExternalCSDataElementClass): DemDataElementDataSize=3, DemDataElementUsePort=false, DemDataElementReadFnc=Rte_ReadData_Odomete
        DemDataElementClass_3
          LVBatteryVoltage (DemExternalCSDataElementClass): DemDataElementDataSize=1, DemDataElementUsePort=false, DemDataElementReadFnc=Rte_ReadDataLVBatteryVoltage
        DemDataElementClass_4
          VehicleSpeed (DemExternalCSDataElementClass): DemDataElementDataSize=2, DemDataElementUsePort=false, DemDataElementReadFnc=Rte_ReadData_VehicleSpeed
      DemFreezeFrameRecordClass_0 (DemFreezeFrameRecordClass): DemFreezeFrameRecordNumber=0, DemFreezeFrameRecordTrigger=DEM_TRIGGER_ON_CONFIRMED, DemFreezeFrameRecordUpdate=DEM_UPDATE_RECORD_NO
      DemFreezeFrameRecNumClass_0 (DemFreezeFrameRecNumClass): DemFreezeFrameRecordClassRef=DemFreezeFrameRecordClass_0
      DemDataElementClass_5 (DemDataElementClass)
        DemExternalCSDataElementClass: DemDataElementDataSize=1, DemDataElementUsePort=false, DemDataElementReadFnc=Rte_ReadData_SnapShot
      DemFreezeFrameClass_0 (DemFreezeFrameClass): DemDidClassRef=DemDidClass_0
      DemDidClass_0 (DemDidClass): DemDidIdentifier=0, DemDidDataElementClassRef=DemExternalCSDataElementClass
      DemNvRamBlockOBD (DemNvRamBlockId): DemNvRamBlockIdRef=NvMBlock_DemEntry_0
      DemGroupOfDTC_0 (DemGroupOfDTC): DemGroupDTCs=256
      EnableCondition_Powered3S (DemEnableCondition): DemEnableConditionId=2, DemEnableConditionStatus=false
      EnableConditionGroup_Power3 (DemEnableConditionGroup): DemEnableConditionRef=EnableCondition_Powered3S
      EnableConditionGroup_Lost_com (DemEnableConditionGroup): DemEnableConditionRef=EnableCondition_Voltage, DemEnableConditionRef=EnableCondition_VehState
      40 x DemNvRamBlockId:
        DemNvRamBlockIdPERMANENT: DemNvRamBlockIdRef=NvMBlock_DemEntry_1
        DemNvRamBlockId_0: DemNvRamBlockIdRef=NvMBlock_DemEntry_2
        DemNvRamBlockId_1: DemNvRamBlockIdRef=NvMBlock_DemEntry_3
        DemNvRamBlockId_2: DemNvRamBlockIdRef=NvMBlock_DemEntry_4
        DemNvRamBlockId_3: DemNvRamBlockIdRef=NvMBlock_DemEntry_5
        DemNvRamBlockId_4: DemNvRamBlockIdRef=NvMBlock_DemEntry_6
        DemNvRamBlockId_5: DemNvRamBlockIdRef=NvMBlock_DemEntry_7
        DemNvRamBlockId_6: DemNvRamBlockIdRef=NvMBlock_DemEntry_8
        DemNvRamBlockId_7: DemNvRamBlockIdRef=NvMBlock_DemEntry_9
        DemNvRamBlockId_8: DemNvRamBlockIdRef=NvMBlock_DemEntry_10
        DemNvRamBlockId_9: DemNvRamBlockIdRef=NvMBlock_DemEntry_11
        DemNvRamBlockId_10: DemNvRamBlockIdRef=NvMBlock_DemEntry_12
        DemNvRamBlockId_11: DemNvRamBlockIdRef=NvMBlock_DemEntry_13
        DemNvRamBlockId_12: DemNvRamBlockIdRef=NvMBlock_DemEntry_14
        DemNvRamBlockId_13: DemNvRamBlockIdRef=NvMBlock_DemEntry_15
        DemNvRamBlockId_14: DemNvRamBlockIdRef=NvMBlock_DemEntry_16
        DemNvRamBlockId_15: DemNvRamBlockIdRef=NvMBlock_DemEntry_17
        DemNvRamBlockId_16: DemNvRamBlockIdRef=NvMBlock_DemEntry_18
        DemNvRamBlockId_17: DemNvRamBlockIdRef=NvMBlock_DemEntry_19
        DemNvRamBlockId_18: DemNvRamBlockIdRef=NvMBlock_DemEntry_20
        DemNvRamBlockId_19: DemNvRamBlockIdRef=NvMBlock_DemEntry_21
        DemNvRamBlockId_20: DemNvRamBlockIdRef=NvMBlock_DemEntry_22
        DemNvRamBlockId_21: DemNvRamBlockIdRef=NvMBlock_DemEntry_23
        DemNvRamBlockId_22: DemNvRamBlockIdRef=NvMBlock_DemEntry_24
        DemNvRamBlockId_23: DemNvRamBlockIdRef=NvMBlock_DemEntry_25
        DemNvRamBlockId_24: DemNvRamBlockIdRef=NvMBlock_DemEntry_26
        DemNvRamBlockId_25: DemNvRamBlockIdRef=NvMBlock_DemEntry_27
        DemNvRamBlockId_26: DemNvRamBlockIdRef=NvMBlock_DemEntry_28
        DemNvRamBlockId_27: DemNvRamBlockIdRef=NvMBlock_DemEntry_29
        DemNvRamBlockId_28: DemNvRamBlockIdRef=NvMBlock_DemEntry_30
        DemNvRamBlockId_29: DemNvRamBlockIdRef=NvMBlock_DemEntry_31
        DemNvRamBlockId_30: DemNvRamBlockIdRef=NvMBlock_DemEntry_32
        DemNvRamBlockId_31: DemNvRamBlockIdRef=NvMBlock_DemEntry_33
        DemNvRamBlockId_32: DemNvRamBlockIdRef=NvMBlock_DemEntry_34
        DemNvRamBlockId_33: DemNvRamBlockIdRef=NvMBlock_DemEntry_35
        DemNvRamBlockId_34: DemNvRamBlockIdRef=NvMBlock_DemEntry_36
        DemNvRamBlockId_35: DemNvRamBlockIdRef=NvMBlock_DemEntry_37
        DemNvRamBlockId_Version: DemNvRamBlockIdRef=NvMBlock_DemEntry_DemVersion
        DemNvRamBlockId_OBD: DemNvRamBlockIdRef=NvMBlock_DemEntry_OBD
        DemNvRamBlockId_EVENTInfo: DemNvRamBlockIdRef=NvMBlock_DemEventInfo
    DemConfigSet
      DemDTCAttributes_0 (DemDTCAttributes):
        DemAgingAllowed = true
        DemDTCPriority = 1
        DemDTCSignificance = DEM_EVENT_SIGNIFICANCE_FAULT
        DemImmediateNvStorage = true
        DemAgingCycleCounterThreshold = 40
        DemAgingCycleRef = DemOperationCycle_IG
        DemExtendedDataClassRef = DemExtendedDataClass_0
        DemFreezeFrameRecNumClassRef = DemFreezeFrameRecNumClass_0
        DemMemoryDestinationRef = DemPrimaryMemory
      50 x DemDTC, all with DemDTCFunctionalUnit=0, DemDTCAttributesRef=DemDTCAttributes_0:
        DemDTC_B2980: DemDtcValue=11108372
        DemDTC_B2981: DemDtcValue=11108628
        DemDTC_B2982: DemDtcValue=11108884
        DemDTC_B2983: DemDtcValue=11109140
        DemDTC_B2984: DemDtcValue=11109396
        DemDTC_B2985: DemDtcValue=11109652
        DemDTC_B2986: DemDtcValue=11109908
        DemDTC_B2987: DemDtcValue=11110163
        DemDTC_B2988: DemDtcValue=11110417
        DemDTC_B2989: DemDtcValue=11110675
        DemDTC_B298A: DemDtcValue=11110929
        DemDTC_B298B: DemDtcValue=11111187
        DemDTC_B298C: DemDtcValue=11111441
        DemDTC_B298D: DemDtcValue=11111699
        DemDTC_B298E: DemDtcValue=11111953
        DemDTC_B298F: DemDtcValue=11112211
        DemDTC_B2990: DemDtcValue=11112465
        DemDTC_B2991: DemDtcValue=11112839
        DemDTC_B2992: DemDtcValue=11113095
        DemDTC_B2993: DemDtcValue=11113351
        DemDTC_B2994: DemDtcValue=11113607
        DemDTC_B2995: DemDtcValue=11113747
        DemDTC_B2996: DemDtcValue=11114001
        DemDTC_B2997: DemDtcValue=11114315
        DemDTC_B2998: DemDtcValue=11114503
        DemDTC_B2999: DemDtcValue=11114887
        DemDTC_B299A: DemDtcValue=11115030
        DemDTC_B299B: DemDtcValue=11115287
        DemDTC_B299C: DemDtcValue=11115548
        DemDTC_B299D: DemDtcValue=11115798
        DemDTC_B299E: DemDtcValue=11116037
        DemDTC_B299F: DemDtcValue=11116311
        DemDTC_B29A0: DemDtcValue=11116566
        DemDTC_B29A1: DemDtcValue=11116823
        DemDTC_B29A2: DemDtcValue=11117077
        DemDTC_B29A3: DemDtcValue=11117317
        DemDTC_B29A4: DemDtcValue=11117591
        DemDTC_B29A5: DemDtcValue=11117905
        DemDTC_B29A6: DemDtcValue=11118103
        DemDTC_B29A7: DemDtcValue=11118358
        DemDTC_B29A8: DemDtcValue=11118597
        DemDTC_B29A9: DemDtcValue=11118873
        DemDTC_U310016: DemDtcValue=15794198
        DemDTC_U310017: DemDtcValue=15794199
        DemDTC_U30DC87: DemDtcValue=15785095
        DemDTC_U32FC87: DemDtcValue=15924359
        DemDTC_U32AC87: DemDtcValue=15903879
        DemDTC_U30DC83: DemDtcValue=15785091
        DemDTC_U30DC82: DemDtcValue=15785090
        DemDTC_U101F88: DemDtcValue=13639560
      50 x DemEventParameter, all with DemEventAvailable=true, DemEventFailureCycleCounterThreshold=0, DemFFPrestorageSupported=false, DemOperationCycleRef=DemOperationCycle_IG:
        Low_Beam_BIN_resistor: DemEventId=1, DemEventKind=DEM_EVENT_KIND_SWC, DemDTCRef=DemDTC_B2980, DemEnableConditionGroupRef=EnableConditionGroup_VOL_Powr3
          DemDebounceAlgorithmClass
        High_Beam_BIN_resistor: DemEventId=2, DemEventKind=DEM_EVENT_KIND_SWC, DemDTCRef=DemDTC_B2981, DemEnableConditionGroupRef=EnableConditionGroup_VOL_Powr3
          DemDebounceAlgorithmClass
        FogOrCorner_BIN_resistor: DemEventId=3, DemEventKind=DEM_EVENT_KIND_SWC, DemDTCRef=DemDTC_B2982, DemEnableConditionGroupRef=EnableConditionGroup_VOL_Powr3
          DemDebounceAlgorithmClass
        DRLOrTI_NTC_resistor: DemEventId=4, DemEventKind=DEM_EVENT_KIND_SWC, DemReportBehavior=REPORT_AFTER_INIT, DemDTCRef=DemDTC_B2983, DemEnableConditionGroupRef=EnableConditionGroup_VOL_Powr3
          DemDebounceAlgorithmClass
        FogOrCorner_NTC_resistor: DemEventId=5, DemEventKind=DEM_EVENT_KIND_SWC, DemReportBehavior=REPORT_AFTER_INIT, DemDTCRef=DemDTC_B2984, DemEnableConditionGroupRef=EnableConditionGroup_VOL_Powr3
          DemDebounceAlgorithmClass
        High_Beam_NTC_resistor: DemEventId=6, DemEventKind=DEM_EVENT_KIND_SWC, DemReportBehavior=REPORT_AFTER_INIT, DemDTCRef=DemDTC_B2985, DemEnableConditionGroupRef=EnableConditionGroup_VOL_Powr3
          DemDebounceAlgorithmClass
        Low_Beam_NTC_resistor: DemEventId=7, DemEventKind=DEM_EVENT_KIND_SWC, DemReportBehavior=REPORT_AFTER_INIT, DemDTCRef=DemDTC_B2986, DemEnableConditionGroupRef=EnableConditionGroup_VOL_Powr3
          DemDebounceAlgorithmClass
        High_Beam_Led_open: DemEventId=8, DemEventKind=DEM_EVENT_KIND_SWC, DemDTCRef=DemDTC_B2987, DemEnableConditionGroupRef=EnableConditionGroup_VOL_Powr3
          DemDebounceAlgorithmClass
        High_Beam_Led_short: DemEventId=9, DemEventKind=DEM_EVENT_KIND_SWC, DemDTCRef=DemDTC_B2988, DemEnableConditionGroupRef=EnableConditionGroup_VOL_Powr3
          DemDebounceAlgorithmClass
        Low_Beam_Led_open: DemEventId=10, DemEventKind=DEM_EVENT_KIND_SWC, DemReportBehavior=REPORT_AFTER_INIT, DemDTCRef=DemDTC_B2989, DemEnableConditionGroupRef=EnableConditionGroup_VOL_Powr3
          DemDebounceAlgorithmClass
        Low_Beam_Led_short: DemEventId=11, DemEventKind=DEM_EVENT_KIND_SWC, DemDTCRef=DemDTC_B298A, DemEnableConditionGroupRef=EnableConditionGroup_VOL_Powr3
          DemDebounceAlgorithmClass
        FogOrCorner_Led_open: DemEventId=12, DemEventKind=DEM_EVENT_KIND_SWC, DemDTCRef=DemDTC_B298B, DemEnableConditionGroupRef=EnableConditionGroup_VOL_Powr3
          DemDebounceAlgorithmClass
        FogOrCorner_Led_short: DemEventId=13, DemEventKind=DEM_EVENT_KIND_SWC, DemReportBehavior=REPORT_AFTER_INIT, DemDTCRef=DemDTC_B298C, DemEnableConditionGroupRef=EnableConditionGroup_VOL_Powr3
          DemDebounceAlgorithmClass
        DRLOrPO_Led_open: DemEventId=14, DemEventKind=DEM_EVENT_KIND_SWC, DemReportBehavior=REPORT_AFTER_INIT, DemDTCRef=DemDTC_B298D, DemEnableConditionGroupRef=EnableConditionGroup_VOL_Powr3
          DemDebounceAlgorithmClass
        DRLOrPO_Led_short: DemEventId=15, DemEventKind=DEM_EVENT_KIND_SWC, DemDTCRef=DemDTC_B298E, DemEnableConditionGroupRef=EnableConditionGroup_VOL_Powr3
          DemDebounceAlgorithmClass
        TL_Led_open: DemEventId=16, DemEventKind=DEM_EVENT_KIND_SWC, DemReportBehavior=REPORT_AFTER_INIT, DemDTCRef=DemDTC_B298F, DemEnableConditionGroupRef=EnableConditionGroup_VOL_Powr3
          DemDebounceAlgorithmClass
        TL_Led_short: DemEventId=17, DemEventKind=DEM_EVENT_KIND_SWC, DemReportBehavior=REPORT_AFTER_INIT, DemDTCRef=DemDTC_B2990, DemEnableConditionGroupRef=EnableConditionGroup_VOL_Powr3
          DemDebounceAlgorithmClass
        BUCK1Low_Beam_lost_Com: DemEventId=18, DemEventKind=DEM_EVENT_KIND_SWC, DemReportBehavior=REPORT_AFTER_INIT, DemDTCRef=DemDTC_B2991, DemEnableConditionGroupRef=EnableConditionGroup_VOL_Powr3
          DemDebounceAlgorithmClass
        BUCK2High_Beam_lost_Com: DemEventId=19, DemEventKind=DEM_EVENT_KIND_SWC, DemReportBehavior=REPORT_AFTER_INIT, DemDTCRef=DemDTC_B2992, DemEnableConditionGroupRef=EnableConditionGroup_VOL_Powr3
          DemDebounceAlgorithmClass
        DRLOrPO_led_driver_lost_Com: DemEventId=20, DemEventKind=DEM_EVENT_KIND_SWC, DemDTCRef=DemDTC_B2993, DemEnableConditionGroupRef=EnableConditionGroup_VOL_Powr3
          DemDebounceAlgorithmClass
        TL_led_driver_lost_Com: DemEventId=21, DemEventKind=DEM_EVENT_KIND_SWC, DemReportBehavior=REPORT_AFTER_INIT, DemDTCRef=DemDTC_B2994, DemEnableConditionGroupRef=EnableConditionGroup_VOL_Powr3
          DemDebounceAlgorithmClass
        Leveling_motor_open_circuit: DemEventId=22, DemEventKind=DEM_EVENT_KIND_SWC, DemReportBehavior=REPORT_AFTER_INIT, DemDTCRef=DemDTC_B2995, DemEnableConditionGroupRef=EnableConditionGroup_VOL_Powr3
          DemDebounceAlgorithmClass
        Leveling_motor_short_circuit: DemEventId=23, DemEventKind=DEM_EVENT_KIND_SWC, DemReportBehavior=REPORT_AFTER_INIT, DemDTCRef=DemDTC_B2996, DemEnableConditionGroupRef=EnableConditionGroup_VOL_Powr3
          DemDebounceAlgorithmClass
        Leveling_motor_ThermalShutdown: DemEventId=24, DemEventKind=DEM_EVENT_KIND_SWC, DemDTCRef=DemDTC_B2997, DemEnableConditionGroupRef=EnableConditionGroup_VOL_Powr3
          DemDebounceAlgorithmClass
        Leveling_motor_stall: DemEventId=25, DemEventKind=DEM_EVENT_KIND_SWC, DemReportBehavior=REPORT_AFTER_INIT, DemDTCRef=DemDTC_B2998, DemEnableConditionGroupRef=EnableConditionGroup_VOL_Powr3
          DemDebounceAlgorithmClass
        Leveling_motor_driver_lost_Com: DemEventId=26, DemEventKind=DEM_EVENT_KIND_SWC, DemReportBehavior=REPORT_AFTER_INIT, DemDTCRef=DemDTC_B2999, DemEnableConditionGroupRef=EnableConditionGroup_VOL_Powr3
          DemDebounceAlgorithmClass
        SBC_input_undervoltage: DemEventId=27, DemEventKind=DEM_EVENT_KIND_SWC, DemDTCRef=DemDTC_B299A, DemEnableConditionGroupRef=EnableConditionGroup_Power3
          DemDebounceAlgorithmClass
        SBC_input_overvoltage: DemEventId=28, DemEventKind=DEM_EVENT_KIND_SWC, DemDTCRef=DemDTC_B299B, DemEnableConditionGroupRef=EnableConditionGroup_Power3
          DemDebounceAlgorithmClass
        DEM5VUnderOrOvervoltage: DemEventId=29, DemEventKind=DEM_EVENT_KIND_SWC, DemDTCRef=DemDTC_B299C, DemEnableConditionGroupRef=EnableConditionGroup_VOL_Powr3
          DemDebounceAlgorithmClass
        BUCK1_V5A_undervoltage: DemEventId=30, DemEventKind=DEM_EVENT_KIND_SWC, DemReportBehavior=REPORT_AFTER_INIT, DemDTCRef=DemDTC_B299D, DemEnableConditionGroupRef=EnableConditionGroup_VOL_Powr3
          DemDebounceAlgorithmClass
        BUCK1_driver: DemEventId=31, DemEventKind=DEM_EVENT_KIND_SWC, DemDTCRef=DemDTC_B299E, DemEnableConditionGroupRef=EnableConditionGroup_VOL_Powr3
          DemDebounceAlgorithmClass
        BUCK1_COMP_overvoltage: DemEventId=32, DemEventKind=DEM_EVENT_KIND_SWC, DemReportBehavior=REPORT_AFTER_INIT, DemDTCRef=DemDTC_B299F, DemEnableConditionGroupRef=EnableConditionGroup_VOL_Powr3
          DemDebounceAlgorithmClass
        BUCK1_outputLow_Beam_undervoltage: DemEventId=33, DemEventKind=DEM_EVENT_KIND_SWC, DemDTCRef=DemDTC_B29A0, DemEnableConditionGroupRef=EnableConditionGroup_VOL_Powr3
          DemDebounceAlgorithmClass
        BUCK1_outputLow_Beam_overvoltage: DemEventId=34, DemEventKind=DEM_EVENT_KIND_SWC, DemReportBehavior=REPORT_AFTER_INIT, DemDTCRef=DemDTC_B29A1, DemEnableConditionGroupRef=EnableConditionGroup_VOL_Powr3
          DemDebounceAlgorithmClass
        BUCK2_V5A_undervoltage: DemEventId=35, DemEventKind=DEM_EVENT_KIND_SWC, DemReportBehavior=REPORT_AFTER_INIT, DemDTCRef=DemDTC_B29A2, DemEnableConditionGroupRef=EnableConditionGroup_VOL_Powr3
          DemDebounceAlgorithmClass
        BUCK2_driver: DemEventId=36, DemEventKind=DEM_EVENT_KIND_SWC, DemReportBehavior=REPORT_AFTER_INIT, DemDTCRef=DemDTC_B29A3, DemEnableConditionGroupRef=EnableConditionGroup_VOL_Powr3
          DemDebounceAlgorithmClass
        BUCK2_COMP_overvoltage: DemEventId=37, DemEventKind=DEM_EVENT_KIND_SWC, DemReportBehavior=REPORT_AFTER_INIT, DemDTCRef=DemDTC_B29A4, DemEnableConditionGroupRef=EnableConditionGroup_VOL_Powr3
          DemDebounceAlgorithmClass
        Program_flow: DemEventId=38, DemEventKind=DEM_EVENT_KIND_SWC, DemReportBehavior=REPORT_AFTER_INIT, DemDTCRef=DemDTC_B29A5, DemEnableConditionGroupRef=EnableConditionGroup_VOL_Powr3
          DemDebounceAlgorithmClass
        Boost_ouput_overvoltage: DemEventId=39, DemEventKind=DEM_EVENT_KIND_SWC, DemReportBehavior=REPORT_AFTER_INIT, DemDTCRef=DemDTC_B29A6, DemEnableConditionGroupRef=EnableConditionGroup_VOL_Powr3
          DemDebounceAlgorithmClass
        Boost_ouput_undervoltage: DemEventId=40, DemEventKind=DEM_EVENT_KIND_SWC, DemReportBehavior=REPORT_AFTER_INIT, DemDTCRef=DemDTC_B29A7, DemEnableConditionGroupRef=EnableConditionGroup_VOL_Powr3
          DemDebounceAlgorithmClass
        Boost_driver: DemEventId=41, DemEventKind=DEM_EVENT_KIND_SWC, DemReportBehavior=REPORT_AFTER_INIT, DemDTCRef=DemDTC_B29A8, DemEnableConditionGroupRef=EnableConditionGroup_VOL_Powr3
          DemDebounceAlgorithmClass
        HideSide_ouput_overcurrent: DemEventId=42, DemEventKind=DEM_EVENT_KIND_SWC, DemDTCRef=DemDTC_B29A9, DemEnableConditionGroupRef=EnableConditionGroup_VOL_Powr3
          DemDebounceAlgorithmClass
        KL15_voltage_less_than_7V: DemEventId=43, DemEventKind=DEM_EVENT_KIND_SWC, DemDTCRef=DemDTC_U310016, DemEnableConditionGroupRef=EnableConditionGroup_Power3
          DemDebounceAlgorithmClass
        KL15_voltage_more_than_18V: DemEventId=44, DemEventKind=DEM_EVENT_KIND_SWC, DemDTCRef=DemDTC_U310017, DemEnableConditionGroupRef=EnableConditionGroup_Power3
          DemDebounceAlgorithmClass
        Lost_Com_with_BCM_FLM0xDC: DemEventId=45, DemEventKind=DEM_EVENT_KIND_SWC, DemDTCRef=DemDTC_U30DC87, DemEnableConditionGroupRef=EnableConditionGroup_Lost_com
          DemDebounceAlgorithmClass
        Lost_Com_with_BGW_LI0x2FC: DemEventId=46, DemEventKind=DEM_EVENT_KIND_SWC, DemDTCRef=DemDTC_U32FC87, DemEnableConditionGroupRef=EnableConditionGroup_Lost_com
          DemDebounceAlgorithmClass
        Lost_Com_with_CDC_HU_070x2AC: DemEventId=47, DemEventKind=DEM_EVENT_KIND_SWC, DemDTCRef=DemDTC_U32AC87, DemEnableConditionGroupRef=EnableConditionGroup_Lost_com
          DemDebounceAlgorithmClass
        CRC_with_BCM_FLM0xDC: DemEventId=48, DemEventKind=DEM_EVENT_KIND_SWC, DemDTCRef=DemDTC_U30DC83, DemEnableConditionGroupRef=EnableConditionGroup_Lost_com
          DemDebounceAlgorithmClass
        Message_counter_witth_BCM_FLM0xDC: DemEventId=49, DemEventKind=DEM_EVENT_KIND_SWC, DemDTCRef=DemDTC_U30DC82, DemEnableConditionGroupRef=EnableConditionGroup_Lost_com
          DemDebounceAlgorithmClass
        CAN_bus_off: DemEventId=50, DemEventKind=DEM_EVENT_KIND_BSW, DemReportBehavior=REPORT_AFTER_INIT, DemDTCRef=DemDTC_U101F88, DemEnableConditionGroupRef=EnableConditionGroup_Lost_com
          DemDebounceAlgorithmClass
            DemDebounceCounterBased: DemDebounceCounterBasedClassRef=DemDebounceCounterBasedClass_0
      DemDebounceCounterBasedClass_0 (DemDebounceCounterBasedClass):
        DemDebounceBehavior = DEM_DEBOUNCE_FREEZE
        DemDebounceCounterDecrementStepSize = 1
        DemDebounceCounterFailedThreshold = 1
        DemDebounceCounterIncrementStepSize = 1
        DemDebounceCounterJumpDown = true
        DemDebounceCounterJumpDownValue = 0
        DemDebounceCounterJumpUp = true
        DemDebounceCounterJumpUpValue = 0
        DemDebounceCounterPassedThreshold = -1
        DemDebounceCounterStorage = false
      DemDTC_B29AA (DemDTC): DemDTCFunctionalUnit=0, DemDtcValue=11119121, DemDTCAttributesRef=DemDTCAttributes_0
      DemDTC_B29AB (DemDTC): DemDTCFunctionalUnit=0, DemDtcValue=11119379, DemDTCAttributesRef=DemDTCAttributes_0
      HideSide_ouput_shorterror (DemEventParameter):
        DemEventAvailable = true
        DemEventFailureCycleCounterThreshold = 0
        DemEventId = 51
        DemEventKind = DEM_EVENT_KIND_SWC
        DemFFPrestorageSupported = false
        DemOperationCycleRef = DemOperationCycle_IG
        DemDTCRef = DemDTC_B29AA
        DemEnableConditionGroupRef = EnableConditionGroup_VOL_Powr3
        DemDebounceAlgorithmClass
      HideSide_ouput_openerror (DemEventParameter):
        DemEventAvailable = true
        DemEventFailureCycleCounterThreshold = 0
        DemEventId = 52
        DemEventKind = DEM_EVENT_KIND_SWC
        DemFFPrestorageSupported = false
        DemOperationCycleRef = DemOperationCycle_IG
        DemDTCRef = DemDTC_B29AB
        DemEnableConditionGroupRef = EnableConditionGroup_VOL_Powr3
        DemDebounceAlgorithmClass
  module config WdgIf
    WdgIfGeneral: WdgIfDevErrorDetect=false, WdgIfVersionInfoApi=false, WdgIfNumberOfDevices=1, WdgIfHeaderFileInclusion=SBC_TLE9263_WDG.h
    WdgIfExternalDevice_0 (WdgIfExternalDevice): WdgIfExternalDeviceIndex=0, TriggerConditionFunction=TLE9263_SetTriggerCondition, SetModeFunction=TLE9263_SetMode
  module config Dio: implementation-config-variant=VARIANT-PRE-COMPILE
    CommonPublishedInformation:
      ArReleaseMajorVersion = 4
      ArReleaseMinorVersion = 4
      ArReleaseRevisionVersion = 0
      ModuleId = 120
      SwMajorVersion = 1
      SwMinorVersion = 0
      SwPatchVersion = 0
      VendorId = 43
    DioConfig
      DioPort_PTB (DioPort): DioPortId=1
        LR_DIRECTION (DioChannel): DioChannelId=9
      DioPort_PTD (DioPort): DioPortId=0
        RO (DioChannel): DioChannelId=4
        SBC_INT (DioChannel): DioChannelId=2
    DioGeneral:
      DioDevErrorDetect = 0
      DioEnableUserModeSupport = 0
      DioFlipChannelApi = 1
      DioMaskedWritePortApi = 0
      DioMulticoreSupport = 0
      DioReadZeroForUndefinedPortPins = 0
      DioReversePortBits = 0
      DioVersionInfoApi = 0
      GPIODioIPDevErrorDetect = 0
  module config Os
    OsOS:
      OsNumberOfCores = 1
      OsScalabilityClass = SC1
      OsSystemStackSize = 1024
      OsStackMonitoring = true
      OsStatus = EXTENDED
      OsUseGetServiceId = false
      OsUseParameterAccess = false
      GetCPUUsage = false
      OsUseResScheduler = true
      SingleCore = 0
      OsHooks: OsErrorHook=false, OsPostTaskHook=false, OsPreTaskHook=false, OsShutdownHook=true, OsStartupHook=true
    OSDEFAULTAPPMODE (OsAppMode)
    Counter (OsCounter)
      SystemTimer_Core0: OsCounterMaxAllowedValue=65535, OsCounterMinCycle=1, OsCounterTicksPerBase=1, OsCounterType=HARDWARE, OsSecondsPerTick=0.0
    SystemTimer: OsCpuFrequency=80000
      ArchSystemTimerCore0: OsPriority=11, OsNestedEnable=true, OsSecondsTick=0.001, OsTimerSource=SysTick_Handler
      ArchTimingProtCore0: OsTimingProtPriority=12, OsTimingProtNestedEnable=false, OsTimingProtSecondsTick=0.001, OsTimingProtTimerSource=NULL
    OsResource_0 (OsResource): OsResourceProperty=STANDARD
    6 x OsTask, all with OsTaskActivation=1, OsTaskSchedule=FULL, OsTaskStackSize=512:
      OsTask_Init: OsTaskPriority=35, OsTaskResourceRef=OsResource_0, OsTaskResourceRef=OsResource_Spi
        OsTaskAutostart: OsTaskAppModeRef=OSDEFAULTAPPMODE
      OsTask_1ms: OsTaskPriority=30, OsTaskResourceRef=OsResource_Spi
      OsTask_2ms: OsTaskPriority=25
      OsTask_10ms: OsTaskPriority=15, OsTaskResourceRef=OsResource_Spi
      OsTask_50ms: OsTaskPriority=10
      OsTask_100ms: OsTaskPriority=5, OsTaskResourceRef=OsResource_Spi
    3 x OsIsr, all with OsIsrCategory=CATEGORY_2:
      LPIT0_Ch0_IRQHandler: OsIsrResourceRef=OsResource_Spi
        OsIsrSettings: OsIsrStackSize=512, OsInterruptSource=LPIT0_Ch0_IRQHandler, OsInterruptsId=OS_LPIT0_Ch0_IRQn, OsInterruptLevel=8, OsIsrNestedEnable=true
      ERM_single_fault_IRQHandler
        OsIsrSettings:
          OsIsrStackSize = 512
          OsInterruptSource = ERM_single_fault_IRQHandler
          OsInterruptsId = OS_ERM_single_fault_IRQn
          OsInterruptLevel = 4
          OsIsrNestedEnable = true
      ERM_double_fault_IRQHandler
        OsIsrSettings:
          OsIsrStackSize = 512
          OsInterruptSource = ERM_double_fault_IRQHandler
          OsInterruptsId = OS_ERM_double_fault_IRQn
          OsInterruptLevel = 4
          OsIsrNestedEnable = true
    5 x OsAlarm, all with OsAlarmCounterRef=SystemTimer_Core0:
      OsAlarm_1ms
        OsAlarmAction
          OsAlarmActivateTask: OsAlarmActivateTaskRef=OsTask_1ms
        OsAlarmAutostart: OsAlarmAlarmTime=1, OsAlarmAutostartType=RELATIVE, OsAlarmCycleTime=1, OsAlarmAppModeRef=OSDEFAULTAPPMODE
      OsAlarm_2ms
        OsAlarmAction
          OsAlarmActivateTask: OsAlarmActivateTaskRef=OsTask_2ms
        OsAlarmAutostart: OsAlarmAlarmTime=2, OsAlarmAutostartType=RELATIVE, OsAlarmCycleTime=2, OsAlarmAppModeRef=OSDEFAULTAPPMODE
      OsAlarm_10ms
        OsAlarmAction
          OsAlarmActivateTask: OsAlarmActivateTaskRef=OsTask_10ms
        OsAlarmAutostart: OsAlarmAlarmTime=4, OsAlarmAutostartType=RELATIVE, OsAlarmCycleTime=10, OsAlarmAppModeRef=OSDEFAULTAPPMODE
      OsAlarm_50ms
        OsAlarmAction
          OsAlarmActivateTask: OsAlarmActivateTaskRef=OsTask_50ms
        OsAlarmAutostart: OsAlarmAlarmTime=5, OsAlarmAutostartType=RELATIVE, OsAlarmCycleTime=50, OsAlarmAppModeRef=OSDEFAULTAPPMODE
      OsAlarm_100ms
        OsAlarmAction
          OsAlarmActivateTask: OsAlarmActivateTaskRef=OsTask_100ms
        OsAlarmAutostart: OsAlarmAlarmTime=6, OsAlarmAutostartType=RELATIVE, OsAlarmCycleTime=100, OsAlarmAppModeRef=OSDEFAULTAPPMODE
    OsTask_5ms (OsTask): OsTaskActivation=1, OsTaskPriority=20, OsTaskSchedule=FULL, OsTaskStackSize=1024
    OsAlarm_5ms (OsAlarm): OsAlarmCounterRef=SystemTimer_Core0
      OsAlarmAction
        OsAlarmActivateTask: OsAlarmActivateTaskRef=OsTask_5ms
      OsAlarmAutostart: OsAlarmAlarmTime=3, OsAlarmAutostartType=RELATIVE, OsAlarmCycleTime=5, OsAlarmAppModeRef=OSDEFAULTAPPMODE
    6 x OsIsr:
      ADC0_IRQHandler: OsIsrCategory=CATEGORY_2
        OsIsrSettings: OsIsrStackSize=512, OsInterruptSource=ADC0_IRQHandler, OsInterruptsId=OS_ADC0_IRQn, OsInterruptLevel=7, OsIsrNestedEnable=true
      ADC1_IRQHandler: OsIsrCategory=CATEGORY_2
        OsIsrSettings: OsIsrStackSize=512, OsInterruptSource=ADC1_IRQHandler, OsInterruptsId=OS_ADC1_IRQn, OsInterruptLevel=7, OsIsrNestedEnable=true
      LPUART0_RxTx_IRQHandler: OsIsrCategory=CATEGORY_1
        OsIsrSettings: OsIsrStackSize=512, OsInterruptSource=LPUART0_RxTx_IRQHandler, OsInterruptsId=OS_LPUART0_RxTx_IRQn, OsInterruptLevel=13, OsIsrNestedEnable=false
      LPUART1_RxTx_IRQHandler: OsIsrCategory=CATEGORY_2
        OsIsrSettings: OsIsrStackSize=512, OsInterruptSource=LPUART1_RxTx_IRQHandler, OsInterruptsId=OS_LPUART1_RxTx_IRQn, OsInterruptLevel=10, OsIsrNestedEnable=false
      DMA0_IRQHandler: OsIsrCategory=CATEGORY_2
        OsIsrSettings: OsIsrStackSize=500, OsInterruptSource=DMA0_IRQHandler, OsInterruptsId=OS_DMA0_IRQn, OsInterruptLevel=4, OsIsrNestedEnable=true
      FTFC_Fault_IRQHandler: OsIsrCategory=CATEGORY_2
        OsIsrSettings: OsIsrStackSize=512, OsInterruptSource=FTFC_Fault_IRQHandler, OsInterruptsId=OS_FTFC_Fault_IRQn, OsInterruptLevel=4, OsIsrNestedEnable=true
    OsResource_Spi (OsResource): OsResourceProperty=STANDARD
    LVD_LVW_IRQHandler (OsIsr): OsIsrCategory=CATEGORY_2
      OsIsrSettings: OsIsrStackSize=100, OsInterruptSource=LVD_LVW_IRQHandler, OsInterruptsId=OS_LVD_LVW_IRQn, OsInterruptLevel=4, OsIsrNestedEnable=true
  module config Mcu: implementation-config-variant=VARIANT-POST-BUILD
    CommonPublishedInformation:
      ArReleaseMajorVersion = 4
      ArReleaseMinorVersion = 4
      ArReleaseRevisionVersion = 0
      ModuleId = 101
      SwMajorVersion = 1
      SwMinorVersion = 0
      SwPatchVersion = 0
      VendorApiInfix = 
      VendorId = 43
    McuDebugConfiguration:
      McuDisableCmuApi = 0
      McuDisableDemReportErrorStatus = 0
      McuEnablePeripheralCMU = 0
      McuGetClockFrequencyApi = 0
      McuGetMidrStructureApi = 0
      McuGetPowerModeStatetApi = 0
      McuSRAMRetentionConfigApi = 0
    McuGeneralConfiguration:
      McuCalloutBeforePerformReset = 0
      McuCmuErrorIsrUsed = 0
      McuDevErrorDetect = 0
      McuDisablePmcInit = 0
      McuDisableRcmInit = 0
      McuDisableSmcInit = 0
      McuEnableModeChangeNotification = 0
      McuEnableUserModeSupport = 0
      McuEnterLowPowerMode = 1
      McuGetRamStateApi = 0
      McuInitClock = 1
      McuNoPll = 0
      McuPerformResetApi = 1
      McuPerformResetCallout = NULL_PTR
      McuTimeout = 50000
      McuTimeoutMethod = OSIF_COUNTER_DUMMY
      McuVersionInfoApi = 0
    McuModuleConfiguration:
      McuClockSrcFailureNotification = DISABLED
      McuNumberOfMcuModes = 1
      McuRTC_CLKINFrequencyHz = 32768.0
      McuRamSectors = 0
      McuTCLK{0..2}_REF_CLKFrequencyHz = 32000.0
      McuAllowedModes: McuAllowHighSpeedRunMode=0, McuAllowVeryLowPowerModes=0
      McuClockSettingConfig_0 (McuClockSettingConfig): McuClockSettingId=0, McuScgClkOutSelect=SPLL_CLK, McuSysClockUnderMcuControl=1
        McuClkMonitor
          McuClkMonitor_0: McuAsyncFHHInterruptEn=0, McuAsyncFLLInterruptEn=0, McuClkMonitorEn=0, McuClockMonitorUnderMcuControl=0, McuCmuName=CMU_FC_0_FIRC_MON1_CLK
          McuClkMonitor_1: McuClkMonitorEn=0, McuClockMonitorUnderMcuControl=0, McuCmuName=CMU_FC_1_FIRC_MON2_CLK, McuSyncFHHInterruptEn=0, McuSyncFLLInterruptEn=0
        4 x McuClockReferencePoint:
          McuClockReferencePoint_FlexCan0: McuClockFrequencySelect=RUN_SYS_CLK, McuClockReferencePointFrequency=8.0E7
          McuClockReferencePoint_LPIT_CLK: McuClockFrequencySelect=LPIT0_CLK, McuClockReferencePointFrequency=4.0E7
          McuClockReferencePoint_LPSPI1: McuClockFrequencySelect=LPSPI1_CLK, McuClockReferencePointFrequency=4.0E7
          McuClockReferencePoint_Lin: McuClockFrequencySelect=LPUART1_CLK, McuClockReferencePointFrequency=4.0E7
        McuFIRCClockConfig:
          McuFIRCDiv1 = 1
          McuFIRCDiv1Frequency = 4.8E7
          McuFIRCDiv2 = 2
          McuFIRCDiv2Frequency = 2.4E7
          McuFIRCEnable = 1
          McuFIRCFrequency = 4.8E7
          McuFIRCRangeSelect = TRIMMED_TO_48MHZ
          McuFIRCRegulatorEnable = 1
          McuFIRCUnderMcuControl = 0
        McuHsrunClockConfig:
          McuBusClockDivider = 2
          McuBusClockFrequency = 4.0E7
          McuCoreClockDivider = 2
          McuCoreClockFrequency = 8.0E7
          McuFlashClockFrequency = 2.0E7
          McuPreDivSystemClockFrequency = 4.8E7
          McuScgClkOutFrequency = 1.6E8
          McuSlowClockDivider = 4
          McuSystemClockFrequency = 8.0E7
          McuSystemClockSwitch = SPLL_CLK
        34 x McuPeripheralClockConfig, all with McuPeripheralClockDivider=1, McuPeripheralClockEnable=1, McuPeripheralClockUnderMcuControl=1, McuPeripheralFractionalDivider=1:
          McuPeripheralClockConfig_0: McuPerName=FTFC, McuPeripheralClockFrequency=0.0, McuPeripheralClockSelect=CLOCK_IS_OFF
          McuPeripheralClockConfig_1: McuPerName=DMAMUX0, McuPeripheralClockFrequency=0.0, McuPeripheralClockSelect=CLOCK_IS_OFF
          McuPeripheralClockConfig_10: McuPerName=PDB1, McuPeripheralClockFrequency=0.0, McuPeripheralClockSelect=CLOCK_IS_OFF
          McuPeripheralClockConfig_11: McuPerName=CRC0, McuPeripheralClockFrequency=0.0, McuPeripheralClockSelect=CLOCK_IS_OFF
          McuPeripheralClockConfig_12: McuPerName=PDB0, McuPeripheralClockFrequency=0.0, McuPeripheralClockSelect=CLOCK_IS_OFF
          McuPeripheralClockConfig_13: McuPerName=LPIT0, McuPeripheralClockFrequency=4.0E7, McuPeripheralClockSelect=SPLL
          McuPeripheralClockConfig_14: McuPerName=FTM0, McuPeripheralClockFrequency=8.0E7, McuPeripheralClockSelect=SPLL
          McuPeripheralClockConfig_15: McuPerName=FTM1, McuPeripheralClockFrequency=32000.0, McuPeripheralClockSelect=CLOCK_IS_OFF
          McuPeripheralClockConfig_16: McuPerName=FTM2, McuPeripheralClockFrequency=8000000.0, McuPeripheralClockSelect=SOSC
          McuPeripheralClockConfig_17: McuPerName=ADC0, McuPeripheralClockFrequency=4.0E7, McuPeripheralClockSelect=SPLL
          McuPeripheralClockConfig_18: McuPerName=RTC0, McuPeripheralClockFrequency=0.0, McuPeripheralClockSelect=CLOCK_IS_OFF
          McuPeripheralClockConfig_19: McuPerName=LPTMR0, McuPeripheralClockFrequency=0.0, McuPeripheralClockSelect=CLOCK_IS_OFF
          McuPeripheralClockConfig_2: McuPerName=FLEXCAN0, McuPeripheralClockFrequency=0.0, McuPeripheralClockSelect=CLOCK_IS_OFF
          McuPeripheralClockConfig_20: McuPerName=PORTA, McuPeripheralClockFrequency=0.0, McuPeripheralClockSelect=CLOCK_IS_OFF
          McuPeripheralClockConfig_21: McuPerName=PORTB, McuPeripheralClockFrequency=0.0, McuPeripheralClockSelect=CLOCK_IS_OFF
          McuPeripheralClockConfig_22: McuPerName=PORTC, McuPeripheralClockFrequency=0.0, McuPeripheralClockSelect=CLOCK_IS_OFF
          McuPeripheralClockConfig_23: McuPerName=PORTD, McuPeripheralClockFrequency=0.0, McuPeripheralClockSelect=CLOCK_IS_OFF
          McuPeripheralClockConfig_24: McuPerName=PORTE, McuPeripheralClockFrequency=0.0, McuPeripheralClockSelect=CLOCK_IS_OFF
          McuPeripheralClockConfig_25: McuPerName=FlexIO, McuPeripheralClockFrequency=0.0, McuPeripheralClockSelect=CLOCK_IS_OFF
          McuPeripheralClockConfig_26: McuPerName=EWM0, McuPeripheralClockFrequency=0.0, McuPeripheralClockSelect=CLOCK_IS_OFF
          McuPeripheralClockConfig_27: McuPerName=LPI2C0, McuPeripheralClockFrequency=4.0E7, McuPeripheralClockSelect=SPLL
          McuPeripheralClockConfig_28: McuPerName=LPUART0, McuPeripheralClockFrequency=4.0E7, McuPeripheralClockSelect=SPLL
          McuPeripheralClockConfig_29: McuPerName=LPUART1, McuPeripheralClockFrequency=4.0E7, McuPeripheralClockSelect=SPLL
          McuPeripheralClockConfig_3: McuPerName=FLEXCAN1, McuPeripheralClockFrequency=0.0, McuPeripheralClockSelect=CLOCK_IS_OFF
          McuPeripheralClockConfig_30: McuPerName=LPUART2, McuPeripheralClockFrequency=8000000.0, McuPeripheralClockSelect=SOSC
          McuPeripheralClockConfig_31: McuPerName=FTM4, McuPeripheralClockFrequency=32000.0, McuPeripheralClockSelect=CLOCK_IS_OFF
          McuPeripheralClockConfig_32: McuPerName=FTM5, McuPeripheralClockFrequency=32000.0, McuPeripheralClockSelect=CLOCK_IS_OFF
          McuPeripheralClockConfig_33: McuPerName=CMP0, McuPeripheralClockFrequency=0.0, McuPeripheralClockSelect=CLOCK_IS_OFF
          McuPeripheralClockConfig_4: McuPerName=FTM3, McuPeripheralClockFrequency=8.0E7, McuPeripheralClockSelect=SPLL
          McuPeripheralClockConfig_5: McuPerName=ADC1, McuPeripheralClockFrequency=4.0E7, McuPeripheralClockSelect=SPLL
          McuPeripheralClockConfig_6: McuPerName=FLEXCAN2, McuPeripheralClockFrequency=0.0, McuPeripheralClockSelect=CLOCK_IS_OFF
          McuPeripheralClockConfig_7: McuPerName=LPSPI0, McuPeripheralClockFrequency=4.0E7, McuPeripheralClockSelect=SPLL
          McuPeripheralClockConfig_8: McuPerName=LPSPI1, McuPeripheralClockFrequency=4.0E7, McuPeripheralClockSelect=SPLL
          McuPeripheralClockConfig_9: McuPerName=LPSPI2, McuPeripheralClockFrequency=4.0E7, McuPeripheralClockSelect=SPLL
        McuRunClockConfig:
          McuBusClockDivider = 2
          McuBusClockFrequency = 4.0E7
          McuCoreClockDivider = 2
          McuCoreClockFrequency = 8.0E7
          McuFlashClockFrequency = 2.0E7
          McuPreDivSystemClockFrequency = 4.8E7
          McuScgClkOutFrequency = 1.6E8
          McuSlowClockDivider = 4
          McuSystemClockFrequency = 8.0E7
          McuSystemClockSwitch = SPLL_CLK
        McuSIMClockConfig:
          McuDMAClockGatingEnable = 1
          McuEIMClockGatingEnable = 1
          McuERMClockGatingEnable = 1
          McuGPIOClockGatingEnable = 0
          McuMPUClockGatingEnable = 1
          McuMSCMClockGatingEnable = 1
          McuSIMUnderMcuControl = 0
          McuSimChipConfiguration:
            McuCLKOUTDivider = 1
            McuCLKOUTEnable = 1
            McuCLKOUTSelect = BUS_CLK
            McuDebugTraceDividerEnable = 1
            McuTRACECLKDivider = 1
            McuTRACECLKFraction = 1
            McuTRACECLKSelect = CORE_CLK
          McuSimFtmConfiguration:
            McuFTM{0..7}ExternalClockPinSelect = TCLK0_PIN
          McuSimLpoConfiguration: McuLPOClkSelect=LPO_128K_CLK, McuLPO_1KClockEnable=1, McuLPO_32KClockEnable=1, McuRTCClkSelect=SOSCDIV1_CLK
        McuSIRCClockConfig:
          McuSIRCDiv1 = 1
          McuSIRCDiv1Frequency = 8000000.0
          McuSIRCDiv2 = 2
          McuSIRCDiv2Frequency = 4000000.0
          McuSIRCEnable = 0
          McuSIRCFrequency = 8000000.0
          McuSIRCLowPowerEnable = 0
          McuSIRCRangeSelect = HIGH_RANGE_CLOCK
          McuSIRCStopEnable = 0
          McuSIRCUnderMcuControl = 0
        McuSystemOSCClockConfig:
          McuSOSCClockMonitorEnable = 0
          McuSOSCClockMonitorResetEnable = 0
          McuSOSCDiv1 = 1
          McuSOSCDiv1Frequency = 8000000.0
          McuSOSCDiv2 = 1
          McuSOSCDiv2Frequency = 8000000.0
          McuSOSCEnable = 1
          McuSOSCExternalReferenceSelect = 0
          McuSOSCFrequency = 8000000.0
          McuSOSCHighGainOscillatorSelect = 0
          McuSOSCRangeSelect = HIGH_FREQ_RANGE
          McuSOSCUnderMcuControl = 1
        McuSystemPll:
          McuSPLLClockMonitorEnable = 1
          McuSPLLClockMonitorResetEnable = 0
          McuSPLLDiv1 = 2
          McuSPLLDiv1Frequency = 8.0E7
          McuSPLLDiv2 = 4
          McuSPLLDiv2Frequency = 4.0E7
          McuSPLLEnable = 1
          McuSPLLFrequency = 1.6E8
          McuSPLLInputClkPreDivider = 1
          McuSPLLInputFrequency = 8000000.0
          McuSPLLMultiplier = 40
          McuSPLLSelectSourceClock = SOSC_CLK
          McuSystemPllUnderMcuControl = 1
        McuVlprClockConfig:
          McuBusClockDivider = 2
          McuBusClockFrequency = 500000.0
          McuCoreClockDivider = 8
          McuCoreClockFrequency = 1000000.0
          McuFlashClockFrequency = 250000.0
          McuPreDivSystemClockFrequency = 8000000.0
          McuScgClkOutFrequency = 0.0
          McuSlowClockDivider = 4
          McuSystemClockFrequency = 1000000.0
          McuSystemClockSwitch = SIRC_CLK
      McuInterruptEvents: McuAlternateResetEvent=0, McuVoltageErrorEvent=0
      McuModeSettingConf_0 (McuModeSettingConf): McuEnableSleepOnExit=0, McuMode=0, McuPowerMode=RUN
      McuPowerControl:
        McuClockBiasDisable = 0
        McuLPODisable = 0
        McuLowPowerBiasEnable = 0
        McuLowVoltageDetectInterruptEnable = 0
        McuLowVoltageDetectResetEnable = 0
        McuLowVoltageWarningInterruptEnable = 0
      McuResetConfig: McuResetPinFilterBusClockSelect=0, McuResetPinFilterInRunAndWait=ALL_FILTERING_DISABLE, McuResetPinFilterInStopMode=ALL_FILTERING_DISABLE
        McuSystemInterruptEnable:
          McuCMULossOfClockResetInterrupt = 0
          McuCoreLockupInterrupt = 0
          McuExternalResetPinInterrupt = 0
          McuGlobalInterrupt = 0
          McuJTAGResetInterrupt = 0
          McuLossOfClockInterrupt = 0
          McuLossOfLockInterrupt = 0
          McuMDMAPSystemResetInterrupt = 0
          McuResetDelayTime = DELAY_10_LPO_CYCLES
          McuSoftwareInterrupt = 0
          McuStopAcknowledgeErrorInterrupt = 0
          McuWatchdogInterrupt = 0
    McuPublishedInformation
      15 x McuResetReasonConf:
        MCU_CMU_LOSS_OF_CLOCK_RESET: McuResetReason=8
        MCU_CORE_LOCKUP_RESET: McuResetReason=3
        MCU_EXTERNAL_PIN_RESET: McuResetReason=6
        MCU_JTAG_RESET: McuResetReason=4
        MCU_LOSS_OF_CLOCK_RESET: McuResetReason=10
        MCU_LOSS_OF_LOCK_RESET: McuResetReason=9
        MCU_LOW_OR_HIGH_VOLTAGE_DETECT_RESET: McuResetReason=11
        MCU_MDM_AP_SYSTEM_RESET: McuResetReason=1
        MCU_MULTIPLE_RESET_REASON: McuResetReason=13
        MCU_NO_RESET_REASON: McuResetReason=12
        MCU_POWER_ON_RESET: McuResetReason=5
        MCU_RESET_UNDEFINED: McuResetReason=14
        MCU_STOP_ACKNOWLEDGE_ERROR_RESET: McuResetReason=0
        MCU_SW_RESET: McuResetReason=2
        MCU_WATCHDOG_RESET: McuResetReason=7
  module config LinIf
    LinIfGeneral:
      LinIfCancelTransmitSupported = false
      LinIfDevErrorDetect = false
      LinIfMultipleDriversSupported = false
      LinIfMultipleTrcvDriverSupported = false
      LinIfNcOptionalRequestSupported = false
      LinIfTpSupported = true
      LinIfTrcvDriverSupported = false
      LinIfVersionInfoApi = false
      LinIfSleepModeFrameDelay = 4.0
      LinIfWakeupSupported = false
    LinIfGlobalConfig: LinIfTimeBase=0.005
      LinIfChannel_RLM_RS (LinIfChannel):
        LinIfBusIdleTimeoutPeriod = 4.0
        LinIfGotoSleepConfirmationUL = LIN_SM
        GotoSleepConfirmation = LinSM_GotoSleepConfirmation
        LinIfStartupState = NORMAL
        LinIfWakeupConfirmationUL = LIN_SM
        WakeupConfirmation = LinSM_WakeupConfirmation
        LinIfGotoSleepIndicationUL = LIN_SM
        GotoSleepIndication = LinSM_GotoSleepIndication
        LinIfChannelRef = LinChannel_0
        LinIfComMNetworkHandleRef = ComMChannel_RLM_RS
        LinIfNodeType
          LinIfSlave: LinIfLinProtocolVersion=LIN22, LinIfResponseErrorSignal=RLM_RSResponseErr_RLM_RS_BCM_01
            LinIfNodeConfigurationIdentification: LinIfConfiguredNAD=70, LinIfFunctionId=25, LinIfInitialNAD=70, LinIfNasTimeout=1.0, LinIfSupplierId=332, LinIfVariantId=0
        LinIfLinDriverApi: LinGoToSleepInternal=Lin_GoToSleepInternal, LinWakeup=Lin_Wakeup, LinWakeupInternal=Lin_WakeupInternal, LinCheckWakeup=Lin_CheckWakeup
        5 x LinIfFrame:
          LinIfFrame_BCM_RLM_01: ProtectedId=76, LinIfFrameType=UNCONDITIONAL, LinIfChecksumType=ENHANCED, LinIfFrameId=12, LinIfFrameIndex=0
            LinIfPduDirection
              LinIfRxPdu: LinIfRxIndicationUL=PduR_LinIfRxIndication, LinIfUserRxIndicationUL=PDUR, LinIfRxPduRef=BCM_RLM_01
          LinIfFrame_BCM_RLM_02: ProtectedId=13, LinIfFrameType=UNCONDITIONAL, LinIfChecksumType=ENHANCED, LinIfFrameId=13, LinIfFrameIndex=1
            LinIfPduDirection
              LinIfRxPdu: LinIfRxIndicationUL=PduR_LinIfRxIndication, LinIfUserRxIndicationUL=PDUR, LinIfRxPduRef=BCM_RLM_02
          LinIfFrame_RLM_RS_BCM_01: ProtectedId=216, LinIfFrameType=UNCONDITIONAL, LinIfChecksumType=ENHANCED, LinIfFrameId=24, LinIfFrameIndex=2
            LinIfPduDirection
              LinIfTxPdu:
                LinIfTxPduId = LINIF_TXPDU_RLM_RS_BCM_01
                LinIfUserTxUL = PDUR
                LinIfTxTriggerTransmitUL = PduR_LinIfTriggerTransmit
                LinIfTxConfirmationUL = PduR_LinIfTxConfirmation
                LinIfTxPduRef = RLM_RS_BCM_01
          LinIfFrame_MasterReq: ProtectedId=60, LinIfFrameType=MRF, LinIfChecksumType=CLASSIC, LinIfFrameId=60, LinIfFrameIndex=3
            LinIfPduDirection
              LinIfRxPdu: LinIfRxIndicationUL=PduR_LinIfRxIndication, LinIfUserRxIndicationUL=PDUR
          LinIfFrame_SlaveResp: ProtectedId=125, LinIfFrameType=SRF, LinIfChecksumType=CLASSIC, LinIfFrameId=61, LinIfFrameIndex=4
            LinIfPduDirection
              LinIfTxPdu: LinIfTxPduId=LINIF_TXPDU_, LinIfUserTxUL=PDUR
      LinIfChannel_HCML (LinIfChannel):
        LinIfBusIdleTimeoutPeriod = 4
        LinIfGotoSleepConfirmationUL = LIN_SM
        GotoSleepConfirmation = LinSM_GotoSleepConfirmation
        LinIfStartupState = SLEEP
        LinIfWakeupConfirmationUL = LIN_SM
        WakeupConfirmation = LinSM_WakeupConfirmation
        LinIfGotoSleepIndicationUL = LIN_SM
        LinIfChannelRef = LinChannel_0
        LinIfComMNetworkHandleRef = ComMChannel_HCML
        LinIfNodeType
          LinIfSlave: LinIfLinProtocolVersion=LIN21, LinIfResponseErrorSignal=ErrRespHCML_HcmlZcud_Lin2Fr01
            LinIfNodeConfigurationIdentification: LinIfConfiguredNAD=42, LinIfFunctionId=0, LinIfInitialNAD=42, LinIfNasTimeout=1, LinIfSupplierId=0, LinIfVariantId=0
        LinIfLinDriverApi: LinGoToSleepInternal=Lin_GoToSleepInternal, LinWakeup=Lin_Wakeup, LinWakeupInternal=Lin_WakeupInternal, LinCheckWakeup=Lin_CheckWakeup
        5 x LinIfFrame:
          LinIfFrame_HcmlZcud_Lin2Fr01: ProtectedId=193, LinIfFrameType=UNCONDITIONAL, LinIfChecksumType=ENHANCED, LinIfFrameId=1, LinIfFrameIndex=0
            LinIfPduDirection
              LinIfTxPdu:
                LinIfTxPduId = LINIF_TXPDU_HcmlZcud_Lin2Fr01
                LinIfUserTxUL = PDUR
                LinIfTxTriggerTransmitUL = PduR_LinIfTriggerTransmit
                LinIfTxConfirmationUL = PduR_LinIfTxConfirmation
                LinIfTxPduRef = HcmlZcud_Lin2Fr01
          LinIfFrame_ZcudZcud_Lin2Fr01: ProtectedId=3, LinIfFrameType=UNCONDITIONAL, LinIfChecksumType=ENHANCED, LinIfFrameId=3, LinIfFrameIndex=1
            LinIfPduDirection
              LinIfRxPdu: LinIfRxIndicationUL=PduR_LinIfRxIndication, LinIfUserRxIndicationUL=PDUR, LinIfRxPduRef=ZcudZcud_Lin2Fr01
          LinIfFrame_ZcudZcud_Lin2Fr02: ProtectedId=196, LinIfFrameType=UNCONDITIONAL, LinIfChecksumType=ENHANCED, LinIfFrameId=4, LinIfFrameIndex=2
            LinIfPduDirection
              LinIfRxPdu: LinIfRxIndicationUL=PduR_LinIfRxIndication, LinIfUserRxIndicationUL=PDUR, LinIfRxPduRef=ZcudZcud_Lin2Fr02
          LinIfFrame_MasterReq: ProtectedId=60, LinIfFrameType=MRF, LinIfChecksumType=CLASSIC, LinIfFrameId=60, LinIfFrameIndex=3
            LinIfPduDirection
              LinIfRxPdu: LinIfRxIndicationUL=PduR_LinIfRxIndication, LinIfUserRxIndicationUL=PDUR
          LinIfFrame_SlaveResp: ProtectedId=125, LinIfFrameType=SRF, LinIfChecksumType=CLASSIC, LinIfFrameId=61, LinIfFrameIndex=4
            LinIfPduDirection
              LinIfTxPdu: LinIfTxPduId=LINIF_TXPDU_, LinIfUserTxUL=PDUR, LinIfTxTriggerTransmitUL=PduR_LinIfTriggerTransmit, LinIfTxConfirmationUL=PduR_LinIfTxConfirmation
    LinTpGeneral: LinTpChangeParameterApi=false, LinTpVersionInfoApi=false
    LinTpGlobalConfig: LinTpMaxNumberOfRespPendingFrames=5, LinTpP2Max=2.0, LinTpP2Timing=0.5
      LinTpRxNSdu_RLM_RS (LinTpRxNSdu):
        LinTpRxNSduId = LINTP_RXPDU_RLM_RS_MasterReq
        LinTpRxNSduNad = 70
        LinTpNcr = 1.0
        LinTpLinDriverChannelRef = LinChannel_0
        LinTpRxNSduPduRef = RLM_RS_MasterReq
        LinTpRxNSduChannelRef = ComMChannel_RLM_RS
      LinTpTxNSdu_RLM_RS (LinTpTxNSdu):
        LinTpMaxBufReq = 10
        LinTpNas = 0.5
        LinTpTxNSduId = LINTP_TXPDU_RLM_RS_SlaveResp
        LinTpTxNSduNad = 70
        LinTpNcs = 0.3
        LinTpLinDriverChannelRef = LinChannel_0
        LinTpTxNSduPduRef = RLM_RS_SlaveResp
        LinTpTxNSduChannelRef = ComMChannel_RLM_RS
      LinTpChannelConfig_RLM_RS (LinTpChannelConfig): LinTpDropNotRequestedNad=true, LinTpScheduleChangeDiag=true, LinTpLinDriverChannelRef=LinChannel_0, LinTpChannelRef=ComMChannel_RLM_RS
      LinTpRxNSdu_Fun (LinTpRxNSdu):
        LinTpRxNSduId = LINTP_RXPDU_RLM_RS_MasterReq_Fun
        LinTpRxNSduNad = 126
        LinTpNcr = 1.0
        LinTpLinDriverChannelRef = LinChannel_0
        LinTpRxNSduPduRef = RLM_RS_MasterReq_Fun
        LinTpRxNSduChannelRef = ComMChannel_RLM_RS
      LinTpRxNSdu_HCML (LinTpRxNSdu):
        LinTpRxNSduId = LINTP_RXPDU_HCML_MasterReq
        LinTpRxNSduNad = 42
        LinTpNcr = 1.0
        LinTpLinDriverChannelRef = LinChannel_0
        LinTpRxNSduPduRef = HCML_MasterReq
        LinTpRxNSduChannelRef = ComMChannel_HCML
      LinTpTxNSdu_HCML (LinTpTxNSdu):
        LinTpMaxBufReq = 10
        LinTpNas = 0.5
        LinTpTxNSduId = LINTP_TXPDU_HCML_SlaveResp
        LinTpTxNSduNad = 42
        LinTpLinDriverChannelRef = LinChannel_0
        LinTpTxNSduPduRef = HCML_SlaveResp
        LinTpTxNSduChannelRef = ComMChannel_HCML
      LinTpChannelConfig_HCML (LinTpChannelConfig): LinTpDropNotRequestedNad=true, LinTpScheduleChangeDiag=true, LinTpLinDriverChannelRef=LinChannel_0, LinTpChannelRef=ComMChannel_HCML
  module config WdgM
    WdgMGeneral:
      WdgMDevErrorDetect = false
      WdgMImmediateReset = false
      WdgMOffModeEnabled = true
      WdgMVersionInfoApi = false
      FIRST_EXPIRED_SEID = 536870904
      FIRST_EXPIRED_INVERSE_SEID = 536870908
      WdgMWatchdog_0 (WdgMWatchdog): WdgMWatchdogName=WdgIfExternalDevice_0, WdgMWatchdogDeviceRef=WdgIfExternalDevice_0
      WdgMSupervisedEntity_0 (WdgMSupervisedEntity):
        WdgMSupervisedEntityId = 1
        WdgMInternalTransitionId = 0
        WdgMInternalCheckpointInitialRef = SE0_WdgMCheckpoint_3
        WdgMInternallCheckpointFinalRef = SE0_WdgMCheckpoint_4
        SE0_WdgMCheckpoint_0 (WdgMCheckpoint): WdgMCheckpointId=0
        WdgMInternalTransition_0 (WdgMInternalTransition): WdgMInternalTransitionSourceRef=SE0_WdgMCheckpoint_3, WdgMInternalTransitionDestRef=SE0_WdgMCheckpoint_4
        4 x WdgMCheckpoint:
          SE0_WdgMCheckpoint_{1..4}: WdgMCheckpointId={1..4}
    WdgMConfigSet: WdgMInitialMode=WdgMMode_Slow
      3 x WdgMMode, all with WdgMExpiredSupervisionCycleTol=0, WdgMSupervisionCycle=0.0:
        WdgMMode_OffMode: WdgMModeId=0
          WdgMTrigger: WdgMTriggerConditionValue=1, WdgMWatchdogMode=WDGIF_OFF_MODE, WdgMTriggerWatchdogRef=WdgMWatchdog_0
        WdgMMode_Slow: WdgMModeId=1
          WdgMTrigger_0 (WdgMTrigger): WdgMTriggerConditionValue=10000, WdgMWatchdogMode=WDGIF_SLOW_MODE, WdgMTriggerWatchdogRef=WdgMWatchdog_0
          WdgMAliveSupervision_0 (WdgMAliveSupervision):
            WdgMAliveSupervisionId = 0
            WdgMExpectedAliveIndications = 0
            WdgMMaxMargin = 3
            WdgMMinMargin = 1
            WdgMSupervisionReferenceCycle = 1
            WdgMAliveSupervisionCheckpointRef = SE0_WdgMCheckpoint_0
          WdgMLocalStatusParams_0 (WdgMLocalStatusParams): WdgMFailedAliveSupervisionRefCycleTol=0, WdgMLocalStatusSupervisedEntityRef=WdgMSupervisedEntity_0
          WdgMDeadlineSupervision_0 (WdgMDeadlineSupervision):
            WdgMDeadlineSupervisionId = 0
            WdgMDeadlineMax = 0.006
            WdgMDeadlineMin = 0.004
            WdgMEnableTimeoutDetection = true
            WdgMDeadlineStartRef = SE0_WdgMCheckpoint_1
            WdgMDeadlineStopRef = SE0_WdgMCheckpoint_2
        WdgMMode_Fast: WdgMModeId=2
          WdgMTrigger_0 (WdgMTrigger): WdgMTriggerConditionValue=100, WdgMWatchdogMode=WDGIF_FAST_MODE, WdgMTriggerWatchdogRef=WdgMWatchdog_0
          WdgMAliveSupervision_0 (WdgMAliveSupervision):
            WdgMAliveSupervisionId = 0
            WdgMExpectedAliveIndications = 4
            WdgMMaxMargin = 1
            WdgMMinMargin = 1
            WdgMSupervisionReferenceCycle = 1
            WdgMAliveSupervisionCheckpointRef = SE0_WdgMCheckpoint_0
          WdgMLocalStatusParams_0 (WdgMLocalStatusParams): WdgMFailedAliveSupervisionRefCycleTol=0, WdgMLocalStatusSupervisedEntityRef=WdgMSupervisedEntity_0
  module config LinSM
    LinSMGeneral:
      LinSMVariantCfg = LINSM_VARIANT_PC
      LinSMDevErrorDetect = false
      LinSMMainProcessingPeriod = 0.01
      LinSMVersionInfoApi = false
      LinSMTransceiverPassiveModeSupport = false
    LinSMConfigSet: LinSMModeRequestRepetitionMax=2
      LinSMChannel_RLM_RS (LinSMChannel): LinSMConfirmationTimeout=10, LinSMNodeType=SLAVE, LinSMTransceiverPassiveMode=false, LinSMComMNetworkHandleRef=ComMChannel_RLM_RS
      LinSMChannel_HCML (LinSMChannel): LinSMConfirmationTimeout=10, LinSMNodeType=SLAVE, LinSMTransceiverPassiveMode=false, LinSMComMNetworkHandleRef=ComMChannel_HCML
  module config Dcm
    DcmGeneral:
      DcmDevErrorDetect = false
      DcmRespondAllRequest = true
      DcmTaskTime = 0.01
      DcmVersionInfoApi = false
      PreemptionProtocolCancelSupport = false
      DcmDDDIDStorage = false
    DcmConfigSet
      DcmDsd: DcmDsdRequestManufacturerNotificationEnabled=false, DcmDsdRequestSupplierNotificationEnabled=false
        DcmDsdServiceTable: DcmDsdSidTabId=0
          12 x DcmDsdService, all with DcmDsdServiceUsed=true:
            DcmDsdService_10: DcmDsdSidTabFnc=Dcm_UDS0x10, DcmDsdSidTabServiceId=16, DcmDsdSidTabSubfuncAvail=true, DcmDsdSidTabAddressingFormat=PHYANDFUNC
              4 x DcmDsdSubService, all with DcmDsdSubServiceUsed=true:
                DcmDsdSubService_1001: DcmDsdSubServiceId=1
                DcmDsdSubService_1002: DcmDsdSubServiceId=2, DcmDsdSubServiceSessionLevelRef=DcmDspSessionRow_03, DcmDsdSubServiceSessionLevelRef=DcmDspSessionRow_02, DcmDsdSubServiceSessionLevelRef=DcmDspSessionRow_70
                DcmDsdSubService_1003: DcmDsdSubServiceId=3, DcmDsdSubServiceSessionLevelRef=DcmDspSessionRow_01, DcmDsdSubServiceSessionLevelRef=DcmDspSessionRow_03, DcmDsdSubServiceSessionLevelRef=DcmDspSessionRow_70
                DcmDsdSubService_1070: DcmDsdSubServiceId=112
            DcmDsdService_11: DcmDsdSidTabFnc=Dcm_UDS0x11, DcmDsdSidTabServiceId=17, DcmDsdSidTabSubfuncAvail=true, DcmDsdSidTabAddressingFormat=PHYANDFUNC, DcmDsdSidTabSessionLevelRef=DcmDspSessionRow_03
              DcmDsdSubService_01_Hardware (DcmDsdSubService): DcmDsdSubServiceId=1, DcmDsdSubServiceUsed=true
            DcmDsdService_14: DcmDsdSidTabFnc=Dcm_UDS0x14, DcmDsdSidTabServiceId=20, DcmDsdSidTabSubfuncAvail=false, DcmDsdSidTabAddressingFormat=PHYANDFUNC, DcmDsdSidTabSessionLevelRef=DcmDspSessionRow_01, DcmDsdSidTabSessionLevelRef=DcmDspSessionRow_02, DcmDsdSidTabSessionLevelRef=DcmDspSessionRow_03
            DcmDsdService_19: DcmDsdSidTabFnc=Dcm_UDS0x19, DcmDsdSidTabServiceId=25, DcmDsdSidTabSubfuncAvail=true, DcmDsdSidTabAddressingFormat=PHYANDFUNC, DcmDsdSidTabSessionLevelRef=DcmDspSessionRow_01, DcmDsdSidTabSessionLevelRef=DcmDspSessionRow_02, DcmDsdSidTabSessionLevelRef=DcmDspSessionRow_03
              4 x DcmDsdSubService, all with DcmDsdSubServiceUsed=true:
                DcmDsdSubService_1: DcmDsdSubServiceId=1
                DcmDsdSubService_2: DcmDsdSubServiceId=2
                DcmDsdSubService_6: DcmDsdSubServiceId=6
                DcmDsdSubService_A: DcmDsdSubServiceId=10
            DcmDsdService_22: DcmDsdSidTabFnc=Dcm_UDS0x22, DcmDsdSidTabServiceId=34, DcmDsdSidTabSubfuncAvail=false, DcmDsdSidTabAddressingFormat=PHYANDFUNC
            DcmDsdService_27: DcmDsdSidTabFnc=Dcm_UDS0x27, DcmDsdSidTabServiceId=39, DcmDsdSidTabSubfuncAvail=true, DcmDsdSidTabAddressingFormat=PHYSICAL, DcmDsdSidTabSessionLevelRef=DcmDspSessionRow_03, DcmDsdSidTabSessionLevelRef=DcmDspSessionRow_02
              6 x DcmDsdSubService, all with DcmDsdSubServiceUsed=true:
                DcmDsdSubService_2701: DcmDsdSubServiceId=1, DcmDsdSubServiceSessionLevelRef=DcmDspSessionRow_03
                DcmDsdSubService_2702: DcmDsdSubServiceId=2, DcmDsdSubServiceSessionLevelRef=DcmDspSessionRow_03
                DcmDsdSubService_2703: DcmDsdSubServiceId=3, DcmDsdSubServiceSessionLevelRef=DcmDspSessionRow_03
                DcmDsdSubService_2704: DcmDsdSubServiceId=4, DcmDsdSubServiceSessionLevelRef=DcmDspSessionRow_03
                DcmDsdSubService_2707: DcmDsdSubServiceId=7, DcmDsdSubServiceSessionLevelRef=DcmDspSessionRow_02
                DcmDsdSubService_2708: DcmDsdSubServiceId=8, DcmDsdSubServiceSessionLevelRef=DcmDspSessionRow_02
            DcmDsdService_28: DcmDsdSidTabFnc=Dcm_UDS0x28, DcmDsdSidTabServiceId=40, DcmDsdSidTabSubfuncAvail=true, DcmDsdSidTabAddressingFormat=PHYANDFUNC, DcmDsdSidTabSessionLevelRef=DcmDspSessionRow_03
              DcmDsdSubService_0 (DcmDsdSubService): DcmDsdSubServiceId=0, DcmDsdSubServiceUsed=true, DcmDsdSubServiceSessionLevelRef=DcmDspSessionRow_03
              DcmDsdSubService_1 (DcmDsdSubService): DcmDsdSubServiceId=1, DcmDsdSubServiceUsed=true, DcmDsdSubServiceSessionLevelRef=DcmDspSessionRow_03
            DcmDsdService_2E: DcmDsdSidTabFnc=Dcm_UDS0x2E, DcmDsdSidTabServiceId=46, DcmDsdSidTabSubfuncAvail=false, DcmDsdSidTabAddressingFormat=PHYSICAL, DcmDsdSidTabSessionLevelRef=DcmDspSessionRow_03, DcmDsdSidTabSessionLevelRef=DcmDspSessionRow_02, DcmDsdSidTabSessionLevelRef=DcmDspSessionRow_70
            DcmDsdService_2F: DcmDsdSidTabFnc=Dcm_UDS0x2F, DcmDsdSidTabServiceId=47, DcmDsdSidTabSubfuncAvail=false, DcmDsdSidTabAddressingFormat=PHYSICAL, DcmDsdSidTabSecurityLevelRef=DcmDspSecurityRow_1, DcmDsdSidTabSessionLevelRef=DcmDspSessionRow_03, DcmDsdSidTabSecurityLevelRef=DcmDspSecurityRow_2
            DcmDsdService_31: DcmDsdSidTabFnc=Dcm_UDS0x31, DcmDsdSidTabServiceId=49, DcmDsdSidTabSubfuncAvail=true, DcmDsdSidTabAddressingFormat=PHYSICAL, DcmDsdSidTabSessionLevelRef=DcmDspSessionRow_03, DcmDsdSidTabSessionLevelRef=DcmDspSessionRow_02
              DcmDsdSubService_01 (DcmDsdSubService):
                DcmDsdSubServiceId = 1
                DcmDsdSubServiceUsed = true
                DcmDsdSubServiceSessionLevelRef = DcmDspSessionRow_02
                DcmDsdSubServiceSessionLevelRef = DcmDspSessionRow_03
            DcmDsdService_3E: DcmDsdSidTabFnc=Dcm_UDS0x3E, DcmDsdSidTabServiceId=62, DcmDsdSidTabSubfuncAvail=true, DcmDsdSidTabAddressingFormat=PHYANDFUNC
              DcmDsdSubService_00 (DcmDsdSubService): DcmDsdSubServiceId=0, DcmDsdSubServiceUsed=true
            DcmDsdService_85: DcmDsdSidTabFnc=Dcm_UDS0x85, DcmDsdSidTabServiceId=133, DcmDsdSidTabSubfuncAvail=true, DcmDsdSidTabAddressingFormat=PHYANDFUNC, DcmDsdSidTabSessionLevelRef=DcmDspSessionRow_03
              DcmDsdSubService_01 (DcmDsdSubService): DcmDsdSubServiceId=1, DcmDsdSubServiceUsed=true
              DcmDsdSubService_02 (DcmDsdSubService): DcmDsdSubServiceId=2, DcmDsdSubServiceUsed=true
      DcmDsl
        DcmDslBuffer_Rx (DcmDslBuffer): DcmDslBufferSize=256
        DcmDslDiagResp: DcmDslDiagRespMaxNumRespPend=255, DcmDslDiagRespOnSecondDeclinedRequest=false
        DcmDslProtocol
          DcmDslProtocolRow:
            DcmDslProtocolID = DCM_UDS_ON_CAN
            DcmDslProtocolPreemptTimeout = 0.0
            DcmDslProtocolPriority = 0
            DcmDslProtocolRowUsed = true
            DcmSendRespPendOnTransToBoot = true
            DcmTimStrP2ServerAdjust = 0.0
            DcmTimStrP2StarServerAdjust = 0.0
            DcmDslProtocolRxBufferRef = DcmDslBuffer_Rx
            DcmDslProtocolSIDTable = DcmDsdServiceTable
            DcmDslProtocolTxBufferRef = DcmDslBuffer_Tx
            DcmDslConnection
              DcmDslMainConnection: DcmDslProtocolComMChannelRef=ComMChannel_RLM_RS
                DcmDslProtocolRx_Phy (DcmDslProtocolRx): DcmDslProtocolRxAddrType=DCM_PHYSICAL_TYPE, DcmDslProtocolRxPduId=DCM_Dcm_RLM_RS_MasterReq, DcmDslProtocolRxPduRef=Dcm_RLM_RS_MasterReq
                DcmDslProtocolTx: DcmDslTxConfirmationPduId=DCM_Dcm_RLM_RS_SlaveResp, DcmDslProtocolTxPduRef=Dcm_RLM_RS_SlaveResp
                DcmDslProtocolRx_Fun (DcmDslProtocolRx):
                  DcmDslProtocolRxAddrType = DCM_FUNCTIONAL_TYPE
                  DcmDslProtocolRxPduId = DCM_Dcm_RLM_RS_MasterReq_Fun
                  DcmDslProtocolRxPduRef = Dcm_RLM_RS_MasterReq_Fun
        DcmDslBuffer_Tx (DcmDslBuffer): DcmDslBufferSize=256
      DcmPageBufferCfg: DcmPagedBufferEnabled=false
      DcmDsp: DcmDspDataDefaultEndianness=BIG_ENDIAN, DcmDspEnableObdMirror=false, DcmResponseToEcuReset=AFTER_RESET
        DcmDspSecurity
          3 x DcmDspSecurityRow, all with DcmDspSecurityAttemptCounterEnabled=true, DcmDspSecurityUsePort=USE_ASYNCH_FNC, DcmDspSecurityDelayTime=10.0, DcmDspSecurityDelayTimeOnBoot=0.0, DcmDspSecurityKeySize=4, DcmDspSecurityNumAttDelay=3, DcmDspSecuritySeedSize=4:
            DcmDspSecurityRow_1: DcmDspSecurityCompareKeyFnc=Rte_Call_Dcm_SecurityAccess_DcmDspSecurityRow_1_CompareKey, DcmDspSecurityGetAttemptCounterFnc=Rte_Call_Dcm_SecurityAccess_DcmDspSecurityRow_1_GetSecurityAttemptCounter, DcmDspSecurityGetSeedFnc=Rte_Call_Dcm_SecurityAccess_DcmDspSecurityRow_1_GetSeed, DcmDspSecurityLevel=1, DcmDspSecuritySetAttemptCounterFnc=Rte_Call_Dcm_SecurityAccess_DcmDspSecurityRow_1_SetSecurityAttemptCounter
            DcmDspSecurityRow_2: DcmDspSecurityCompareKeyFnc=Rte_Call_Dcm_SecurityAccess_DcmDspSecurityRow_2_CompareKey, DcmDspSecurityGetAttemptCounterFnc=Rte_Call_Dcm_SecurityAccess_DcmDspSecurityRow_2_GetSecurityAttemptCounter, DcmDspSecurityGetSeedFnc=Rte_Call_Dcm_SecurityAccess_DcmDspSecurityRow_2_GetSeed, DcmDspSecurityLevel=2, DcmDspSecuritySetAttemptCounterFnc=Rte_Call_Dcm_SecurityAccess_DcmDspSecurityRow_2_SetSecurityAttemptCounter
            DcmDspSecurityRow_4: DcmDspSecurityCompareKeyFnc=NULL_PTR, DcmDspSecurityGetAttemptCounterFnc=NULL_PTR, DcmDspSecurityGetSeedFnc=NULL_PTR, DcmDspSecurityLevel=4, DcmDspSecuritySetAttemptCounterFnc=NULL_PTR
        DcmDspSession
          4 x DcmDspSessionRow, all with DcmDspSessionP2ServerMax=0.05, DcmDspSessionP2StarServerMax=2.0:
            DcmDspSessionRow_01: DcmDspSessionForBoot=DCM_NO_BOOT, DcmDspSessionLevel=1
            DcmDspSessionRow_02: DcmDspSessionForBoot=DCM_SYS_BOOT, DcmDspSessionLevel=2
            DcmDspSessionRow_03: DcmDspSessionForBoot=DCM_NO_BOOT, DcmDspSessionLevel=3
            DcmDspSessionRow_70: DcmDspSessionForBoot=DCM_NO_BOOT, DcmDspSessionLevel=112
        DcmDspComControl
          DcmDspComControlAllChannel_0 (DcmDspComControlAllChannel): DcmDspComControlAllChannelUsed=true, DcmDspAllComMChannelRef=ComMChannel_RLM_RS
        DcmDspControlDTCSetting
        DcmDspData_F193 (DcmDspData):
          DcmDspDataUsePort = USE_DATA_SYNCH_FNC
          DcmDspDataType = UINT8
          DcmDspDataConditionCheckReadFnc = NULL_PTR
          DcmDspDataFreezeCurrentStateFnc = NULL_PTR
          DcmDspDataGetScalingInfoFnc = NULL_PTR
          DcmDspDataReadDataLengthFnc = NULL_PTR
          DcmDspDataReadFnc = DcmDspDataReadF193
          DcmDspDataResetToDefaultFnc = NULL_PTR
          DcmDspDataReturnControlToEcuFnc = NULL_PTR
          DcmDspDataShortTermAdjustmentFnc = NULL_PTR
          DcmDspDataWriteFnc = NULL_PTR
          DcmDspDataSize = 32
          DcmDspDataConditionCheckReadFncUsed = false
          DcmDspDataEndianness = BIG_ENDIAN
          DcmDspDidInfoRef = DcmDspDidInfo_ReadOnly
        DcmDspDid_F193 (DcmDspDid): DcmDspDidIdentifier=61843, DcmDspDidUsed=true, DcmDspDidInfoRef=DcmDspDidInfo_ReadOnly
          DcmDspDidSignal_F193 (DcmDspDidSignal): DcmDspDidDataPos=0, DcmDspDidDataRef=DcmDspData_F193
        DcmDspDidInfo_ReadOnly (DcmDspDidInfo): DcmDspDidDynamicallyDefined=false
          DcmDspDidRead: DcmDspDidReadSessionRef=DcmDspSessionRow_01, DcmDspDidReadSessionRef=DcmDspSessionRow_03, DcmDspDidReadSessionRef=DcmDspSessionRow_70
        DcmDspDid_F195 (DcmDspDid): DcmDspDidIdentifier=61845, DcmDspDidUsed=true, DcmDspDidInfoRef=DcmDspDidInfo_ReadOnly
          DcmDspDidSignal_F195 (DcmDspDidSignal): DcmDspDidDataPos=0, DcmDspDidDataRef=DcmDspData_F195
        DcmDspData_F195 (DcmDspData):
          DcmDspDataUsePort = USE_DATA_SYNCH_FNC
          DcmDspDataType = UINT8
          DcmDspDataConditionCheckReadFnc = NULL_PTR
          DcmDspDataFreezeCurrentStateFnc = NULL_PTR
          DcmDspDataGetScalingInfoFnc = NULL_PTR
          DcmDspDataReadDataLengthFnc = NULL_PTR
          DcmDspDataReadFnc = DcmDspDataReadF195
          DcmDspDataResetToDefaultFnc = NULL_PTR
          DcmDspDataReturnControlToEcuFnc = NULL_PTR
          DcmDspDataShortTermAdjustmentFnc = NULL_PTR
          DcmDspDataWriteFnc = NULL_PTR
          DcmDspDataSize = 32
          DcmDspDataConditionCheckReadFncUsed = false
          DcmDspDataEndianness = BIG_ENDIAN
          DcmDspDidInfoRef = DcmDspDidInfo_ReadOnly
        DcmDspRoutine_0203 (DcmDspRoutine): DcmDspRoutineIdentifier=515, DcmDspRoutineUsed=true, DcmDspCommonAuthorizationRef=DcmDspCommonAuthorization_0
          DcmDspStartRoutine: DcmDspStartRoutineFnc=Rte_DcmRoutineStart_0203, DcmDspStartRoutineCommonAuthorizationRef=DcmDspCommonAuthorization_0
            DcmDspStartRoutineIn
              DcmDspStartRoutineInSignal_0 (DcmDspStartRoutineInSignal): DcmDspRoutineSignalPos=0, DcmDspRoutineSignalType=SINT16
            DcmDspStartRoutineOut
              DcmDspStartRoutineOutSignal_0 (DcmDspStartRoutineOutSignal): DcmDspRoutineSignalType=SINT32, DcmDspRoutineSignalLength=8, DcmDspRoutineSignalPos=0
        DcmDspCommonAuthorization_0 (DcmDspCommonAuthorization): DcmDspCommonAuthorizationSessionRef=DcmDspSessionRow_02, DcmDspCommonAuthorizationSessionRef=DcmDspSessionRow_03
        DcmDspClearDTC
        DcmDspData_4B40 (DcmDspData):
          DcmDspDataUsePort = USE_DATA_SYNCH_FNC
          DcmDspDataType = UINT8
          DcmDspDataConditionCheckReadFnc = NULL_PTR
          DcmDspDataFreezeCurrentStateFnc = NULL_PTR
          DcmDspDataGetScalingInfoFnc = NULL_PTR
          DcmDspDataReadDataLengthFnc = NULL_PTR
          DcmDspDataReadFnc = DcmDspDataRead_4B40
          DcmDspDataResetToDefaultFnc = NULL_PTR
          DcmDspDataReturnControlToEcuFnc = Rte_ReturnControlToECU_4B40
          DcmDspDataShortTermAdjustmentFnc = Rte_ShortTermAdjustment_4B40
          DcmDspDataWriteFnc = NULL_PTR
          DcmDspDataSize = 8
          DcmDspDidInfoRef = DcmDspDidInfo_ReadOnly
        DcmDspDidInfo_22And2F (DcmDspDidInfo): DcmDspDidDynamicallyDefined=false
          DcmDspDidRead
          DcmDspDidControl:
            DcmDspDidControlMask = DCM_CONTROLMASK_EXTERNAL
            DcmDspDidFreezeCurrentState = false
            DcmDspDidResetToDefault = false
            DcmDspDidShortTermAdjustment = true
            DcmDspDidControlMaskSize = 1
            DcmDspDidControlSessionRef = DcmDspSessionRow_03
            DcmDspDidControlSecurityLevelRef = DcmDspSecurityRow_2
            DcmDspDidControlEnableMask: DcmDspDidControlMaskBitPosition=0
        DcmDspDid_4B40 (DcmDspDid): DcmDspDidIdentifier=19264, DcmDspDidUsed=true, DcmDspDidInfoRef=DcmDspDidInfo_22And2F
          DcmDspDidSignal_0 (DcmDspDidSignal): DcmDspDidDataPos=0, DcmDspDidDataRef=DcmDspData_4B40
        DcmDspDidInfo_22And2E (DcmDspDidInfo): DcmDspDidDynamicallyDefined=false
          DcmDspDidRead
          DcmDspDidWrite:
            DcmDspDidWriteSessionRef = DcmDspSessionRow_03
            DcmDspDidWriteSecurityLevelRef = DcmDspSecurityRow_1
            DcmDspDidWriteSecurityLevelRef = DcmDspSecurityRow_2
            DcmDspDidWriteSecurityLevelRef = DcmDspSecurityRow_4
        17 x DcmDspDid, all with DcmDspDidUsed=true:
          DcmDspDid_F010: DcmDspDidIdentifier=61456, DcmDspDidInfoRef=DcmDspDidInfo_ReadOnly
            DcmDspDidSignal_F010 (DcmDspDidSignal): DcmDspDidDataPos=0, DcmDspDidDataRef=DcmDspData_F010TBD
          DcmDspDid_F110: DcmDspDidIdentifier=61712, DcmDspDidInfoRef=DcmDspDidInfo_WriteOnFactor
            DcmDspDidSignal_F110 (DcmDspDidSignal): DcmDspDidDataPos=0, DcmDspDidDataRef=DcmDspData_F110
          DcmDspDid_F111: DcmDspDidIdentifier=61713, DcmDspDidInfoRef=DcmDspDidInfo_WriteOnFactor
            DcmDspDidSignal_F111 (DcmDspDidSignal): DcmDspDidDataPos=0, DcmDspDidDataRef=DcmDspData_F111
          DcmDspDid_F118: DcmDspDidIdentifier=61720, DcmDspDidInfoRef=DcmDspDidInfo_ReadOnly
            DcmDspDidSignal_F118 (DcmDspDidSignal): DcmDspDidDataPos=0, DcmDspDidDataRef=DcmDspData_F118
          DcmDspDid_F119: DcmDspDidIdentifier=61721, DcmDspDidInfoRef=DcmDspDidInfo_ReadOnly
            DcmDspDidSignal_F119 (DcmDspDidSignal): DcmDspDidDataPos=0, DcmDspDidDataRef=DcmDspData_F119
          DcmDspDid_F15B: DcmDspDidIdentifier=61787, DcmDspDidInfoRef=DcmDspDidInfo_ReadOnly_NoDefault
            DcmDspDidSignal_F15B (DcmDspDidSignal): DcmDspDidDataPos=0, DcmDspDidDataRef=DcmDspData_F15B
          DcmDspDid_F186: DcmDspDidIdentifier=61830, DcmDspDidInfoRef=DcmDspDidInfo_ReadOnly
            DcmDspDidSignal_F186 (DcmDspDidSignal): DcmDspDidDataPos=0, DcmDspDidDataRef=DcmDspData_F186
          DcmDspDid_F187: DcmDspDidIdentifier=61831, DcmDspDidInfoRef=DcmDspDidInfo_22And2E
            DcmDspDidSignal_F187 (DcmDspDidSignal): DcmDspDidDataPos=0, DcmDspDidDataRef=DcmDspData_F187
          DcmDspDid_F18A: DcmDspDidIdentifier=61834, DcmDspDidInfoRef=DcmDspDidInfo_ReadOnly
            DcmDspDidSignal_F18A (DcmDspDidSignal): DcmDspDidDataPos=0, DcmDspDidDataRef=DcmDspData_F18A
          DcmDspDid_F18B: DcmDspDidIdentifier=61835, DcmDspDidInfoRef=DcmDspDidInfo_WriteOnFactor
            DcmDspDidSignal_F18B (DcmDspDidSignal): DcmDspDidDataPos=0, DcmDspDidDataRef=DcmDspData_F18B
          DcmDspDid_F18C: DcmDspDidIdentifier=61836, DcmDspDidInfoRef=DcmDspDidInfo_WriteOnFactor
            DcmDspDidSignal_F18C (DcmDspDidSignal): DcmDspDidDataPos=0, DcmDspDidDataRef=DcmDspData_F18C
          DcmDspDid_F192: DcmDspDidIdentifier=61842, DcmDspDidInfoRef=DcmDspDidInfo_ReadOnly
            DcmDspDidSignal_F192 (DcmDspDidSignal): DcmDspDidDataPos=0, DcmDspDidDataRef=DcmDspData_F192TBD
          DcmDspDid_F194: DcmDspDidIdentifier=61844, DcmDspDidInfoRef=DcmDspDidInfo_ReadOnly
            DcmDspDidSignal_F194 (DcmDspDidSignal): DcmDspDidDataPos=0, DcmDspDidDataRef=DcmDspData_F194TBD
          DcmDspDid_F197: DcmDspDidIdentifier=61847, DcmDspDidInfoRef=DcmDspDidInfo_ReadOnly
            DcmDspDidSignal_F197 (DcmDspDidSignal): DcmDspDidDataPos=0, DcmDspDidDataRef=DcmDspData_F197
          DcmDspDid_F199: DcmDspDidIdentifier=61849, DcmDspDidInfoRef=DcmDspDidInfo_ReadOnly
            DcmDspDidSignal_F199 (DcmDspDidSignal): DcmDspDidDataPos=0, DcmDspDidDataRef=DcmDspData_F199
          DcmDspDid_F19E: DcmDspDidIdentifier=61854, DcmDspDidInfoRef=DcmDspDidInfo_ReadOnly
            DcmDspDidSignal_F19E (DcmDspDidSignal): DcmDspDidDataPos=0, DcmDspDidDataRef=DcmDspData_F19E
          DcmDspDid_F150: DcmDspDidIdentifier=61776, DcmDspDidInfoRef=DcmDspDidInfo_ReadOnly
            DcmDspDidSignal_F150 (DcmDspDidSignal): DcmDspDidDataPos=0, DcmDspDidDataRef=DcmDspData_F150
        17 x DcmDspData, all with DcmDspDataType=UINT8, DcmDspDataConditionCheckReadFnc=NULL_PTR, DcmDspDataFreezeCurrentStateFnc=NULL_PTR, DcmDspDataGetScalingInfoFnc=NULL_PTR, DcmDspDataReadDataLengthFnc=NULL_PTR, DcmDspDataResetToDefaultFnc=NULL_PTR, DcmDspDataReturnControlToEcuFnc=NULL_PTR, DcmDspDataShortTermAdjustmentFnc=NULL_PTR, DcmDspDataConditionCheckReadFncUsed=false, DcmDspDataEndianness=BIG_ENDIAN:
          DcmDspData_F010TBD: DcmDspDataUsePort=USE_DATA_SYNCH_FNC, DcmDspDataReadFnc=DcmDspDataReadF010, DcmDspDataWriteFnc=NULL_PTR, DcmDspDataSize=32
          DcmDspData_F110: DcmDspDataUsePort=USE_DATA_SYNCH_FNC, DcmDspDataReadFnc=DcmDspDataReadF110, DcmDspDataWriteFnc=Rte_WriteData_F110, DcmDspDataSize=88
          DcmDspData_F111: DcmDspDataUsePort=USE_DATA_SYNCH_FNC, DcmDspDataReadFnc=DcmDspDataReadF111, DcmDspDataWriteFnc=Rte_WriteData_F111, DcmDspDataSize=16
          DcmDspData_F118: DcmDspDataUsePort=USE_DATA_SYNCH_FNC, DcmDspDataReadFnc=DcmDspDataReadF118, DcmDspDataWriteFnc=NULL_PTR, DcmDspDataSize=88
          DcmDspData_F119: DcmDspDataUsePort=USE_DATA_SYNCH_FNC, DcmDspDataReadFnc=DcmDspDataReadF119, DcmDspDataWriteFnc=NULL_PTR, DcmDspDataSize=16
          DcmDspData_F15B: DcmDspDataUsePort=USE_DATA_SYNCH_FNC, DcmDspDataReadFnc=DcmDspDataReadF15B, DcmDspDataWriteFnc=NULL_PTR, DcmDspDataSize=96
          DcmDspData_F186: DcmDspDataUsePort=USE_DATA_SYNCH_FNC, DcmDspDataReadFnc=DcmDspDataReadF186, DcmDspDataWriteFnc=NULL_PTR, DcmDspDataSize=8
          DcmDspData_F187: DcmDspDataUsePort=USE_DATA_ASYNCH_FNC_ERROR, DcmDspDataReadFnc=DcmDspDataReadF187, DcmDspDataWriteFnc=Rte_WriteData_F187, DcmDspDataSize=88
          DcmDspData_F18A: DcmDspDataUsePort=USE_DATA_SYNCH_FNC, DcmDspDataReadFnc=DcmDspDataReadF18A, DcmDspDataWriteFnc=NULL_PTR, DcmDspDataSize=64
          DcmDspData_F18B: DcmDspDataUsePort=USE_DATA_SYNCH_FNC, DcmDspDataReadFnc=DcmDspDataReadF18B, DcmDspDataWriteFnc=Rte_WriteData_F18B, DcmDspDataSize=24
          DcmDspData_F18C: DcmDspDataUsePort=USE_DATA_SYNCH_FNC, DcmDspDataReadFnc=DcmDspDataReadF18C, DcmDspDataWriteFnc=Rte_WriteData_F18C, DcmDspDataSize=80
          DcmDspData_F192TBD: DcmDspDataUsePort=USE_DATA_SYNCH_FNC, DcmDspDataReadFnc=DcmDspDataReadF192, DcmDspDataWriteFnc=NULL_PTR, DcmDspDataSize=66
          DcmDspData_F194TBD: DcmDspDataUsePort=USE_DATA_SYNCH_FNC, DcmDspDataReadFnc=DcmDspDataReadF194, DcmDspDataWriteFnc=NULL_PTR, DcmDspDataSize=68
          DcmDspData_F197: DcmDspDataUsePort=USE_DATA_SYNCH_FNC, DcmDspDataReadFnc=DcmDspDataReadF197, DcmDspDataWriteFnc=NULL_PTR, DcmDspDataSize=64
          DcmDspData_F199: DcmDspDataUsePort=USE_DATA_SYNCH_FNC, DcmDspDataReadFnc=DcmDspDataReadF199, DcmDspDataWriteFnc=NULL_PTR, DcmDspDataSize=24
          DcmDspData_F19E: DcmDspDataUsePort=USE_DATA_SYNCH_FNC, DcmDspDataReadFnc=DcmDspDataReadF19E, DcmDspDataWriteFnc=NULL_PTR, DcmDspDataSize=24
          DcmDspData_F150: DcmDspDataUsePort=USE_DATA_SYNCH_FNC, DcmDspDataReadFnc=DcmDspDataReadF150, DcmDspDataWriteFnc=NULL_PTR, DcmDspDataSize=24
        DcmDspDidInfo_2E_Boot (DcmDspDidInfo): DcmDspDidDynamicallyDefined=false
          DcmDspDidWrite: DcmDspDidWriteSessionRef=DcmDspSessionRow_02, DcmDspDidWriteSecurityLevelRef=DcmDspSecurityRow_4
        DcmDspData_F15A (DcmDspData):
          DcmDspDataUsePort = USE_DATA_SYNCH_FNC
          DcmDspDataType = UINT8
          DcmDspDataConditionCheckReadFnc = NULL_PTR
          DcmDspDataFreezeCurrentStateFnc = NULL_PTR
          DcmDspDataGetScalingInfoFnc = NULL_PTR
          DcmDspDataReadDataLengthFnc = NULL_PTR
          DcmDspDataReadFnc = NULL_PTR
          DcmDspDataResetToDefaultFnc = NULL_PTR
          DcmDspDataReturnControlToEcuFnc = NULL_PTR
          DcmDspDataShortTermAdjustmentFnc = NULL_PTR
          DcmDspDataWriteFnc = NULL_PTR
          DcmDspDataConditionCheckReadFncUsed = false
          DcmDspDataEndianness = BIG_ENDIAN
          DcmDspDataSize = 96
        DcmDspDid_F15A (DcmDspDid): DcmDspDidIdentifier=61786, DcmDspDidUsed=true, DcmDspDidInfoRef=DcmDspDidInfo_2E_Boot
          DcmDspDidSignal_F15A (DcmDspDidSignal): DcmDspDidDataPos=0, DcmDspDidDataRef=DcmDspData_F15A
        DcmDspDidInfo_ReadOnly_NoDefault (DcmDspDidInfo): DcmDspDidDynamicallyDefined=false
          DcmDspDidRead:
            DcmDspDidReadSessionRef = DcmDspSessionRow_03
            DcmDspDidReadSecurityLevelRef = DcmDspSecurityRow_1
            DcmDspDidReadSecurityLevelRef = DcmDspSecurityRow_2
            DcmDspDidReadSecurityLevelRef = DcmDspSecurityRow_4
            DcmDspDidReadSessionRef = DcmDspSessionRow_70
        DcmDspDidInfo_WriteOnFactor (DcmDspDidInfo): DcmDspDidDynamicallyDefined=false
          DcmDspDidRead: DcmDspDidReadSessionRef=DcmDspSessionRow_01, DcmDspDidReadSessionRef=DcmDspSessionRow_03, DcmDspDidReadSessionRef=DcmDspSessionRow_70
          DcmDspDidWrite: DcmDspDidWriteSessionRef=DcmDspSessionRow_70
  module config MemIf
    MemIfGeneral:
      MemIfGeneralDevErrorDetect = false
      MemIfGeneralNumberOfDevices = 1
      MemIfGeneralVersionInfoApi = false
      MemIfGeneralUseFunciontApi = false
      MemIfGeneralFeeMapSupport = true
      MemIfGeneralEaMapSupport = false
  module config EcuM
    EcuMGeneral: EcuMDevErrorDetect=false, EcuMIncludeDet=false, EcuMMainFunctionPeriod=0.01, EcuMVersionInfoApi=false
    EcuMConfiguration
      EcuMCommonConfiguration: EcuMConfigConsistencyHash=0, EcuMDefaultAppMode=OSDEFAULTAPPMODE, EcuMOSResource=OsResource_0
        EcuMDefaultShutdownTarget: EcuMDefaultState=EcuMStateOff
        EcuMWakeupSource_Lin (EcuMWakeupSource): EcuMCheckWakeupTimeout=4.0, EcuMValidationTimeout=4.0, EcuMWakeupSourceId=7, EcuMWakeupSourcePolling=false
      EcuMFlexConfiguration
        EcuMFlexUserConfig_0 (EcuMFlexUserConfig): EcuMFlexUser=0
        EcuMResetMode_0 (EcuMResetMode): EcuMResetModeId=ECUM_RESET_MCU
        EcuMShutdownCause_0 (EcuMShutdownCause): EcuMShutdownCauseId=ECUM_CAUSE_ECU_STATE
        EcuMGoDownAllowedUsers: EcuMGoDownAllowedUserRef=EcuMFlexUserConfig_0
    EcuMFlexGeneral: EcuMAlarmClockPresent=false, EcuMModeHandling=true, EcuMResetLoopDetection=false, EcuMSetProgrammableInterrupts=false
  module config Port: implementation-config-variant=VARIANT-POST-BUILD
    CommonPublishedInformation:
      ArReleaseMajorVersion = 4
      ArReleaseMinorVersion = 4
      ArReleaseRevisionVersion = 0
      ModuleId = 124
      SwMajorVersion = 1
      SwMinorVersion = 0
      SwPatchVersion = 0
      VendorId = 43
    PortConfigSet
      NotUsedPortPin:
        PortPinDSE = High_Drive_Strength
        PortPinDirection = PORT_PIN_HIGH_Z
        PortPinLevelValue = PORT_PIN_LEVEL_LOW
        PortPinMode = GPIO
        PortPinPE = PullEnabled
        PortPinPS = PullUp
      PortContainer_0 (PortContainer): PortNumberOfPortPins=19
        19 x PortPin, all with PortPinDSE=Low_Drive_Strength, PortPinDirectionChangeable=1, PortPinInitialMode=PORT_GPIO_MODE, PortPinLK=0, PortPinModeChangeable=1, PortPinPFE=0:
          AD1_PTE2: PortPinDirection=PORT_PIN_IN, PortPinId=19, PortPinLevelValue=PORT_PIN_LEVEL_LOW, PortPinMode=ADC1_SE10, PortPinPE=PullDisabled, PortPinPS=PullDown, PortPinPcr=130
          AD2_PTE6: PortPinDirection=PORT_PIN_IN, PortPinId=18, PortPinLevelValue=PORT_PIN_LEVEL_LOW, PortPinMode=ADC1_SE11, PortPinPE=PullDisabled, PortPinPS=PullDown, PortPinPcr=134
          AD3_PTA15: PortPinDirection=PORT_PIN_IN, PortPinId=17, PortPinLevelValue=PORT_PIN_LEVEL_LOW, PortPinMode=ADC1_SE12, PortPinPE=PullDisabled, PortPinPS=PullDown, PortPinPcr=15
          CS_N_PTB17: PortPinDirection=PORT_PIN_OUT, PortPinId=10, PortPinLevelValue=PORT_PIN_LEVEL_HIGH, PortPinMode=LPSPI1_PCS3, PortPinPE=PullDisabled, PortPinPS=PullDown, PortPinPcr=49
          DCDC_FREQ_PTD5: PortPinDirection=PORT_PIN_OUT, PortPinId=7, PortPinLevelValue=PORT_PIN_LEVEL_LOW, PortPinMode=FTM2_CH3, PortPinPE=PullDisabled, PortPinPS=PullDown, PortPinPcr=101
          DC_OUT_CHECK_PTC3: PortPinDirection=PORT_PIN_IN, PortPinId=5, PortPinLevelValue=PORT_PIN_LEVEL_LOW, PortPinMode=ADC0_SE11_CMP0_IN4, PortPinPE=PullDisabled, PortPinPS=PullDown, PortPinPcr=67
          INT_PTD2: PortPinDirection=PORT_PIN_IN, PortPinId=15, PortPinLevelValue=PORT_PIN_LEVEL_HIGH, PortPinMode=GPIO, PortPinPE=PullEnabled, PortPinPS=PullUp, PortPinPcr=98
          KL15_V1_PTC2: PortPinDirection=PORT_PIN_IN, PortPinId=6, PortPinLevelValue=PORT_PIN_LEVEL_LOW, PortPinMode=ADC0_SE10_CMP0_IN5, PortPinPE=PullDisabled, PortPinPS=PullDown, PortPinPcr=66
          L_R_PTB9: PortPinDirection=PORT_PIN_IN, PortPinId=16, PortPinLevelValue=PORT_PIN_LEVEL_HIGH, PortPinMode=GPIO, PortPinPE=PullEnabled, PortPinPS=PullUp, PortPinPcr=41
          MCU_RX2_PTD17: PortPinDirection=PORT_PIN_IN, PortPinId=2, PortPinLevelValue=PORT_PIN_LEVEL_LOW, PortPinMode=LPUART2_RX, PortPinPE=PullDisabled, PortPinPS=PullDown, PortPinPcr=113
          MCU_TX2_PTE12: PortPinDirection=PORT_PIN_OUT, PortPinId=1, PortPinLevelValue=PORT_PIN_LEVEL_LOW, PortPinMode=LPUART2_TX, PortPinPE=PullDisabled, PortPinPS=PullDown, PortPinPcr=140
          PWM_CON_PTD12: PortPinDirection=PORT_PIN_OUT, PortPinId=8, PortPinLevelValue=PORT_PIN_LEVEL_LOW, PortPinMode=FTM2_CH2, PortPinPE=PullDisabled, PortPinPS=PullDown, PortPinPcr=108
          RO_PTD4: PortPinDirection=PORT_PIN_IN, PortPinId=14, PortPinLevelValue=PORT_PIN_LEVEL_HIGH, PortPinMode=GPIO, PortPinPE=PullEnabled, PortPinPS=PullUp, PortPinPcr=100
          RX_LIN_PTD13: PortPinDirection=PORT_PIN_IN, PortPinId=4, PortPinLevelValue=PORT_PIN_LEVEL_LOW, PortPinMode=LPUART1_RX, PortPinPE=PullDisabled, PortPinPS=PullDown, PortPinPcr=109
          SCK_PTB14: PortPinDirection=PORT_PIN_OUT, PortPinId=13, PortPinLevelValue=PORT_PIN_LEVEL_LOW, PortPinMode=LPSPI1_SCK, PortPinPE=PullDisabled, PortPinPS=PullDown, PortPinPcr=46
          SDI_PTB15: PortPinDirection=PORT_PIN_IN, PortPinId=12, PortPinLevelValue=PORT_PIN_LEVEL_LOW, PortPinMode=LPSPI1_SIN, PortPinPE=PullDisabled, PortPinPS=PullDown, PortPinPcr=47
          SDO_PTB16: PortPinDirection=PORT_PIN_OUT, PortPinId=11, PortPinLevelValue=PORT_PIN_LEVEL_LOW, PortPinMode=LPSPI1_SOUT, PortPinPE=PullDisabled, PortPinPS=PullDown, PortPinPcr=48
          TX_LIN_PTD14: PortPinDirection=PORT_PIN_OUT, PortPinId=3, PortPinLevelValue=PORT_PIN_LEVEL_LOW, PortPinMode=LPUART1_TX, PortPinPE=PullDisabled, PortPinPS=PullDown, PortPinPcr=110
          V1_PTC17: PortPinDirection=PORT_PIN_IN, PortPinId=9, PortPinLevelValue=PORT_PIN_LEVEL_LOW, PortPinMode=ADC0_SE15, PortPinPE=PullDisabled, PortPinPS=PullDown, PortPinPcr=81
      5 x UnTouchedPortPin:
        MCU_BKGD: PortPinPcr=4
        MCU_CLK: PortPinPcr=68
        MCU_EXTAL: PortPinPcr=39
        MCU_REST: PortPinPcr=5
        MCU_XTAL: PortPinPcr=38
    PortGeneral:
      PortCiPortIPDevErrorDetect = 0
      PortDevErrorDetect = 0
      PortEnableUserModeSupport = 0
      PortMulticoreSupport = 0
      PortResetPinModeApi = 0
      PortSet2PinsDirectionApi = 1
      PortSetAsUnusedPinApi = 0
      PortSetPinDirectionApi = 0
      PortSetPinModeApi = 1
      PortSetPinModeDoesNotTouchGpioLevel = 0
      PortVersionInfoApi = 1
  module config Com
    ComGeneral:
      ComCancellationSupport = false
      ComConfigurationUseDet = false
      ComEnableMDTForCyclicTransmission = true
      ComEnableSignalGroupArrayApi = false
      ComMetaDataSupport = false
      ComRetryFailedTransmitRequests = false
      ComSupportedIPduGroups = 4
      ComVersionInfoApi = false
    ComConfig
      ComTimeBase: ComGwTimeBase=0.005, ComRxTimeBase=0.005, ComTxTimeBase=0.005
      ComIPduGroup_RLM_RS_Tx (ComIPduGroup): ComIPduGroupHandleId=ComIPduGroup_RLM_RS_Tx
      ComIPduGroup_RLM_RS_Rx (ComIPduGroup): ComIPduGroupHandleId=ComIPduGroup_RLM_RS_Rx
      IPDU_COM_BCM_RLM_01 (ComIPdu):
        ComIPduCancellationSupport = false
        ComIPduDirection = RECEIVE
        ComIPduHandleId = COM_RXPDU_Com_BCM_RLM_01
        ComIPduSignalProcessing = DEFERRED
        ComIPduType = NORMAL
        ComIPduCallout = IPDU_COM_BCM_RLM_01
        ComPduIdRef = Com_BCM_RLM_01
        ComIPduGroupRef = ComIPduGroup_RLM_RS_Rx
        ComIPduSignalRef = PosnLiOnOffReLeMid_BCM_RLM_01
        ComIPduSignalRef = PosnLiOnOffReRiMid_BCM_RLM_01
        ComIPduSignalRef = PosnLiOnOffBrilvl_BCM_RLM_01
        ComIPduSignalRef = FogLiOnOffReLeMid_BCM_RLM_01
        ComIPduSignalRef = FogLiOnOffReRiMid_BCM_RLM_01
        ComIPduSignalRef = RvsLiOnOffLeMid_BCM_RLM_01
        ComIPduSignalRef = RvsLiOnOffRiMid_BCM_RLM_01
        ComIPduSignalRef = BrkLampOnOffLeMid_BCM_RLM_01
        ComIPduSignalRef = BrkLampOnOffRiMid_BCM_RLM_01
        ComIPduSignalRef = TurnSweepingEna_BCM_RLM_01
        ComIPduSignalRef = LiLanguageMod_BCM_RLM_01
        ComIPduSignalRef = ChrgSyncIndcnSts_BCM_RLM_01
        ComIPduSignalRef = PosnLiOnOffReLeSide_BCM_RLM_01
        ComIPduSignalRef = PosnLiOnOffReRiSide_BCM_RLM_01
        ComIPduSignalRef = FogLiOnOffFrntLe_BCM_RLM_01
        ComIPduSignalRef = FogLiOnOffFrntRi_BCM_RLM_01
        ComIPduSignalRef = FogLiOnOffReLeSide_BCM_RLM_01
        ComIPduSignalRef = FogLiOnOffReRiSide_BCM_RLM_01
        ComIPduSignalRef = RvsLiOnOffLeSide_BCM_RLM_01
        ComIPduSignalRef = RvsLiOnOffRiSide_BCM_RLM_01
        ComIPduSignalRef = BrkLampOnOffLeSide_BCM_RLM_01
        ComIPduSignalRef = BrkLampOnOffRiSide_BCM_RLM_01
        ComIPduSignalRef = TurnLiOnOffLe_BCM_RLM_01
        ComIPduSignalRef = TurnLiOnOffRi_BCM_RLM_01
        ComIPduSignalRef = BCMResponseErr_BCM_RLM_01
      25 x ComSignal, all with ComSignalEndianness=LITTLE_ENDIAN, ComSignalInitValue=0x0, ComSignalLength=0, ComDataInvalidAction=NOTIFY, ComInvalidNotification=NULL_PTR, ComRxDataTimeoutAction=NONE, ComInitialValueOnly=false, ComTransferProperty=PENDING:
        PosnLiOnOffReLeMid_BCM_RLM_01: ComBitPosition=3, ComBitSize=1, ComHandleId=PosnLiOnOffReLeMid_BCM_RLM_01, ComSignalType=BOOLEAN
        PosnLiOnOffReRiMid_BCM_RLM_01: ComBitPosition=2, ComBitSize=1, ComHandleId=PosnLiOnOffReRiMid_BCM_RLM_01, ComSignalType=BOOLEAN
        PosnLiOnOffBrilvl_BCM_RLM_01: ComBitPosition=4, ComBitSize=1, ComHandleId=PosnLiOnOffBrilvl_BCM_RLM_01, ComSignalType=BOOLEAN
        FogLiOnOffReLeMid_BCM_RLM_01: ComBitPosition=5, ComBitSize=1, ComHandleId=FogLiOnOffReLeMid_BCM_RLM_01, ComSignalType=BOOLEAN
        FogLiOnOffReRiMid_BCM_RLM_01: ComBitPosition=8, ComBitSize=1, ComHandleId=FogLiOnOffReRiMid_BCM_RLM_01, ComSignalType=BOOLEAN
        RvsLiOnOffLeMid_BCM_RLM_01: ComBitPosition=22, ComBitSize=1, ComHandleId=RvsLiOnOffLeMid_BCM_RLM_01, ComSignalType=BOOLEAN
        RvsLiOnOffRiMid_BCM_RLM_01: ComBitPosition=25, ComBitSize=1, ComHandleId=RvsLiOnOffRiMid_BCM_RLM_01, ComSignalType=BOOLEAN
        BrkLampOnOffLeMid_BCM_RLM_01: ComBitPosition=11, ComBitSize=2, ComHandleId=BrkLampOnOffLeMid_BCM_RLM_01, ComSignalType=UINT8
        BrkLampOnOffRiMid_BCM_RLM_01: ComBitPosition=17, ComBitSize=2, ComHandleId=BrkLampOnOffRiMid_BCM_RLM_01, ComSignalType=UINT8
        TurnSweepingEna_BCM_RLM_01: ComBitPosition=21, ComBitSize=1, ComHandleId=TurnSweepingEna_BCM_RLM_01, ComSignalType=BOOLEAN
        LiLanguageMod_BCM_RLM_01: ComBitPosition=30, ComBitSize=4, ComHandleId=LiLanguageMod_BCM_RLM_01, ComSignalType=UINT8
        ChrgSyncIndcnSts_BCM_RLM_01: ComBitPosition=34, ComBitSize=2, ComHandleId=ChrgSyncIndcnSts_BCM_RLM_01, ComSignalType=UINT8
        PosnLiOnOffReLeSide_BCM_RLM_01: ComBitPosition=0, ComBitSize=1, ComHandleId=PosnLiOnOffReLeSide_BCM_RLM_01, ComSignalType=BOOLEAN
        PosnLiOnOffReRiSide_BCM_RLM_01: ComBitPosition=1, ComBitSize=1, ComHandleId=PosnLiOnOffReRiSide_BCM_RLM_01, ComSignalType=BOOLEAN
        FogLiOnOffFrntLe_BCM_RLM_01: ComBitPosition=9, ComBitSize=1, ComHandleId=FogLiOnOffFrntLe_BCM_RLM_01, ComSignalType=BOOLEAN
        FogLiOnOffFrntRi_BCM_RLM_01: ComBitPosition=10, ComBitSize=1, ComHandleId=FogLiOnOffFrntRi_BCM_RLM_01, ComSignalType=BOOLEAN
        FogLiOnOffReLeSide_BCM_RLM_01: ComBitPosition=6, ComBitSize=1, ComHandleId=FogLiOnOffReLeSide_BCM_RLM_01, ComSignalType=BOOLEAN
        FogLiOnOffReRiSide_BCM_RLM_01: ComBitPosition=7, ComBitSize=1, ComHandleId=FogLiOnOffReRiSide_BCM_RLM_01, ComSignalType=BOOLEAN
        RvsLiOnOffLeSide_BCM_RLM_01: ComBitPosition=23, ComBitSize=1, ComHandleId=RvsLiOnOffLeSide_BCM_RLM_01, ComSignalType=BOOLEAN
        RvsLiOnOffRiSide_BCM_RLM_01: ComBitPosition=24, ComBitSize=1, ComHandleId=RvsLiOnOffRiSide_BCM_RLM_01, ComSignalType=BOOLEAN
        BrkLampOnOffLeSide_BCM_RLM_01: ComBitPosition=13, ComBitSize=2, ComHandleId=BrkLampOnOffLeSide_BCM_RLM_01, ComSignalType=UINT8
        BrkLampOnOffRiSide_BCM_RLM_01: ComBitPosition=15, ComBitSize=2, ComHandleId=BrkLampOnOffRiSide_BCM_RLM_01, ComSignalType=UINT8
        TurnLiOnOffLe_BCM_RLM_01: ComBitPosition=19, ComBitSize=1, ComHandleId=TurnLiOnOffLe_BCM_RLM_01, ComSignalType=BOOLEAN
        TurnLiOnOffRi_BCM_RLM_01: ComBitPosition=20, ComBitSize=1, ComHandleId=TurnLiOnOffRi_BCM_RLM_01, ComSignalType=BOOLEAN
        BCMResponseErr_BCM_RLM_01: ComBitPosition=36, ComBitSize=1, ComHandleId=BCMResponseErr_BCM_RLM_01, ComSignalType=BOOLEAN, ComNotification=Rte_COMCbk
      IPDU_COM_BCM_RLM_02 (ComIPdu):
        ComIPduCancellationSupport = false
        ComIPduDirection = RECEIVE
        ComIPduHandleId = COM_RXPDU_Com_BCM_RLM_02
        ComIPduSignalProcessing = DEFERRED
        ComIPduType = NORMAL
        ComIPduCallout = IPDU_COM_BCM_RLM_02
        ComPduIdRef = Com_BCM_RLM_02
        ComIPduGroupRef = ComIPduGroup_RLM_RS_Rx
        ComIPduSignalRef = LiLanguageCtrl_{1..8}_BCM_RLM_02
      8 x ComSignal, all with ComBitSize=8, ComSignalEndianness=LITTLE_ENDIAN, ComSignalInitValue=0x0, ComSignalLength=0, ComSignalType=UINT8, ComDataInvalidAction=NOTIFY, ComInvalidNotification=NULL_PTR, ComRxDataTimeoutAction=NONE, ComInitialValueOnly=false, ComTransferProperty=PENDING:
        LiLanguageCtrl_1_BCM_RLM_02: ComBitPosition=0, ComHandleId=LiLanguageCtrl_1_BCM_RLM_02
        LiLanguageCtrl_2_BCM_RLM_02: ComBitPosition=8, ComHandleId=LiLanguageCtrl_2_BCM_RLM_02
        LiLanguageCtrl_3_BCM_RLM_02: ComBitPosition=16, ComHandleId=LiLanguageCtrl_3_BCM_RLM_02
        LiLanguageCtrl_4_BCM_RLM_02: ComBitPosition=24, ComHandleId=LiLanguageCtrl_4_BCM_RLM_02
        LiLanguageCtrl_5_BCM_RLM_02: ComBitPosition=32, ComHandleId=LiLanguageCtrl_5_BCM_RLM_02
        LiLanguageCtrl_6_BCM_RLM_02: ComBitPosition=40, ComHandleId=LiLanguageCtrl_6_BCM_RLM_02
        LiLanguageCtrl_7_BCM_RLM_02: ComBitPosition=48, ComHandleId=LiLanguageCtrl_7_BCM_RLM_02
        LiLanguageCtrl_8_BCM_RLM_02: ComBitPosition=56, ComHandleId=LiLanguageCtrl_8_BCM_RLM_02, ComNotification=Rte_COMCbk
      IPDU_COM_RLM_RS_BCM_01 (ComIPdu):
        ComIPduCancellationSupport = false
        ComIPduDirection = SEND
        ComIPduHandleId = COM_TXPDU_Com_RLM_RS_BCM_01
        ComIPduSignalProcessing = DEFERRED
        ComIPduType = NORMAL
        ComIPduCallout = IPDU_COM_RLM_RS_BCM_01
        ComPduIdRef = Com_RLM_RS_BCM_01
        ComIPduGroupRef = ComIPduGroup_RLM_RS_Tx
        ComIPduSignalRef = RLM_RSResponseErr_RLM_RS_BCM_01
        ComIPduSignalRef = RLM_RS_ErrEcu_RLM_RS_BCM_01
        ComIPduSignalRef = RLM_RS_StVolt_RLM_RS_BCM_01
        ComIPduSignalRef = PosnLiStsReRiSide_RLM_RS_BCM_01
        ComIPduSignalRef = PosnLiErrIndcnReRiSide_RLM_RS_BCM_01
        ComIPduSignalRef = PosnLiErrStsReRiSide_RLM_RS_BCM_01
        ComIPduSignalRef = RvsLiStsReRiSide_RLM_RS_BCM_01
        ComIPduSignalRef = RvsLiErrIndcnReRiSide_RLM_RS_BCM_01
        ComIPduSignalRef = RvsLiErrStsReRiSide_RLM_RS_BCM_01
        ComIPduSignalRef = BrkLiStsReRiSide_RLM_RS_BCM_01
        ComIPduSignalRef = BrkLiErrIndcnReRiSide_RLM_RS_BCM_01
        ComIPduSignalRef = BrkLiErrStsReRiSide_RLM_RS_BCM_01
        ComIPduSignalRef = FogLiStsReRiSide_RLM_RS_BCM_01
        ComIPduSignalRef = FogLiErrIndcnReRiSide_RLM_RS_BCM_01
        ComIPduSignalRef = FogLiErrStsReRiSide_RLM_RS_BCM_01
        ComIPduSignalRef = LilanguageSts_RLM_R_RLM_RS_BCM_01
        ComIPduSignalRef = TurnLiStsReRiSide_RLM_RS_BCM_01
        ComIPduSignalRef = TurnLiErrIndcnReRiSide_RLM_RS_BCM_01
        ComIPduSignalRef = TurnLiErrStsReRiSide_RLM_RS_BCM_01
        ComIPduSignalRef = RLM_R_ChrgSyncIndcn_RLM_RS_BCM_01
        ComTxIPdu: ComMinimumDelayTime=0, ComTxIPduClearUpdateBit=Confirmation, ComTxIPduUnusedAreasDefault=0
          ComTxModeTrue
            ComTxMode: ComTxModeMode=NONE, ComTxModeNumberOfRepetitions=0, ComTxModeRepetitionPeriod=0.0, ComTxModeTimeOffset=0.0, ComTxModeTimePeriod=0.0
      20 x ComSignal, all with ComSignalEndianness=LITTLE_ENDIAN, ComSignalInitValue=0x0, ComSignalLength=0, ComDataInvalidAction=NOTIFY, ComInvalidNotification=NULL_PTR, ComRxDataTimeoutAction=NONE, ComInitialValueOnly=false, ComTransferProperty=PENDING:
        RLM_RSResponseErr_RLM_RS_BCM_01: ComBitPosition=0, ComBitSize=1, ComHandleId=RLM_RSResponseErr_RLM_RS_BCM_01, ComSignalType=BOOLEAN
        RLM_RS_ErrEcu_RLM_RS_BCM_01: ComBitPosition=2, ComBitSize=2, ComHandleId=RLM_RS_ErrEcu_RLM_RS_BCM_01, ComSignalType=UINT8
        RLM_RS_StVolt_RLM_RS_BCM_01: ComBitPosition=4, ComBitSize=2, ComHandleId=RLM_RS_StVolt_RLM_RS_BCM_01, ComSignalType=UINT8
        PosnLiStsReRiSide_RLM_RS_BCM_01: ComBitPosition=8, ComBitSize=1, ComHandleId=PosnLiStsReRiSide_RLM_RS_BCM_01, ComSignalType=BOOLEAN
        PosnLiErrIndcnReRiSide_RLM_RS_BCM_01: ComBitPosition=9, ComBitSize=1, ComHandleId=PosnLiErrIndcnReRiSide_RLM_RS_BCM_01, ComSignalType=BOOLEAN
        PosnLiErrStsReRiSide_RLM_RS_BCM_01: ComBitPosition=10, ComBitSize=3, ComHandleId=PosnLiErrStsReRiSide_RLM_RS_BCM_01, ComSignalType=UINT8
        RvsLiStsReRiSide_RLM_RS_BCM_01: ComBitPosition=16, ComBitSize=1, ComHandleId=RvsLiStsReRiSide_RLM_RS_BCM_01, ComSignalType=BOOLEAN
        RvsLiErrIndcnReRiSide_RLM_RS_BCM_01: ComBitPosition=17, ComBitSize=1, ComHandleId=RvsLiErrIndcnReRiSide_RLM_RS_BCM_01, ComSignalType=BOOLEAN
        RvsLiErrStsReRiSide_RLM_RS_BCM_01: ComBitPosition=18, ComBitSize=3, ComHandleId=RvsLiErrStsReRiSide_RLM_RS_BCM_01, ComSignalType=UINT8
        BrkLiStsReRiSide_RLM_RS_BCM_01: ComBitPosition=24, ComBitSize=1, ComHandleId=BrkLiStsReRiSide_RLM_RS_BCM_01, ComSignalType=BOOLEAN
        BrkLiErrIndcnReRiSide_RLM_RS_BCM_01: ComBitPosition=25, ComBitSize=1, ComHandleId=BrkLiErrIndcnReRiSide_RLM_RS_BCM_01, ComSignalType=BOOLEAN
        BrkLiErrStsReRiSide_RLM_RS_BCM_01: ComBitPosition=26, ComBitSize=3, ComHandleId=BrkLiErrStsReRiSide_RLM_RS_BCM_01, ComSignalType=UINT8
        FogLiStsReRiSide_RLM_RS_BCM_01: ComBitPosition=32, ComBitSize=1, ComHandleId=FogLiStsReRiSide_RLM_RS_BCM_01, ComSignalType=BOOLEAN
        FogLiErrIndcnReRiSide_RLM_RS_BCM_01: ComBitPosition=33, ComBitSize=1, ComHandleId=FogLiErrIndcnReRiSide_RLM_RS_BCM_01, ComSignalType=BOOLEAN
        FogLiErrStsReRiSide_RLM_RS_BCM_01: ComBitPosition=34, ComBitSize=3, ComHandleId=FogLiErrStsReRiSide_RLM_RS_BCM_01, ComSignalType=UINT8
        LilanguageSts_RLM_R_RLM_RS_BCM_01: ComBitPosition=37, ComBitSize=2, ComHandleId=LilanguageSts_RLM_R_RLM_RS_BCM_01, ComSignalType=UINT8
        TurnLiStsReRiSide_RLM_RS_BCM_01: ComBitPosition=39, ComBitSize=1, ComHandleId=TurnLiStsReRiSide_RLM_RS_BCM_01, ComSignalType=BOOLEAN
        TurnLiErrIndcnReRiSide_RLM_RS_BCM_01: ComBitPosition=40, ComBitSize=1, ComHandleId=TurnLiErrIndcnReRiSide_RLM_RS_BCM_01, ComSignalType=BOOLEAN
        TurnLiErrStsReRiSide_RLM_RS_BCM_01: ComBitPosition=41, ComBitSize=3, ComHandleId=TurnLiErrStsReRiSide_RLM_RS_BCM_01, ComSignalType=UINT8
        RLM_R_ChrgSyncIndcn_RLM_RS_BCM_01: ComBitPosition=44, ComBitSize=2, ComHandleId=RLM_R_ChrgSyncIndcn_RLM_RS_BCM_01, ComSignalType=UINT8, ComNotification=Rte_COMCbkTAck
      ComIPduGroup_HCML_Tx (ComIPduGroup): ComIPduGroupHandleId=ComIPduGroup_HCML_Tx
      ComIPduGroup_HCML_Rx (ComIPduGroup): ComIPduGroupHandleId=ComIPduGroup_HCML_Rx
      IPDU_COM_HcmlZcud_Lin2Fr01 (ComIPdu):
        ComIPduCancellationSupport = false
        ComIPduDirection = SEND
        ComIPduHandleId = COM_TXPDU_Com_HcmlZcud_Lin2Fr01
        ComIPduSignalProcessing = DEFERRED
        ComIPduType = NORMAL
        ComPduIdRef = Com_HcmlZcud_Lin2Fr01
        ComIPduGroupRef = ComIPduGroup_HCML_Tx
        ComIPduSignalRef = HCML2DTCGroup{1..4}_HcmlZcud_Lin2Fr01
        ComIPduSignalRef = StsOfLedCornrgLampwithLINLe_HcmlZcud_Lin2Fr01
        ComIPduSignalRef = StsOfLedDaytiRunngLampWithLINLe_HcmlZcud_Lin2Fr01
        ComIPduSignalRef = StsOfLedFrntFogLampWithLINLe_HcmlZcud_Lin2Fr01
        ComIPduSignalRef = StsOfLedFrntPosnLampWithLINLe_HcmlZcud_Lin2Fr01
        ComIPduSignalRef = StsOfLedFrntTurnIndcrWithLINLe_HcmlZcud_Lin2Fr01
        ComIPduSignalRef = StsOfLedHiBeamWithLINLe_HcmlZcud_Lin2Fr01
        ComIPduSignalRef = StsOfLedLoBeamWithLINLe_HcmlZcud_Lin2Fr01
        ComIPduSignalRef = StsOfWelGbyFrntWithLINLe_HcmlZcud_Lin2Fr01
        ComIPduSignalRef = ErrRespHCML_HcmlZcud_Lin2Fr01
        ComTxIPdu: ComMinimumDelayTime=0, ComTxIPduClearUpdateBit=Confirmation, ComTxIPduUnusedAreasDefault=0
          ComTxModeTrue
            ComTxMode: ComTxModeMode=NONE, ComTxModeNumberOfRepetitions=0, ComTxModeRepetitionPeriod=0.0, ComTxModeTimeOffset=0.0, ComTxModeTimePeriod=0.0
      13 x ComSignal, all with ComSignalEndianness=LITTLE_ENDIAN, ComSignalInitValue=0x0, ComSignalLength=0, ComDataInvalidAction=NOTIFY, ComInvalidNotification=NULL_PTR, ComRxDataTimeoutAction=NONE, ComInitialValueOnly=false, ComTransferProperty=PENDING:
        HCML2DTCGroup1_HcmlZcud_Lin2Fr01: ComBitPosition=16, ComBitSize=8, ComHandleId=HCML2DTCGroup1_HcmlZcud_Lin2Fr01, ComSignalType=UINT8
        HCML2DTCGroup2_HcmlZcud_Lin2Fr01: ComBitPosition=24, ComBitSize=8, ComHandleId=HCML2DTCGroup2_HcmlZcud_Lin2Fr01, ComSignalType=UINT8
        HCML2DTCGroup3_HcmlZcud_Lin2Fr01: ComBitPosition=32, ComBitSize=8, ComHandleId=HCML2DTCGroup3_HcmlZcud_Lin2Fr01, ComSignalType=UINT8
        HCML2DTCGroup4_HcmlZcud_Lin2Fr01: ComBitPosition=40, ComBitSize=8, ComHandleId=HCML2DTCGroup4_HcmlZcud_Lin2Fr01, ComSignalType=UINT8
        StsOfLedCornrgLampwithLINLe_HcmlZcud_Lin2Fr01: ComBitPosition=0, ComBitSize=2, ComHandleId=StsOfLedCornrgLampwithLINLe_HcmlZcud_Lin2Fr01, ComSignalType=UINT8
        StsOfLedDaytiRunngLampWithLINLe_HcmlZcud_Lin2Fr01: ComBitPosition=2, ComBitSize=2, ComHandleId=StsOfLedDaytiRunngLampWithLINLe_HcmlZcud_Lin2Fr01, ComSignalType=UINT8
        StsOfLedFrntFogLampWithLINLe_HcmlZcud_Lin2Fr01: ComBitPosition=4, ComBitSize=2, ComHandleId=StsOfLedFrntFogLampWithLINLe_HcmlZcud_Lin2Fr01, ComSignalType=UINT8
        StsOfLedFrntPosnLampWithLINLe_HcmlZcud_Lin2Fr01: ComBitPosition=6, ComBitSize=2, ComHandleId=StsOfLedFrntPosnLampWithLINLe_HcmlZcud_Lin2Fr01, ComSignalType=UINT8
        StsOfLedFrntTurnIndcrWithLINLe_HcmlZcud_Lin2Fr01: ComBitPosition=8, ComBitSize=2, ComHandleId=StsOfLedFrntTurnIndcrWithLINLe_HcmlZcud_Lin2Fr01, ComSignalType=UINT8
        StsOfLedHiBeamWithLINLe_HcmlZcud_Lin2Fr01: ComBitPosition=10, ComBitSize=2, ComHandleId=StsOfLedHiBeamWithLINLe_HcmlZcud_Lin2Fr01, ComSignalType=UINT8
        StsOfLedLoBeamWithLINLe_HcmlZcud_Lin2Fr01: ComBitPosition=12, ComBitSize=2, ComHandleId=StsOfLedLoBeamWithLINLe_HcmlZcud_Lin2Fr01, ComSignalType=UINT8
        StsOfWelGbyFrntWithLINLe_HcmlZcud_Lin2Fr01: ComBitPosition=14, ComBitSize=1, ComHandleId=StsOfWelGbyFrntWithLINLe_HcmlZcud_Lin2Fr01, ComSignalType=BOOLEAN
        ErrRespHCML_HcmlZcud_Lin2Fr01: ComBitPosition=55, ComBitSize=1, ComHandleId=ErrRespHCML_HcmlZcud_Lin2Fr01, ComSignalType=BOOLEAN
      IPDU_COM_ZcudZcud_Lin2Fr01 (ComIPdu):
        ComIPduCancellationSupport = false
        ComIPduDirection = RECEIVE
        ComIPduHandleId = COM_RXPDU_Com_ZcudZcud_Lin2Fr01
        ComIPduSignalProcessing = DEFERRED
        ComIPduType = NORMAL
        ComPduIdRef = Com_ZcudZcud_Lin2Fr01
        ComIPduGroupRef = ComIPduGroup_HCML_Rx
        ComIPduSignalRef = ActnOfAssistantLi_ZcudZcud_Lin2Fr01
        ComIPduSignalRef = ActnOfLedCornrgLampLe_ZcudZcud_Lin2Fr01
        ComIPduSignalRef = ActnOfLedCornrgLampRi_ZcudZcud_Lin2Fr01
        ComIPduSignalRef = ActnOfLedDaytiRunngLamp_ZcudZcud_Lin2Fr01
        ComIPduSignalRef = ActnOfLedFrntCrossLamp_ZcudZcud_Lin2Fr01
        ComIPduSignalRef = ActnOfLedFrntCrossLampDyn_ZcudZcud_Lin2Fr01
        ComIPduSignalRef = ActnOfLedFrntFogLamp_ZcudZcud_Lin2Fr01
        ComIPduSignalRef = ActnOfLedGrilleLamp_ZcudZcud_Lin2Fr01
        ComIPduSignalRef = ActnOfLedGrilleLampDyn_ZcudZcud_Lin2Fr01
        ComIPduSignalRef = ActnOfLedHiBeam_ZcudZcud_Lin2Fr01
        ComIPduSignalRef = ActnOfLedLeLogoLamp_ZcudZcud_Lin2Fr01
        ComIPduSignalRef = ActnOfLedLeLogoLampDyn_ZcudZcud_Lin2Fr01
        ComIPduSignalRef = ActnOfLedLoBeamActnOfLedLoBeam_ZcudZcud_Lin2Fr01
        ComIPduSignalRef = ActnOfLedLoBeamChks_ZcudZcud_Lin2Fr01
        ComIPduSignalRef = ActnOfLedLoBeamCntr_ZcudZcud_Lin2Fr01
        ComIPduSignalRef = ActnOfLedPosnLamp_ZcudZcud_Lin2Fr01
        ComIPduSignalRef = ActnOfLedPosnLampDyn_ZcudZcud_Lin2Fr01
        ComIPduSignalRef = ActnOfLedRiLogoLamp_ZcudZcud_Lin2Fr01
        ComIPduSignalRef = ActnOfLedRiLogoLampDyn_ZcudZcud_Lin2Fr01
        ComIPduSignalRef = ActvnOfApproach_ZcudZcud_Lin2Fr01
        ComIPduSignalRef = ActvnOfCarLoctr_ZcudZcud_Lin2Fr01
        ComIPduSignalRef = ActvnOfGoodByeLi_ZcudZcud_Lin2Fr01
        ComIPduSignalRef = ActvnOfIndcrIndcrOut_ZcudZcud_Lin2Fr01
        ComIPduSignalRef = ActvnOfIndcrIndcrOutChks_ZcudZcud_Lin2Fr01
        ComIPduSignalRef = ActvnOfIndcrIndcrOutCntr_ZcudZcud_Lin2Fr01
        ComIPduSignalRef = ActvnOfShowModLi_ZcudZcud_Lin2Fr01
        ComIPduSignalRef = ActvnOfWaitMode_ZcudZcud_Lin2Fr01
        ComIPduSignalRef = ActvnOfWelcomeLi_ZcudZcud_Lin2Fr01
        ComIPduSignalRef = IndcrNoSeq_ZcudZcud_Lin2Fr01
        ComIPduSignalRef = IndcrSts_ZcudZcud_Lin2Fr01
        ComIPduSignalRef = WelcomeGoodbyeModeReq_ZcudZcud_Lin2Fr01
      31 x ComSignal, all with ComSignalEndianness=LITTLE_ENDIAN, ComSignalInitValue=0x0, ComSignalLength=0, ComDataInvalidAction=NOTIFY, ComInvalidNotification=NULL_PTR, ComRxDataTimeoutAction=NONE, ComInitialValueOnly=false, ComTransferProperty=PENDING:
        ActnOfAssistantLi_ZcudZcud_Lin2Fr01: ComBitPosition=1, ComBitSize=1, ComHandleId=ActnOfAssistantLi_ZcudZcud_Lin2Fr01, ComSignalType=BOOLEAN
        ActnOfLedCornrgLampLe_ZcudZcud_Lin2Fr01: ComBitPosition=0, ComBitSize=1, ComHandleId=ActnOfLedCornrgLampLe_ZcudZcud_Lin2Fr01, ComSignalType=BOOLEAN
        ActnOfLedCornrgLampRi_ZcudZcud_Lin2Fr01: ComBitPosition=2, ComBitSize=1, ComHandleId=ActnOfLedCornrgLampRi_ZcudZcud_Lin2Fr01, ComSignalType=BOOLEAN
        ActnOfLedDaytiRunngLamp_ZcudZcud_Lin2Fr01: ComBitPosition=3, ComBitSize=1, ComHandleId=ActnOfLedDaytiRunngLamp_ZcudZcud_Lin2Fr01, ComSignalType=BOOLEAN
        ActnOfLedFrntCrossLamp_ZcudZcud_Lin2Fr01: ComBitPosition=4, ComBitSize=1, ComHandleId=ActnOfLedFrntCrossLamp_ZcudZcud_Lin2Fr01, ComSignalType=BOOLEAN
        ActnOfLedFrntCrossLampDyn_ZcudZcud_Lin2Fr01: ComBitPosition=5, ComBitSize=1, ComHandleId=ActnOfLedFrntCrossLampDyn_ZcudZcud_Lin2Fr01, ComSignalType=BOOLEAN
        ActnOfLedFrntFogLamp_ZcudZcud_Lin2Fr01: ComBitPosition=6, ComBitSize=1, ComHandleId=ActnOfLedFrntFogLamp_ZcudZcud_Lin2Fr01, ComSignalType=BOOLEAN
        ActnOfLedGrilleLamp_ZcudZcud_Lin2Fr01: ComBitPosition=7, ComBitSize=1, ComHandleId=ActnOfLedGrilleLamp_ZcudZcud_Lin2Fr01, ComSignalType=BOOLEAN
        ActnOfLedGrilleLampDyn_ZcudZcud_Lin2Fr01: ComBitPosition=8, ComBitSize=1, ComHandleId=ActnOfLedGrilleLampDyn_ZcudZcud_Lin2Fr01, ComSignalType=BOOLEAN
        ActnOfLedHiBeam_ZcudZcud_Lin2Fr01: ComBitPosition=9, ComBitSize=1, ComHandleId=ActnOfLedHiBeam_ZcudZcud_Lin2Fr01, ComSignalType=BOOLEAN
        ActnOfLedLeLogoLamp_ZcudZcud_Lin2Fr01: ComBitPosition=10, ComBitSize=1, ComHandleId=ActnOfLedLeLogoLamp_ZcudZcud_Lin2Fr01, ComSignalType=BOOLEAN
        ActnOfLedLeLogoLampDyn_ZcudZcud_Lin2Fr01: ComBitPosition=11, ComBitSize=1, ComHandleId=ActnOfLedLeLogoLampDyn_ZcudZcud_Lin2Fr01, ComSignalType=BOOLEAN
        ActnOfLedLoBeamActnOfLedLoBeam_ZcudZcud_Lin2Fr01: ComBitPosition=23, ComBitSize=1, ComHandleId=ActnOfLedLoBeamActnOfLedLoBeam_ZcudZcud_Lin2Fr01, ComSignalType=BOOLEAN
        ActnOfLedLoBeamChks_ZcudZcud_Lin2Fr01: ComBitPosition=24, ComBitSize=8, ComHandleId=ActnOfLedLoBeamChks_ZcudZcud_Lin2Fr01, ComSignalType=UINT8
        ActnOfLedLoBeamCntr_ZcudZcud_Lin2Fr01: ComBitPosition=32, ComBitSize=4, ComHandleId=ActnOfLedLoBeamCntr_ZcudZcud_Lin2Fr01, ComSignalType=UINT8
        ActnOfLedPosnLamp_ZcudZcud_Lin2Fr01: ComBitPosition=12, ComBitSize=1, ComHandleId=ActnOfLedPosnLamp_ZcudZcud_Lin2Fr01, ComSignalType=BOOLEAN
        ActnOfLedPosnLampDyn_ZcudZcud_Lin2Fr01: ComBitPosition=13, ComBitSize=1, ComHandleId=ActnOfLedPosnLampDyn_ZcudZcud_Lin2Fr01, ComSignalType=BOOLEAN
        ActnOfLedRiLogoLamp_ZcudZcud_Lin2Fr01: ComBitPosition=14, ComBitSize=1, ComHandleId=ActnOfLedRiLogoLamp_ZcudZcud_Lin2Fr01, ComSignalType=BOOLEAN
        ActnOfLedRiLogoLampDyn_ZcudZcud_Lin2Fr01: ComBitPosition=15, ComBitSize=1, ComHandleId=ActnOfLedRiLogoLampDyn_ZcudZcud_Lin2Fr01, ComSignalType=BOOLEAN
        ActvnOfApproach_ZcudZcud_Lin2Fr01: ComBitPosition=16, ComBitSize=1, ComHandleId=ActvnOfApproach_ZcudZcud_Lin2Fr01, ComSignalType=BOOLEAN
        ActvnOfCarLoctr_ZcudZcud_Lin2Fr01: ComBitPosition=17, ComBitSize=1, ComHandleId=ActvnOfCarLoctr_ZcudZcud_Lin2Fr01, ComSignalType=BOOLEAN
        ActvnOfGoodByeLi_ZcudZcud_Lin2Fr01: ComBitPosition=18, ComBitSize=1, ComHandleId=ActvnOfGoodByeLi_ZcudZcud_Lin2Fr01, ComSignalType=BOOLEAN
        ActvnOfIndcrIndcrOut_ZcudZcud_Lin2Fr01: ComBitPosition=46, ComBitSize=2, ComHandleId=ActvnOfIndcrIndcrOut_ZcudZcud_Lin2Fr01, ComSignalType=UINT8
        ActvnOfIndcrIndcrOutChks_ZcudZcud_Lin2Fr01: ComBitPosition=48, ComBitSize=8, ComHandleId=ActvnOfIndcrIndcrOutChks_ZcudZcud_Lin2Fr01, ComSignalType=UINT8
        ActvnOfIndcrIndcrOutCntr_ZcudZcud_Lin2Fr01: ComBitPosition=42, ComBitSize=4, ComHandleId=ActvnOfIndcrIndcrOutCntr_ZcudZcud_Lin2Fr01, ComSignalType=UINT8
        ActvnOfShowModLi_ZcudZcud_Lin2Fr01: ComBitPosition=19, ComBitSize=1, ComHandleId=ActvnOfShowModLi_ZcudZcud_Lin2Fr01, ComSignalType=BOOLEAN
        ActvnOfWaitMode_ZcudZcud_Lin2Fr01: ComBitPosition=20, ComBitSize=1, ComHandleId=ActvnOfWaitMode_ZcudZcud_Lin2Fr01, ComSignalType=BOOLEAN
        ActvnOfWelcomeLi_ZcudZcud_Lin2Fr01: ComBitPosition=21, ComBitSize=1, ComHandleId=ActvnOfWelcomeLi_ZcudZcud_Lin2Fr01, ComSignalType=BOOLEAN
        IndcrNoSeq_ZcudZcud_Lin2Fr01: ComBitPosition=22, ComBitSize=1, ComHandleId=IndcrNoSeq_ZcudZcud_Lin2Fr01, ComSignalType=BOOLEAN
        IndcrSts_ZcudZcud_Lin2Fr01: ComBitPosition=40, ComBitSize=2, ComHandleId=IndcrSts_ZcudZcud_Lin2Fr01, ComSignalType=UINT8
        WelcomeGoodbyeModeReq_ZcudZcud_Lin2Fr01: ComBitPosition=36, ComBitSize=4, ComHandleId=WelcomeGoodbyeModeReq_ZcudZcud_Lin2Fr01, ComSignalType=UINT8
      IPDU_COM_ZcudZcud_Lin2Fr02 (ComIPdu):
        ComIPduCancellationSupport = false
        ComIPduDirection = RECEIVE
        ComIPduHandleId = COM_RXPDU_Com_ZcudZcud_Lin2Fr02
        ComIPduSignalProcessing = DEFERRED
        ComIPduType = NORMAL
        ComPduIdRef = Com_ZcudZcud_Lin2Fr02
        ComIPduGroupRef = ComIPduGroup_HCML_Rx
        ComIPduSignalRef = ClrDTCOfLINHCML2_ZcudZcud_Lin2Fr02
        ComIPduSignalRef = ClrDTCOfLINHCMR2_ZcudZcud_Lin2Fr02
        ComIPduSignalRef = LvlgSwtSetReqChks_ZcudZcud_Lin2Fr02
        ComIPduSignalRef = LvlgSwtSetReqCntr_ZcudZcud_Lin2Fr02
        ComIPduSignalRef = LvlgSwtSetReqLvlgSwtSetReq_ZcudZcud_Lin2Fr02
      5 x ComSignal, all with ComSignalEndianness=LITTLE_ENDIAN, ComSignalInitValue=0x0, ComSignalLength=0, ComDataInvalidAction=NOTIFY, ComInvalidNotification=NULL_PTR, ComRxDataTimeoutAction=NONE, ComInitialValueOnly=false, ComTransferProperty=PENDING:
        ClrDTCOfLINHCML2_ZcudZcud_Lin2Fr02: ComBitPosition=15, ComBitSize=1, ComHandleId=ClrDTCOfLINHCML2_ZcudZcud_Lin2Fr02, ComSignalType=BOOLEAN
        ClrDTCOfLINHCMR2_ZcudZcud_Lin2Fr02: ComBitPosition=16, ComBitSize=1, ComHandleId=ClrDTCOfLINHCMR2_ZcudZcud_Lin2Fr02, ComSignalType=BOOLEAN
        LvlgSwtSetReqChks_ZcudZcud_Lin2Fr02: ComBitPosition=0, ComBitSize=8, ComHandleId=LvlgSwtSetReqChks_ZcudZcud_Lin2Fr02, ComSignalType=UINT8
        LvlgSwtSetReqCntr_ZcudZcud_Lin2Fr02: ComBitPosition=8, ComBitSize=4, ComHandleId=LvlgSwtSetReqCntr_ZcudZcud_Lin2Fr02, ComSignalType=UINT8
        LvlgSwtSetReqLvlgSwtSetReq_ZcudZcud_Lin2Fr02: ComBitPosition=12, ComBitSize=3, ComHandleId=LvlgSwtSetReqLvlgSwtSetReq_ZcudZcud_Lin2Fr02, ComSignalType=UINT8
  module config Fee: implementation-config-variant=VARIANT-PRE-COMPILE
    CommonPublishedInformation:
      ArReleaseMajorVersion = 4
      ArReleaseMinorVersion = 2
      ArReleaseRevisionVersion = 2
      ModuleId = 21
      SwMajorVersion = 1
      SwMinorVersion = 0
      SwPatchVersion = 4
      VendorId = 43
    44 x FeeBlockConfiguration, all with FeeBlockAssignment=APPLICATION, FeeImmediateData=0, FeeNumberOfWriteCycles=0, FeeClusterGroupRef=FeeClusterGroup_0, FeeDeviceIndex=FlsGeneral:
      FeeBlockConfiguration_0: FeeBlockNumber=256, FeeBlockSize=4
      FeeBlockConfiguration_1: FeeBlockNumber=257, FeeBlockSize=4
      FeeBlockConfiguration_10: FeeBlockNumber=2560, FeeBlockSize=34
      FeeBlockConfiguration_11: FeeBlockNumber=2816, FeeBlockSize=34
      FeeBlockConfiguration_12: FeeBlockNumber=3072, FeeBlockSize=34
      FeeBlockConfiguration_13: FeeBlockNumber=3328, FeeBlockSize=34
      FeeBlockConfiguration_14: FeeBlockNumber=3584, FeeBlockSize=34
      FeeBlockConfiguration_15: FeeBlockNumber=3840, FeeBlockSize=34
      FeeBlockConfiguration_16: FeeBlockNumber=4096, FeeBlockSize=34
      FeeBlockConfiguration_17: FeeBlockNumber=4352, FeeBlockSize=34
      FeeBlockConfiguration_18: FeeBlockNumber=4608, FeeBlockSize=34
      FeeBlockConfiguration_19: FeeBlockNumber=4864, FeeBlockSize=34
      FeeBlockConfiguration_2: FeeBlockNumber=512, FeeBlockSize=34
      FeeBlockConfiguration_20: FeeBlockNumber=5120, FeeBlockSize=34
      FeeBlockConfiguration_21: FeeBlockNumber=5376, FeeBlockSize=34
      FeeBlockConfiguration_22: FeeBlockNumber=5632, FeeBlockSize=34
      FeeBlockConfiguration_23: FeeBlockNumber=5888, FeeBlockSize=34
      FeeBlockConfiguration_24: FeeBlockNumber=6144, FeeBlockSize=34
      FeeBlockConfiguration_25: FeeBlockNumber=6400, FeeBlockSize=34
      FeeBlockConfiguration_26: FeeBlockNumber=6656, FeeBlockSize=34
      FeeBlockConfiguration_27: FeeBlockNumber=6912, FeeBlockSize=34
      FeeBlockConfiguration_28: FeeBlockNumber=7168, FeeBlockSize=34
      FeeBlockConfiguration_29: FeeBlockNumber=7424, FeeBlockSize=34
      FeeBlockConfiguration_3: FeeBlockNumber=768, FeeBlockSize=34
      FeeBlockConfiguration_30: FeeBlockNumber=7680, FeeBlockSize=34
      FeeBlockConfiguration_31: FeeBlockNumber=7936, FeeBlockSize=34
      FeeBlockConfiguration_32: FeeBlockNumber=8192, FeeBlockSize=34
      FeeBlockConfiguration_33: FeeBlockNumber=8448, FeeBlockSize=34
      FeeBlockConfiguration_34: FeeBlockNumber=8704, FeeBlockSize=34
      FeeBlockConfiguration_35: FeeBlockNumber=8960, FeeBlockSize=34
      FeeBlockConfiguration_36: FeeBlockNumber=9216, FeeBlockSize=34
      FeeBlockConfiguration_37: FeeBlockNumber=9472, FeeBlockSize=34
      FeeBlockConfiguration_38: FeeBlockNumber=9728, FeeBlockSize=34
      FeeBlockConfiguration_39: FeeBlockNumber=9984, FeeBlockSize=34
      FeeBlockConfiguration_4: FeeBlockNumber=1024, FeeBlockSize=34
      FeeBlockConfiguration_40: FeeBlockNumber=10240, FeeBlockSize=34
      FeeBlockConfiguration_41: FeeBlockNumber=10496, FeeBlockSize=34
      FeeBlockConfiguration_42: FeeBlockNumber=10752, FeeBlockSize=34
      FeeBlockConfiguration_43: FeeBlockNumber=11008, FeeBlockSize=202
      FeeBlockConfiguration_5: FeeBlockNumber=1280, FeeBlockSize=34
      FeeBlockConfiguration_6: FeeBlockNumber=1536, FeeBlockSize=34
      FeeBlockConfiguration_7: FeeBlockNumber=1792, FeeBlockSize=34
      FeeBlockConfiguration_8: FeeBlockNumber=2048, FeeBlockSize=34
      FeeBlockConfiguration_9: FeeBlockNumber=2304, FeeBlockSize=34
    FeeClusterGroup_0 (FeeClusterGroup)
      FeeCluster_0 (FeeCluster)
        15 x FeeSector:
          FeeSector_0: FeeSectorIndex=0, FeeSectorRef=FlsSector_0
          FeeSector_1: FeeSectorIndex=1, FeeSectorRef=FlsSector_1
          FeeSector_{10..14}: FeeSectorIndex={10..14}, FeeSectorRef=FlsSector_{10..14}
          FeeSector_{2..9}: FeeSectorIndex={2..9}, FeeSectorRef=FlsSector_{2..9}
      FeeCluster_1 (FeeCluster)
        15 x FeeSector:
          FeeSector_0: FeeSectorIndex=0, FeeSectorRef=FlsSector_15
          FeeSector_1: FeeSectorIndex=1, FeeSectorRef=FlsSector_16
          FeeSector_10: FeeSectorIndex=10, FeeSectorRef=FlsSector_25
          FeeSector_11: FeeSectorIndex=11, FeeSectorRef=FlsSector_26
          FeeSector_12: FeeSectorIndex=12, FeeSectorRef=FlsSector_27
          FeeSector_13: FeeSectorIndex=13, FeeSectorRef=FlsSector_28
          FeeSector_14: FeeSectorIndex=14, FeeSectorRef=FlsSector_29
          FeeSector_2: FeeSectorIndex=2, FeeSectorRef=FlsSector_17
          FeeSector_3: FeeSectorIndex=3, FeeSectorRef=FlsSector_18
          FeeSector_4: FeeSectorIndex=4, FeeSectorRef=FlsSector_19
          FeeSector_5: FeeSectorIndex=5, FeeSectorRef=FlsSector_20
          FeeSector_6: FeeSectorIndex=6, FeeSectorRef=FlsSector_21
          FeeSector_7: FeeSectorIndex=7, FeeSectorRef=FlsSector_22
          FeeSector_8: FeeSectorIndex=8, FeeSectorRef=FlsSector_23
          FeeSector_9: FeeSectorIndex=9, FeeSectorRef=FlsSector_24
    FeeGeneral:
      FeeBlockAlwaysAvailable = 1
      FeeConfigAssignment = APPLICATION
      FeeDataBufferSize = 96
      FeeDevErrorDetect = 0
      FeeEnableUserModeSupport = 0
      FeeLegacyEraseMode = 0
      FeeLegacyMode = 1
      FeeMainFunctionPeriod = 0.005
      FeeMarkEmptyBlocksInvalid = 0
      FeeMaximumNumberBlocks = 1
      FeePollingMode = 0
      FeeSetModeSupported = 1
      FeeSwapForeignBlocksEnabled = 0
      FeeVersionInfoApi = 0
      FeeVirtualPageSize = 32
    FeePublishedInformation: FeeBlockOverhead=0, FeePageOverhead=0
  module config RamTst
    RamTstCommon:
      RamTstAllowApi = true
      RamTstChangeNumOfTestedCellsApi = true
      RamTstDevErrorDetect = true
      RamTstGetAlgParamsApi = true
      RamTstGetExecutionStatusApi = true
      RamTstGetNumberOfTestedCellsApi = true
      RamTstGetTestAlgorithmApi = true
      RamTstGetTestResultApi = true
      RamTstGetTestResultPerBlockApi = true
      RamTstResumeApi = true
      RamTstRunFullTestApi = true
      RamTstRunPartialTestApi = true
      RamTstSelectAlgParamsApi = true
      RamTstStopApi = true
      RamTstSuspendApi = true
      RamTstVersionInfoApi = true
      SelfCheckEnable = true
      TestCompleteNotificationEnable = true
      TestErrorNotificationEnable = true
      SafeReserveAreaStartAddr = 536862720
      SafeReserveAreaEndAddr = 536866815
      LocalVarAreaStartAddr = 536866816
      LocalVarAreaEndAddr = 536868863
      RamTstAlgorithms:
        RamTstAbrahamTestSelected = false
        RamTstCheckerboardTestSelected = false
        RamTstGalpatTestSelected = false
        RamTstMarchTestSelected = true
        RamTstTranspGalpatTestSelected = false
        RamTstWalkPathTestSelected = false
      RamTstConfigParams:
        RamTstDefaultAlgParamsId = 1
        RamTstMinNumberOfTestedCells = 4
        RamTstNumberOfAlgParamSets = 1
        RamTstTestCompletedNotification = TestCompletedNotification
        RamTstTestErrorNotification = TestErrorNotification
        RamTstAlgParams:
          RamTstAlgorithm = RAMTST_MARCH_TEST
          RamTstAlgParamsId = 1
          RamTstExtNumberOfTestedCells = 4096
          RamTstMaxNumberOfTestedCells = 4096
          RamTstNumberOfBlocks = 6
          RamTstNumberOfTestedCells = 20
          6 x RamTstBlockParams, all with RamTstFillPattern=0, BlockTestUseMethod=BLOCK_TEST_USED_METHOD_FOREGROUND:
            RamTstBlockParams: RamTstBlockId=1, RamTstEndAddress=536807935, RamTstStartAddress=536806400, RamTstTestPolicy=RAMTEST_NON_DESTRUCTIVE
            RamTstBlockParams_0: RamTstBlockId=2, RamTstEndAddress=536888231, RamTstStartAddress=536870912, RamTstTestPolicy=RAMTEST_DESTRUCTIVE
            RamTstBlockParams_MCU_IPW: RamTstBlockId=3, RamTstEndAddress=536895571, RamTstStartAddress=536895568, RamTstTestPolicy=RAMTEST_NON_DESTRUCTIVE
            RamTstBlockParams_3: RamTstBlockId=4, RamTstEndAddress=536898683, RamTstStartAddress=536895572, RamTstTestPolicy=RAMTEST_DESTRUCTIVE
            RamTstBlockParams_EcuM: RamTstBlockId=5, RamTstEndAddress=536898731, RamTstStartAddress=536898684, RamTstTestPolicy=RAMTEST_NON_DESTRUCTIVE
            RamTstBlockParams_5: RamTstBlockId=6, RamTstEndAddress=536911651, RamTstStartAddress=536898732, RamTstTestPolicy=RAMTEST_DESTRUCTIVE
  module config NvM
    NvMCommon:
      NvMApiConfigClass = NVM_API_CONFIG_CLASS_3
      NvMBswMMultiBlockJobStatusInformation = false
      NvMCompiledConfigId = 3
      NvMCrcNumOfBytes = 128
      NvMDatasetSelectionBits = 8
      NvMDevErrorDetect = true
      NvMDrvModeSwitch = true
      NvMDynamicConfiguration = false
      NvMJobPrioritization = false
      NvMMainFunctionPeriod = 0.005
      NvMPollingMode = false
      NvMRepeatMirrorOperations = 0
      NvMSetRamBlockStatusApi = false
      NvMSizeStandardJobQueue = 42
      NvMVersionInfoApi = false
      NvMMultiBlockCallback = Rte_NvMNotifyJobFinished_MultiBlock
    43 x NvMBlockDescriptor, all with NvMBlockCrcType=NVM_CRC16, NvMBlockJobPriority=1, NvMBlockUseAutoValidation=false, NvMBlockUseCRCCompMechanism=false, NvMBlockUseCrc=true, NvMBlockUseSetRamBlockStatus=false, NvMBswMBlockStatusInformation=false, NvMNvramDeviceId=0, NvMResistantToChangedSw=true, NvMRomBlockNum=0, NvMSelectBlockForReadAll=true, NvMStaticBlockIDCheck=false, NvMWriteBlockOnce=false, NvMBlockWriteProt=false, NvMWriteVerification=false, NvMWriteVerificationDataSize=0, ISoftNvMUseNotifyInitBlock=false, ISoftNvMUseNotifyJobFinished=false, NvMRamBlockDataBufferAutoFill=true:
      NvMBlock_ConfigID: NvMBlockManagementType=NVM_BLOCK_REDUNDANT, NvMBlockUseSyncMechanism=true, NvMCalcRamBlockCrc=true, NvMMaxNumOfReadRetries=0, NvMMaxNumOfWriteRetries=0, NvMNvBlockBaseNumber=1, NvMNvBlockLength=2, NvMNvBlockNum=2, NvMNvramBlockIdentifier=NvMBlock_ConfigID, NvMSelectBlockForWriteAll=true, NvMRamBlockDataAddress=NvMBlockRamBuffer1
        NvMTargetBlockReference
          NvMFeeRef: NvMNameOfFeeBlock=FeeBlockConfiguration_0
      NvMBlock_DCMSec: NvMBlockManagementType=NVM_BLOCK_NATIVE, NvMBlockUseSyncMechanism=false, NvMCalcRamBlockCrc=false, NvMMaxNumOfReadRetries=1, NvMMaxNumOfWriteRetries=1, NvMNvBlockBaseNumber=2, NvMNvBlockLength=32, NvMNvBlockNum=1, NvMNvramBlockIdentifier=NvMBlock_DCMSec, NvMSelectBlockForWriteAll=false, NvMRamBlockDataAddress=NvMBlockRamBuffer2, NvMSingleBlockCallback=Rte_NvMNotifyJobFinished_NvMBlock_DCMSec, NvMBlockHeaderInclude=Rte_Diag
        NvMTargetBlockReference
          NvMFeeRef: NvMNameOfFeeBlock=FeeBlockConfiguration_2
      NvMBlock_DemEntry_0: NvMBlockManagementType=NVM_BLOCK_NATIVE, NvMBlockUseSyncMechanism=false, NvMCalcRamBlockCrc=false, NvMMaxNumOfReadRetries=1, NvMMaxNumOfWriteRetries=1, NvMNvBlockBaseNumber=3, NvMNvBlockLength=32, NvMNvBlockNum=1, NvMNvramBlockIdentifier=NvMBlock_DemEntry_0, NvMSelectBlockForWriteAll=false, NvMRamBlockDataAddress=NvMBlockRamBuffer3
        NvMTargetBlockReference
          NvMFeeRef: NvMNameOfFeeBlock=FeeBlockConfiguration_3
      NvMBlock_DemEntry_1: NvMBlockManagementType=NVM_BLOCK_NATIVE, NvMBlockUseSyncMechanism=false, NvMCalcRamBlockCrc=false, NvMMaxNumOfReadRetries=1, NvMMaxNumOfWriteRetries=1, NvMNvBlockBaseNumber=4, NvMNvBlockLength=32, NvMNvBlockNum=1, NvMNvramBlockIdentifier=NvMBlock_DemEntry_1, NvMSelectBlockForWriteAll=false, NvMRamBlockDataAddress=NvMBlockRamBuffer4
        NvMTargetBlockReference
          NvMFeeRef: NvMNameOfFeeBlock=FeeBlockConfiguration_4
      NvMBlock_DemEntry_2: NvMBlockManagementType=NVM_BLOCK_NATIVE, NvMBlockUseSyncMechanism=false, NvMCalcRamBlockCrc=false, NvMMaxNumOfReadRetries=1, NvMMaxNumOfWriteRetries=1, NvMNvBlockBaseNumber=5, NvMNvBlockLength=32, NvMNvBlockNum=1, NvMNvramBlockIdentifier=NvMBlock_DemEntry_2, NvMSelectBlockForWriteAll=false, NvMRamBlockDataAddress=NvMBlockRamBuffer5
        NvMTargetBlockReference
          NvMFeeRef: NvMNameOfFeeBlock=FeeBlockConfiguration_5
      NvMBlock_DemEntry_3: NvMBlockManagementType=NVM_BLOCK_NATIVE, NvMBlockUseSyncMechanism=false, NvMCalcRamBlockCrc=false, NvMMaxNumOfReadRetries=1, NvMMaxNumOfWriteRetries=1, NvMNvBlockBaseNumber=6, NvMNvBlockLength=32, NvMNvBlockNum=1, NvMNvramBlockIdentifier=NvMBlock_DemEntry_3, NvMSelectBlockForWriteAll=false, NvMRamBlockDataAddress=NvMBlockRamBuffer6
        NvMTargetBlockReference
          NvMFeeRef: NvMNameOfFeeBlock=FeeBlockConfiguration_6
      NvMBlock_DemEntry_4: NvMBlockManagementType=NVM_BLOCK_NATIVE, NvMBlockUseSyncMechanism=false, NvMCalcRamBlockCrc=false, NvMMaxNumOfReadRetries=1, NvMMaxNumOfWriteRetries=1, NvMNvBlockBaseNumber=7, NvMNvBlockLength=32, NvMNvBlockNum=1, NvMNvramBlockIdentifier=NvMBlock_DemEntry_4, NvMSelectBlockForWriteAll=false, NvMRamBlockDataAddress=NvMBlockRamBuffer7
        NvMTargetBlockReference
          NvMFeeRef: NvMNameOfFeeBlock=FeeBlockConfiguration_7
      NvMBlock_DemEntry_5: NvMBlockManagementType=NVM_BLOCK_NATIVE, NvMBlockUseSyncMechanism=false, NvMCalcRamBlockCrc=false, NvMMaxNumOfReadRetries=1, NvMMaxNumOfWriteRetries=1, NvMNvBlockBaseNumber=8, NvMNvBlockLength=32, NvMNvBlockNum=1, NvMNvramBlockIdentifier=NvMBlock_DemEntry_5, NvMSelectBlockForWriteAll=false, NvMRamBlockDataAddress=NvMBlockRamBuffer8
        NvMTargetBlockReference
          NvMFeeRef: NvMNameOfFeeBlock=FeeBlockConfiguration_8
      NvMBlock_DemEntry_6: NvMBlockManagementType=NVM_BLOCK_NATIVE, NvMBlockUseSyncMechanism=false, NvMCalcRamBlockCrc=false, NvMMaxNumOfReadRetries=1, NvMMaxNumOfWriteRetries=1, NvMNvBlockBaseNumber=9, NvMNvBlockLength=32, NvMNvBlockNum=1, NvMNvramBlockIdentifier=NvMBlock_DemEntry_6, NvMSelectBlockForWriteAll=false, NvMRamBlockDataAddress=NvMBlockRamBuffer9
        NvMTargetBlockReference
          NvMFeeRef: NvMNameOfFeeBlock=FeeBlockConfiguration_9
      NvMBlock_DemEntry_7: NvMBlockManagementType=NVM_BLOCK_NATIVE, NvMBlockUseSyncMechanism=false, NvMCalcRamBlockCrc=false, NvMMaxNumOfReadRetries=1, NvMMaxNumOfWriteRetries=1, NvMNvBlockBaseNumber=10, NvMNvBlockLength=32, NvMNvBlockNum=1, NvMNvramBlockIdentifier=NvMBlock_DemEntry_7, NvMSelectBlockForWriteAll=false, NvMRamBlockDataAddress=NvMBlockRamBuffer10
        NvMTargetBlockReference
          NvMFeeRef: NvMNameOfFeeBlock=FeeBlockConfiguration_10
      NvMBlock_DemEntry_8: NvMBlockManagementType=NVM_BLOCK_NATIVE, NvMBlockUseSyncMechanism=false, NvMCalcRamBlockCrc=false, NvMMaxNumOfReadRetries=1, NvMMaxNumOfWriteRetries=1, NvMNvBlockBaseNumber=11, NvMNvBlockLength=32, NvMNvBlockNum=1, NvMNvramBlockIdentifier=NvMBlock_DemEntry_8, NvMSelectBlockForWriteAll=false, NvMRamBlockDataAddress=NvMBlockRamBuffer11
        NvMTargetBlockReference
          NvMFeeRef: NvMNameOfFeeBlock=FeeBlockConfiguration_11
      NvMBlock_DemEntry_9: NvMBlockManagementType=NVM_BLOCK_NATIVE, NvMBlockUseSyncMechanism=false, NvMCalcRamBlockCrc=false, NvMMaxNumOfReadRetries=1, NvMMaxNumOfWriteRetries=1, NvMNvBlockBaseNumber=12, NvMNvBlockLength=32, NvMNvBlockNum=1, NvMNvramBlockIdentifier=NvMBlock_DemEntry_9, NvMSelectBlockForWriteAll=false, NvMRamBlockDataAddress=NvMBlockRamBuffer12
        NvMTargetBlockReference
          NvMFeeRef: NvMNameOfFeeBlock=FeeBlockConfiguration_12
      NvMBlock_DemEntry_10: NvMBlockManagementType=NVM_BLOCK_NATIVE, NvMBlockUseSyncMechanism=false, NvMCalcRamBlockCrc=false, NvMMaxNumOfReadRetries=1, NvMMaxNumOfWriteRetries=1, NvMNvBlockBaseNumber=13, NvMNvBlockLength=32, NvMNvBlockNum=1, NvMNvramBlockIdentifier=NvMBlock_DemEntry_10, NvMSelectBlockForWriteAll=false, NvMRamBlockDataAddress=NvMBlockRamBuffer13
        NvMTargetBlockReference
          NvMFeeRef: NvMNameOfFeeBlock=FeeBlockConfiguration_13
      NvMBlock_DemEntry_11: NvMBlockManagementType=NVM_BLOCK_NATIVE, NvMBlockUseSyncMechanism=false, NvMCalcRamBlockCrc=false, NvMMaxNumOfReadRetries=1, NvMMaxNumOfWriteRetries=1, NvMNvBlockBaseNumber=14, NvMNvBlockLength=32, NvMNvBlockNum=1, NvMNvramBlockIdentifier=NvMBlock_DemEntry_11, NvMSelectBlockForWriteAll=false, NvMRamBlockDataAddress=NvMBlockRamBuffer14
        NvMTargetBlockReference
          NvMFeeRef: NvMNameOfFeeBlock=FeeBlockConfiguration_14
      NvMBlock_DemEntry_12: NvMBlockManagementType=NVM_BLOCK_NATIVE, NvMBlockUseSyncMechanism=false, NvMCalcRamBlockCrc=false, NvMMaxNumOfReadRetries=1, NvMMaxNumOfWriteRetries=1, NvMNvBlockBaseNumber=15, NvMNvBlockLength=32, NvMNvBlockNum=1, NvMNvramBlockIdentifier=NvMBlock_DemEntry_12, NvMSelectBlockForWriteAll=false, NvMRamBlockDataAddress=NvMBlockRamBuffer15
        NvMTargetBlockReference
          NvMFeeRef: NvMNameOfFeeBlock=FeeBlockConfiguration_15
      NvMBlock_DemEntry_13: NvMBlockManagementType=NVM_BLOCK_NATIVE, NvMBlockUseSyncMechanism=false, NvMCalcRamBlockCrc=false, NvMMaxNumOfReadRetries=1, NvMMaxNumOfWriteRetries=1, NvMNvBlockBaseNumber=16, NvMNvBlockLength=32, NvMNvBlockNum=1, NvMNvramBlockIdentifier=NvMBlock_DemEntry_13, NvMSelectBlockForWriteAll=false, NvMRamBlockDataAddress=NvMBlockRamBuffer16
        NvMTargetBlockReference
          NvMFeeRef: NvMNameOfFeeBlock=FeeBlockConfiguration_16
      NvMBlock_DemEntry_14: NvMBlockManagementType=NVM_BLOCK_NATIVE, NvMBlockUseSyncMechanism=false, NvMCalcRamBlockCrc=false, NvMMaxNumOfReadRetries=1, NvMMaxNumOfWriteRetries=1, NvMNvBlockBaseNumber=17, NvMNvBlockLength=32, NvMNvBlockNum=1, NvMNvramBlockIdentifier=NvMBlock_DemEntry_14, NvMSelectBlockForWriteAll=false, NvMRamBlockDataAddress=NvMBlockRamBuffer17
        NvMTargetBlockReference
          NvMFeeRef: NvMNameOfFeeBlock=FeeBlockConfiguration_17
      NvMBlock_DemEntry_15: NvMBlockManagementType=NVM_BLOCK_NATIVE, NvMBlockUseSyncMechanism=false, NvMCalcRamBlockCrc=false, NvMMaxNumOfReadRetries=1, NvMMaxNumOfWriteRetries=1, NvMNvBlockBaseNumber=18, NvMNvBlockLength=32, NvMNvBlockNum=1, NvMNvramBlockIdentifier=NvMBlock_DemEntry_15, NvMSelectBlockForWriteAll=false, NvMRamBlockDataAddress=NvMBlockRamBuffer18
        NvMTargetBlockReference
          NvMFeeRef: NvMNameOfFeeBlock=FeeBlockConfiguration_18
      NvMBlock_DemEntry_16: NvMBlockManagementType=NVM_BLOCK_NATIVE, NvMBlockUseSyncMechanism=false, NvMCalcRamBlockCrc=false, NvMMaxNumOfReadRetries=1, NvMMaxNumOfWriteRetries=1, NvMNvBlockBaseNumber=19, NvMNvBlockLength=32, NvMNvBlockNum=1, NvMNvramBlockIdentifier=NvMBlock_DemEntry_16, NvMSelectBlockForWriteAll=false, NvMRamBlockDataAddress=NvMBlockRamBuffer19
        NvMTargetBlockReference
          NvMFeeRef: NvMNameOfFeeBlock=FeeBlockConfiguration_19
      NvMBlock_DemEntry_17: NvMBlockManagementType=NVM_BLOCK_NATIVE, NvMBlockUseSyncMechanism=false, NvMCalcRamBlockCrc=false, NvMMaxNumOfReadRetries=1, NvMMaxNumOfWriteRetries=1, NvMNvBlockBaseNumber=20, NvMNvBlockLength=32, NvMNvBlockNum=1, NvMNvramBlockIdentifier=NvMBlock_DemEntry_17, NvMSelectBlockForWriteAll=false, NvMRamBlockDataAddress=NvMBlockRamBuffer20
        NvMTargetBlockReference
          NvMFeeRef: NvMNameOfFeeBlock=FeeBlockConfiguration_20
      NvMBlock_DemEntry_18: NvMBlockManagementType=NVM_BLOCK_NATIVE, NvMBlockUseSyncMechanism=false, NvMCalcRamBlockCrc=false, NvMMaxNumOfReadRetries=1, NvMMaxNumOfWriteRetries=1, NvMNvBlockBaseNumber=21, NvMNvBlockLength=32, NvMNvBlockNum=1, NvMNvramBlockIdentifier=NvMBlock_DemEntry_18, NvMSelectBlockForWriteAll=false, NvMRamBlockDataAddress=NvMBlockRamBuffer21
        NvMTargetBlockReference
          NvMFeeRef: NvMNameOfFeeBlock=FeeBlockConfiguration_21
      NvMBlock_DemEntry_19: NvMBlockManagementType=NVM_BLOCK_NATIVE, NvMBlockUseSyncMechanism=false, NvMCalcRamBlockCrc=false, NvMMaxNumOfReadRetries=1, NvMMaxNumOfWriteRetries=1, NvMNvBlockBaseNumber=22, NvMNvBlockLength=32, NvMNvBlockNum=1, NvMNvramBlockIdentifier=NvMBlock_DemEntry_19, NvMSelectBlockForWriteAll=false, NvMRamBlockDataAddress=NvMBlockRamBuffer22
        NvMTargetBlockReference
          NvMFeeRef: NvMNameOfFeeBlock=FeeBlockConfiguration_22
      NvMBlock_DemEntry_20: NvMBlockManagementType=NVM_BLOCK_NATIVE, NvMBlockUseSyncMechanism=false, NvMCalcRamBlockCrc=false, NvMMaxNumOfReadRetries=1, NvMMaxNumOfWriteRetries=1, NvMNvBlockBaseNumber=23, NvMNvBlockLength=32, NvMNvBlockNum=1, NvMNvramBlockIdentifier=NvMBlock_DemEntry_20, NvMSelectBlockForWriteAll=false, NvMRamBlockDataAddress=NvMBlockRamBuffer23
        NvMTargetBlockReference
          NvMFeeRef: NvMNameOfFeeBlock=FeeBlockConfiguration_23
      NvMBlock_DemEntry_21: NvMBlockManagementType=NVM_BLOCK_NATIVE, NvMBlockUseSyncMechanism=false, NvMCalcRamBlockCrc=false, NvMMaxNumOfReadRetries=1, NvMMaxNumOfWriteRetries=1, NvMNvBlockBaseNumber=24, NvMNvBlockLength=32, NvMNvBlockNum=1, NvMNvramBlockIdentifier=NvMBlock_DemEntry_21, NvMSelectBlockForWriteAll=false, NvMRamBlockDataAddress=NvMBlockRamBuffer24
        NvMTargetBlockReference
          NvMFeeRef: NvMNameOfFeeBlock=FeeBlockConfiguration_24
      NvMBlock_DemEntry_22: NvMBlockManagementType=NVM_BLOCK_NATIVE, NvMBlockUseSyncMechanism=false, NvMCalcRamBlockCrc=false, NvMMaxNumOfReadRetries=1, NvMMaxNumOfWriteRetries=1, NvMNvBlockBaseNumber=25, NvMNvBlockLength=32, NvMNvBlockNum=1, NvMNvramBlockIdentifier=NvMBlock_DemEntry_22, NvMSelectBlockForWriteAll=false, NvMRamBlockDataAddress=NvMBlockRamBuffer25
        NvMTargetBlockReference
          NvMFeeRef: NvMNameOfFeeBlock=FeeBlockConfiguration_25
      NvMBlock_DemEntry_23: NvMBlockManagementType=NVM_BLOCK_NATIVE, NvMBlockUseSyncMechanism=false, NvMCalcRamBlockCrc=false, NvMMaxNumOfReadRetries=1, NvMMaxNumOfWriteRetries=1, NvMNvBlockBaseNumber=26, NvMNvBlockLength=32, NvMNvBlockNum=1, NvMNvramBlockIdentifier=NvMBlock_DemEntry_23, NvMSelectBlockForWriteAll=false, NvMRamBlockDataAddress=NvMBlockRamBuffer26
        NvMTargetBlockReference
          NvMFeeRef: NvMNameOfFeeBlock=FeeBlockConfiguration_26
      NvMBlock_DemEntry_24: NvMBlockManagementType=NVM_BLOCK_NATIVE, NvMBlockUseSyncMechanism=false, NvMCalcRamBlockCrc=false, NvMMaxNumOfReadRetries=1, NvMMaxNumOfWriteRetries=1, NvMNvBlockBaseNumber=27, NvMNvBlockLength=32, NvMNvBlockNum=1, NvMNvramBlockIdentifier=NvMBlock_DemEntry_24, NvMSelectBlockForWriteAll=false, NvMRamBlockDataAddress=NvMBlockRamBuffer27
        NvMTargetBlockReference
          NvMFeeRef: NvMNameOfFeeBlock=FeeBlockConfiguration_27
      NvMBlock_DemEntry_25: NvMBlockManagementType=NVM_BLOCK_NATIVE, NvMBlockUseSyncMechanism=false, NvMCalcRamBlockCrc=false, NvMMaxNumOfReadRetries=1, NvMMaxNumOfWriteRetries=1, NvMNvBlockBaseNumber=28, NvMNvBlockLength=32, NvMNvBlockNum=1, NvMNvramBlockIdentifier=NvMBlock_DemEntry_25, NvMSelectBlockForWriteAll=false, NvMRamBlockDataAddress=NvMBlockRamBuffer28
        NvMTargetBlockReference
          NvMFeeRef: NvMNameOfFeeBlock=FeeBlockConfiguration_28
      NvMBlock_DemEntry_26: NvMBlockManagementType=NVM_BLOCK_NATIVE, NvMBlockUseSyncMechanism=false, NvMCalcRamBlockCrc=false, NvMMaxNumOfReadRetries=1, NvMMaxNumOfWriteRetries=1, NvMNvBlockBaseNumber=29, NvMNvBlockLength=32, NvMNvBlockNum=1, NvMNvramBlockIdentifier=NvMBlock_DemEntry_26, NvMSelectBlockForWriteAll=false, NvMRamBlockDataAddress=NvMBlockRamBuffer29
        NvMTargetBlockReference
          NvMFeeRef: NvMNameOfFeeBlock=FeeBlockConfiguration_29
      NvMBlock_DemEntry_27: NvMBlockManagementType=NVM_BLOCK_NATIVE, NvMBlockUseSyncMechanism=false, NvMCalcRamBlockCrc=false, NvMMaxNumOfReadRetries=1, NvMMaxNumOfWriteRetries=1, NvMNvBlockBaseNumber=30, NvMNvBlockLength=32, NvMNvBlockNum=1, NvMNvramBlockIdentifier=NvMBlock_DemEntry_27, NvMSelectBlockForWriteAll=false, NvMRamBlockDataAddress=NvMBlockRamBuffer30
        NvMTargetBlockReference
          NvMFeeRef: NvMNameOfFeeBlock=FeeBlockConfiguration_30
      NvMBlock_DemEntry_28: NvMBlockManagementType=NVM_BLOCK_NATIVE, NvMBlockUseSyncMechanism=false, NvMCalcRamBlockCrc=false, NvMMaxNumOfReadRetries=1, NvMMaxNumOfWriteRetries=1, NvMNvBlockBaseNumber=31, NvMNvBlockLength=32, NvMNvBlockNum=1, NvMNvramBlockIdentifier=NvMBlock_DemEntry_28, NvMSelectBlockForWriteAll=false, NvMRamBlockDataAddress=NvMBlockRamBuffer31
        NvMTargetBlockReference
          NvMFeeRef: NvMNameOfFeeBlock=FeeBlockConfiguration_31
      NvMBlock_DemEntry_29: NvMBlockManagementType=NVM_BLOCK_NATIVE, NvMBlockUseSyncMechanism=false, NvMCalcRamBlockCrc=false, NvMMaxNumOfReadRetries=1, NvMMaxNumOfWriteRetries=1, NvMNvBlockBaseNumber=32, NvMNvBlockLength=32, NvMNvBlockNum=1, NvMNvramBlockIdentifier=NvMBlock_DemEntry_29, NvMSelectBlockForWriteAll=false, NvMRamBlockDataAddress=NvMBlockRamBuffer32
        NvMTargetBlockReference
          NvMFeeRef: NvMNameOfFeeBlock=FeeBlockConfiguration_32
      NvMBlock_DemEntry_30: NvMBlockManagementType=NVM_BLOCK_NATIVE, NvMBlockUseSyncMechanism=false, NvMCalcRamBlockCrc=false, NvMMaxNumOfReadRetries=1, NvMMaxNumOfWriteRetries=1, NvMNvBlockBaseNumber=33, NvMNvBlockLength=32, NvMNvBlockNum=1, NvMNvramBlockIdentifier=NvMBlock_DemEntry_30, NvMSelectBlockForWriteAll=false, NvMRamBlockDataAddress=NvMBlockRamBuffer33
        NvMTargetBlockReference
          NvMFeeRef: NvMNameOfFeeBlock=FeeBlockConfiguration_33
      NvMBlock_DemEntry_31: NvMBlockManagementType=NVM_BLOCK_NATIVE, NvMBlockUseSyncMechanism=false, NvMCalcRamBlockCrc=false, NvMMaxNumOfReadRetries=1, NvMMaxNumOfWriteRetries=1, NvMNvBlockBaseNumber=34, NvMNvBlockLength=32, NvMNvBlockNum=1, NvMNvramBlockIdentifier=NvMBlock_DemEntry_31, NvMSelectBlockForWriteAll=false, NvMRamBlockDataAddress=NvMBlockRamBuffer34
        NvMTargetBlockReference
          NvMFeeRef: NvMNameOfFeeBlock=FeeBlockConfiguration_34
      NvMBlock_DemEntry_32: NvMBlockManagementType=NVM_BLOCK_NATIVE, NvMBlockUseSyncMechanism=false, NvMCalcRamBlockCrc=false, NvMMaxNumOfReadRetries=1, NvMMaxNumOfWriteRetries=1, NvMNvBlockBaseNumber=35, NvMNvBlockLength=32, NvMNvBlockNum=1, NvMNvramBlockIdentifier=NvMBlock_DemEntry_32, NvMSelectBlockForWriteAll=false, NvMRamBlockDataAddress=NvMBlockRamBuffer35
        NvMTargetBlockReference
          NvMFeeRef: NvMNameOfFeeBlock=FeeBlockConfiguration_35
      NvMBlock_DemEntry_33: NvMBlockManagementType=NVM_BLOCK_NATIVE, NvMBlockUseSyncMechanism=false, NvMCalcRamBlockCrc=false, NvMMaxNumOfReadRetries=1, NvMMaxNumOfWriteRetries=1, NvMNvBlockBaseNumber=36, NvMNvBlockLength=32, NvMNvBlockNum=1, NvMNvramBlockIdentifier=NvMBlock_DemEntry_33, NvMSelectBlockForWriteAll=false, NvMRamBlockDataAddress=NvMBlockRamBuffer36
        NvMTargetBlockReference
          NvMFeeRef: NvMNameOfFeeBlock=FeeBlockConfiguration_36
      NvMBlock_DemEntry_34: NvMBlockManagementType=NVM_BLOCK_NATIVE, NvMBlockUseSyncMechanism=false, NvMCalcRamBlockCrc=false, NvMMaxNumOfReadRetries=1, NvMMaxNumOfWriteRetries=1, NvMNvBlockBaseNumber=37, NvMNvBlockLength=32, NvMNvBlockNum=1, NvMNvramBlockIdentifier=NvMBlock_DemEntry_34, NvMSelectBlockForWriteAll=false, NvMRamBlockDataAddress=NvMBlockRamBuffer37
        NvMTargetBlockReference
          NvMFeeRef: NvMNameOfFeeBlock=FeeBlockConfiguration_37
      NvMBlock_DemEntry_35: NvMBlockManagementType=NVM_BLOCK_NATIVE, NvMBlockUseSyncMechanism=false, NvMCalcRamBlockCrc=false, NvMMaxNumOfReadRetries=1, NvMMaxNumOfWriteRetries=1, NvMNvBlockBaseNumber=38, NvMNvBlockLength=32, NvMNvBlockNum=1, NvMNvramBlockIdentifier=NvMBlock_DemEntry_35, NvMSelectBlockForWriteAll=false, NvMRamBlockDataAddress=NvMBlockRamBuffer38
        NvMTargetBlockReference
          NvMFeeRef: NvMNameOfFeeBlock=FeeBlockConfiguration_38
      NvMBlock_DemEntry_36: NvMBlockManagementType=NVM_BLOCK_NATIVE, NvMBlockUseSyncMechanism=false, NvMCalcRamBlockCrc=false, NvMMaxNumOfReadRetries=1, NvMMaxNumOfWriteRetries=1, NvMNvBlockBaseNumber=39, NvMNvBlockLength=32, NvMNvBlockNum=1, NvMNvramBlockIdentifier=NvMBlock_DemEntry_36, NvMSelectBlockForWriteAll=false, NvMRamBlockDataAddress=NvMBlockRamBuffer39
        NvMTargetBlockReference
          NvMFeeRef: NvMNameOfFeeBlock=FeeBlockConfiguration_39
      NvMBlock_DemEntry_37: NvMBlockManagementType=NVM_BLOCK_NATIVE, NvMBlockUseSyncMechanism=false, NvMCalcRamBlockCrc=false, NvMMaxNumOfReadRetries=1, NvMMaxNumOfWriteRetries=1, NvMNvBlockBaseNumber=40, NvMNvBlockLength=32, NvMNvBlockNum=1, NvMNvramBlockIdentifier=NvMBlock_DemEntry_37, NvMSelectBlockForWriteAll=false, NvMRamBlockDataAddress=NvMBlockRamBuffer40
        NvMTargetBlockReference
          NvMFeeRef: NvMNameOfFeeBlock=FeeBlockConfiguration_40
      NvMBlock_DemEntry_DemVersion: NvMBlockManagementType=NVM_BLOCK_NATIVE, NvMBlockUseSyncMechanism=false, NvMCalcRamBlockCrc=false, NvMMaxNumOfReadRetries=1, NvMMaxNumOfWriteRetries=1, NvMNvBlockBaseNumber=41, NvMNvBlockLength=32, NvMNvBlockNum=1, NvMNvramBlockIdentifier=NvMBlock_DemEntry_DemVersion, NvMSelectBlockForWriteAll=false, NvMRamBlockDataAddress=NvMBlockRamBuffer41
        NvMTargetBlockReference
          NvMFeeRef: NvMNameOfFeeBlock=FeeBlockConfiguration_41
      NvMBlock_DemEntry_OBD: NvMBlockManagementType=NVM_BLOCK_NATIVE, NvMBlockUseSyncMechanism=false, NvMCalcRamBlockCrc=false, NvMMaxNumOfReadRetries=1, NvMMaxNumOfWriteRetries=1, NvMNvBlockBaseNumber=42, NvMNvBlockLength=32, NvMNvBlockNum=1, NvMNvramBlockIdentifier=NvMBlock_DemEntry_OBD, NvMSelectBlockForWriteAll=false, NvMRamBlockDataAddress=NvMBlockRamBuffer42
        NvMTargetBlockReference
          NvMFeeRef: NvMNameOfFeeBlock=FeeBlockConfiguration_42
      NvMBlock_DemEventInfo: NvMBlockManagementType=NVM_BLOCK_NATIVE, NvMBlockUseSyncMechanism=false, NvMCalcRamBlockCrc=false, NvMMaxNumOfReadRetries=1, NvMMaxNumOfWriteRetries=1, NvMNvBlockBaseNumber=43, NvMNvBlockLength=200, NvMNvBlockNum=1, NvMNvramBlockIdentifier=NvMBlock_DemEventInfo, NvMSelectBlockForWriteAll=false, NvMRamBlockDataAddress=NvMBlockRamBuffer43
        NvMTargetBlockReference
          NvMFeeRef: NvMNameOfFeeBlock=FeeBlockConfiguration_43
  module config FlsTst
    FlsTstGeneral:
      FlsTstDevErrorDetect = true
      FlsTstMainFunctionPeriod = 1.0
      FlsTstNumberOfTestedCellsAtomic = 128
      FlsTstTestCompletedNotificationSupported = true
      FlsTstTestIntervalIdEndValue = 256
      FlsTstInitECC = true
      FlsTstExtendedSafetyMode = true
      FlsTstNumberOfTestedCells = 8
      FlsTstFgndTimeOut = 65536
    FlsTstConfigSet: FlsTstTestCompletedNotification=FlsTst_Notify
      FlsTstBlockBgnd_0 (FlsTstBlockBgnd): FlsTstBgndBlockId=0, FlsTstBlockBaseAddress=65536, FlsTstBlockSize=614400, FlsTstSignatureAddress=983056, FlsTstTestAlgorithm=FLSTST_32BIT_CRC
      FlsTstBlockFgnd_0 (FlsTstBlockFgnd): FlsTstFgndBlockId=0, FlsTstBlockBaseAddress=65536, FlsTstBlockSize=614400, FlsTstSignatureAddress=983056, FlsTstTestAlgorithm=FLSTST_32BIT_CRC
    FlsTstConfigurationOfOptApiServices:
      FlsTstGetCurrentStateApi = true
      FlsTstGetErrorDetailsApi = true
      FlsTstGetTestResultBgndApi = true
      FlsTstGetTestResultFgndApi = true
      FlsTstGetTestSignatureBgndApi = true
      FlsTstGetTestSignatureFgndApi = true
      FlsTstStartFgndApi = true
      FlsTstSuspendResumeApi = true
      FlsTstTestEccApi = true
      FlsTstVersionInfoApi = true
  module config Crc
    CrcGeneral:
      AlgorithmCrc8 = true
      AlgorithmCrc8H2F = true
      AlgorithmCrc16 = true
      AlgorithmCrc32 = true
      AlgorithmCrc32P4 = false
      AlgorithmCrc64 = false
      Crc8Mode = CRC_TABLE
      Crc8H2FMode = CRC_TABLE
      Crc16Mode = CRC_TABLE
      Crc32Mode = CRC_TABLE
      Crc32P4Mode = CRC_TABLE
      Crc64Mode = CRC_TABLE
